/******************************************************************************
** COPYRIGHT (C) CATERPILLAR INC. ALL RIGHTS RESERVED
** This work contains proprietary information, which may
** constitute a trade secret and/or be confidential.
** DESCRIPTION:
** This file contains all ASAP2 objects for calibration of the model.
** FILE: toa_wl00.a2l
** Real-Time Workshop code generation for Simulink model:
** "toa_wl00.mdl".
** Model Version : 1.44
** Real-Time Workshop file version : 8.13 (R2017b) 24-Jul-2017
** TLC version : 8.13 (Jul 25 2017)
** CATutils_MatLab version : CATUTILS_MATLAB_4.6.1
******************************************************************************/ ASAP2_VERSION 1 61
/* ASAP2 Version = 1.61 */
/begin PROJECT ProjectName "ASAP2 generated for Simulink model toa_wl00"
/begin HEADER "ASAP2 generated for Simulink model toa_wl00" VERSION "1.44" /end HEADER
/begin MODULE ModuleName "ECM Flashfile from Simulink"
/begin IF_DATA XCP
 /begin PROTOCOL_LAYER 0x0100 0x07D0 0x2710 0x00 0x00 0x00 0x00 0x00 0xFF 0x05AA BYTE_ORDER_MSB_FIRST ADDRESS_GRANULARITY_BYTE OPTIONAL_CMD ALLOC_ODT_ENTRY OPTIONAL_CMD ALLOC_ODT OPTIONAL_CMD ALLOC_DAQ OPTIONAL_CMD FREE_DAQ OPTIONAL_CMD GET_DAQ_EVENT_INFO OPTIONAL_CMD GET_DAQ_LIST_INFO OPTIONAL_CMD GET_DAQ_RESOLUTION_INFO OPTIONAL_CMD GET_DAQ_PROCESSOR_INFO OPTIONAL_CMD GET_DAQ_CLOCK OPTIONAL_CMD START_STOP_SYNCH OPTIONAL_CMD START_STOP_DAQ_LIST OPTIONAL_CMD GET_DAQ_LIST_MODE OPTIONAL_CMD SET_DAQ_LIST_MODE OPTIONAL_CMD WRITE_DAQ OPTIONAL_CMD SET_DAQ_PTR OPTIONAL_CMD CLEAR_DAQ_LIST OPTIONAL_CMD UPLOAD OPTIONAL_CMD SET_MTA OPTIONAL_CMD GET_COMM_MODE_INFO SEED_AND_KEY_EXTERNAL_FUNCTION "SEEDKEY1.dll" /end PROTOCOL_LAYER
 /begin DAQ STATIC 0x00 0x01 0x00 OPTIMISATION_TYPE_DEFAULT ADDRESS_EXTENSION_FREE IDENTIFICATION_FIELD_TYPE_ABSOLUTE GRANULARITY_ODT_ENTRY_SIZE_DAQ_BYTE 0xF8 OVERLOAD_INDICATION_PID /begin DAQ_LIST 0x00 DAQ_LIST_TYPE DAQ MAX_ODT 0x05 MAX_ODT_ENTRIES 0xC8 /end DAQ_LIST /begin STIM GRANULARITY_ODT_ENTRY_SIZE_STIM_BYTE 0xF8 /end STIM /begin TIMESTAMP_SUPPORTED 0x01 SIZE_DWORD UNIT_1US /end TIMESTAMP_SUPPORTED /end DAQ
 /begin PAG 0x00 /end PAG
 /begin PGM PGM_MODE_ABSOLUTE 0x00 0x00 /end PGM
 /begin XCP_ON_UDP_IP /* XCP on UDP_IP version */ 0x0100 /* PORT */ 0xEA60 ADDRESS "165.26.79.19" /end XCP_ON_UDP_IP
/end IF_DATA
/begin IF_DATA ASAP1B_CCP
 /begin RASTER "CCP_UPDATE BaseRate" "BaseRate" 0 3 30 /end RASTER
 /begin TP_BLOB /* CCP Version */ 0x210 /* Blob Version */ 0x0204 /* CAN-Message ID for 'Transmitting to ECU' */ 0x82010000 /* CAN-Message ID for 'Receiving from ECU' */ 0x82020000 /* Logical CCP-Address of the ECU (station) */ 0x0 /* Endianess / Byte order */ 2 BAUDRATE 250000 /end TP_BLOB
/end IF_DATA
/begin MOD_PAR "Mod Par Comment" /end MOD_PAR
/begin MOD_COMMON "Module Common Comment" BYTE_ORDER MSB_LAST DEPOSIT ABSOLUTE /end MOD_COMMON
/*
* Define standard RECORD_LAYOUTs
*/
/* CHARACTERISTIC RECORDS */
/begin RECORD_LAYOUT RL_CHAR_COLUMN_FLOAT64_IEEE FNC_VALUES 1 FLOAT64_IEEE COLUMN_DIR DIRECT /end RECORD_LAYOUT
/begin RECORD_LAYOUT RL_CHAR_COLUMN_FLOAT32_IEEE FNC_VALUES 1 FLOAT32_IEEE COLUMN_DIR DIRECT /end RECORD_LAYOUT
/begin RECORD_LAYOUT RL_CHAR_COLUMN_SBYTE FNC_VALUES 1 SBYTE COLUMN_DIR DIRECT /end RECORD_LAYOUT
/begin RECORD_LAYOUT RL_CHAR_COLUMN_UBYTE FNC_VALUES 1 UBYTE COLUMN_DIR DIRECT /end RECORD_LAYOUT
/begin RECORD_LAYOUT RL_CHAR_COLUMN_SWORD FNC_VALUES 1 SWORD COLUMN_DIR DIRECT /end RECORD_LAYOUT
/begin RECORD_LAYOUT RL_CHAR_COLUMN_UWORD FNC_VALUES 1 UWORD COLUMN_DIR DIRECT /end RECORD_LAYOUT
/begin RECORD_LAYOUT RL_CHAR_COLUMN_SLONG FNC_VALUES 1 SLONG COLUMN_DIR DIRECT /end RECORD_LAYOUT
/begin RECORD_LAYOUT RL_CHAR_COLUMN_ULONG FNC_VALUES 1 ULONG COLUMN_DIR DIRECT /end RECORD_LAYOUT
/* CHARACTERISTIC RECORDS */
/begin RECORD_LAYOUT RL_CHAR_ROW_FLOAT64_IEEE FNC_VALUES 1 FLOAT64_IEEE ROW_DIR DIRECT /end RECORD_LAYOUT
/begin RECORD_LAYOUT RL_CHAR_ROW_FLOAT32_IEEE FNC_VALUES 1 FLOAT32_IEEE ROW_DIR DIRECT /end RECORD_LAYOUT
/begin RECORD_LAYOUT RL_CHAR_ROW_SBYTE FNC_VALUES 1 SBYTE ROW_DIR DIRECT /end RECORD_LAYOUT
/begin RECORD_LAYOUT RL_CHAR_ROW_UBYTE FNC_VALUES 1 UBYTE ROW_DIR DIRECT /end RECORD_LAYOUT
/begin RECORD_LAYOUT RL_CHAR_ROW_SWORD FNC_VALUES 1 SWORD ROW_DIR DIRECT /end RECORD_LAYOUT
/begin RECORD_LAYOUT RL_CHAR_ROW_UWORD FNC_VALUES 1 UWORD ROW_DIR DIRECT /end RECORD_LAYOUT
/begin RECORD_LAYOUT RL_CHAR_ROW_SLONG FNC_VALUES 1 SLONG ROW_DIR DIRECT /end RECORD_LAYOUT
/begin RECORD_LAYOUT RL_CHAR_ROW_ULONG FNC_VALUES 1 ULONG ROW_DIR DIRECT /end RECORD_LAYOUT
/* INDEPENDENT AXIS RECORDS */
/begin RECORD_LAYOUT RL_AXIS_FLOAT64_IEEE AXIS_PTS_X 1 FLOAT64_IEEE INDEX_INCR DIRECT /end RECORD_LAYOUT
/begin RECORD_LAYOUT RL_AXIS_FLOAT32_IEEE AXIS_PTS_X 1 FLOAT32_IEEE INDEX_INCR DIRECT /end RECORD_LAYOUT
/begin RECORD_LAYOUT RL_AXIS_SBYTE AXIS_PTS_X 1 SBYTE INDEX_INCR DIRECT /end RECORD_LAYOUT
/begin RECORD_LAYOUT RL_AXIS_UBYTE AXIS_PTS_X 1 UBYTE INDEX_INCR DIRECT /end RECORD_LAYOUT
/begin RECORD_LAYOUT RL_AXIS_SWORD AXIS_PTS_X 1 SWORD INDEX_INCR DIRECT /end RECORD_LAYOUT
/begin RECORD_LAYOUT RL_AXIS_UWORD AXIS_PTS_X 1 UWORD INDEX_INCR DIRECT /end RECORD_LAYOUT
/begin RECORD_LAYOUT RL_AXIS_SLONG AXIS_PTS_X 1 SLONG INDEX_INCR DIRECT /end RECORD_LAYOUT
/begin RECORD_LAYOUT RL_AXIS_ULONG AXIS_PTS_X 1 ULONG INDEX_INCR DIRECT /end RECORD_LAYOUT
/begin MEASUREMENT toa_sfuncInRawTiltForce "Signal" FLOAT64_IEEE COMPU_METHOD.double 0 0 -1.7976931348623157E+308 1.7976931348623157E+308 ECU_ADDRESS 0x0 /end MEASUREMENT
/begin MEASUREMENT toa_sfuncInRawLiftForce "Signal" FLOAT64_IEEE COMPU_METHOD.double 0 0 -1.7976931348623157E+308 1.7976931348623157E+308 ECU_ADDRESS 0x0 /end MEASUREMENT
/begin MEASUREMENT toa_sfuncInRawTiltExt "Signal" FLOAT64_IEEE COMPU_METHOD.double 0 0 -1.7976931348623157E+308 1.7976931348623157E+308 ECU_ADDRESS 0x0 /end MEASUREMENT
/begin MEASUREMENT toa_sfuncInRawLiftAng "Signal" FLOAT64_IEEE COMPU_METHOD.double 0 0 -1.7976931348623157E+308 1.7976931348623157E+308 ECU_ADDRESS 0x0 /end MEASUREMENT
/begin MEASUREMENT toa_sfuncInRawBcLength "Signal" FLOAT64_IEEE COMPU_METHOD.double 0 0 -1.7976931348623157E+308 1.7976931348623157E+308 ECU_ADDRESS 0x0 /end MEASUREMENT
/begin MEASUREMENT toa_sfuncInRawGravX "Signal" FLOAT64_IEEE COMPU_METHOD.double 0 0 -1.7976931348623157E+308 1.7976931348623157E+308 ECU_ADDRESS 0x0 /end MEASUREMENT
/begin MEASUREMENT toa_sfuncInRawGravY "Signal" FLOAT64_IEEE COMPU_METHOD.double 0 0 -1.7976931348623157E+308 1.7976931348623157E+308 ECU_ADDRESS 0x0 /end MEASUREMENT
/begin MEASUREMENT toa_sfuncOutRawMass "Signal" FLOAT64_IEEE COMPU_METHOD.double 0 0 -1.7976931348623157E+308 1.7976931348623157E+308 ECU_ADDRESS 0x0 /end MEASUREMENT
/begin MEASUREMENT toa_imuNeefPitch "Signal" FLOAT64_IEEE COMPU_METHOD.double 0 0 -1.7976931348623157E+308 1.7976931348623157E+308 ECU_ADDRESS 0x0 /end MEASUREMENT
/begin MEASUREMENT toa_sfuncOutRawDist "Signal" FLOAT64_IEEE COMPU_METHOD.double 0 0 -1.7976931348623157E+308 1.7976931348623157E+308 ECU_ADDRESS 0x0 /end MEASUREMENT
/begin MEASUREMENT toa_targetCompMargin "Signal" FLOAT64_IEEE COMPU_METHOD.double 0 0 -1.7976931348623157E+308 1.7976931348623157E+308 ECU_ADDRESS 0x0 /end MEASUREMENT
/begin MEASUREMENT toa_targetPayloadPostComp "Signal" FLOAT64_IEEE COMPU_METHOD.double 0 0 -1.7976931348623157E+308 1.7976931348623157E+308 ECU_ADDRESS 0x0 /end MEASUREMENT
/begin MEASUREMENT toa_grav_angles "Signal" FLOAT64_IEEE COMPU_METHOD.double 0 0 -1.7976931348623157E+308 1.7976931348623157E+308 MATRIX_DIM 3 1 1 LAYOUT COLUMN_DIR ECU_ADDRESS 0x0 /end MEASUREMENT
/begin MEASUREMENT toa_inTsTiltExt "Signal" FLOAT32_IEEE COMPU_METHOD.single 0 0 -3.4028234663852886E+38 3.4028234663852886E+38 ECU_ADDRESS 0x0 /end MEASUREMENT
/begin MEASUREMENT toa_inTsLiftAngle "Signal" FLOAT32_IEEE COMPU_METHOD.single 0 0 -3.4028234663852886E+38 3.4028234663852886E+38 ECU_ADDRESS 0x0 /end MEASUREMENT
/begin MEASUREMENT toa_inTsBc "Signal" FLOAT32_IEEE COMPU_METHOD.single 0 0 -3.4028234663852886E+38 3.4028234663852886E+38 ECU_ADDRESS 0x0 /end MEASUREMENT
/begin MEASUREMENT toa_inTsBcAng "Signal" FLOAT32_IEEE COMPU_METHOD.single 0 0 -3.4028234663852886E+38 3.4028234663852886E+38 ECU_ADDRESS 0x0 /end MEASUREMENT
/begin MEASUREMENT toa_tiltSensitivity "Signal" FLOAT32_IEEE COMPU_METHOD.single 0 0 -3.4028234663852886E+38 3.4028234663852886E+38 ECU_ADDRESS 0x0 /end MEASUREMENT
/begin MEASUREMENT toa_outTiltSensToBucket "Signal" FLOAT32_IEEE COMPU_METHOD.single 0 0 -3.4028234663852886E+38 3.4028234663852886E+38 ECU_ADDRESS 0x0 /end MEASUREMENT
/begin MEASUREMENT toa_outTiltHePress "Signal" FLOAT32_IEEE COMPU_METHOD.single 0 0 -3.4028234663852886E+38 3.4028234663852886E+38 ECU_ADDRESS 0x0 /end MEASUREMENT
/begin MEASUREMENT toa_tiltForce "Signal" FLOAT32_IEEE COMPU_METHOD.single 0 0 -3.4028234663852886E+38 3.4028234663852886E+38 ECU_ADDRESS 0x0 /end MEASUREMENT
/begin MEASUREMENT toa_sfuncInTiltForce "Signal" FLOAT32_IEEE COMPU_METHOD.single 0 0 -3.4028234663852886E+38 3.4028234663852886E+38 ECU_ADDRESS 0x0 /end MEASUREMENT
/begin MEASUREMENT toa_fcLiftForceRaw "Signal" FLOAT32_IEEE COMPU_METHOD.single 0 0 -3.4028234663852886E+38 3.4028234663852886E+38 ECU_ADDRESS 0x0 /end MEASUREMENT
/begin MEASUREMENT toa_fcLiftForceComp "Signal" FLOAT32_IEEE COMPU_METHOD.single 0 0 -3.4028234663852886E+38 3.4028234663852886E+38 ECU_ADDRESS 0x0 /end MEASUREMENT
/begin MEASUREMENT toa_liftForce "Signal" FLOAT32_IEEE COMPU_METHOD.single 0 0 -3.4028234663852886E+38 3.4028234663852886E+38 ECU_ADDRESS 0x0 /end MEASUREMENT
/begin MEASUREMENT toa_sfuncInLiftForce "Signal" FLOAT32_IEEE COMPU_METHOD.single 0 0 -3.4028234663852886E+38 3.4028234663852886E+38 ECU_ADDRESS 0x0 /end MEASUREMENT
/begin MEASUREMENT toa_sfuncInTiltExt "Signal" FLOAT32_IEEE COMPU_METHOD.single 0 0 -3.4028234663852886E+38 3.4028234663852886E+38 ECU_ADDRESS 0x0 /end MEASUREMENT
/begin MEASUREMENT toa_sfuncInLiftAng "Signal" FLOAT32_IEEE COMPU_METHOD.single 0 0 -3.4028234663852886E+38 3.4028234663852886E+38 ECU_ADDRESS 0x0 /end MEASUREMENT
/begin MEASUREMENT toa_sfuncInBcLength "Signal" FLOAT32_IEEE COMPU_METHOD.single 0 0 -3.4028234663852886E+38 3.4028234663852886E+38 ECU_ADDRESS 0x0 /end MEASUREMENT
/begin MEASUREMENT toa_inImuAcclX "Signal" FLOAT32_IEEE COMPU_METHOD.single 0 0 -3.4028234663852886E+38 3.4028234663852886E+38 ECU_ADDRESS 0x0 /end MEASUREMENT
/begin MEASUREMENT toa_inImuAcclY "Signal" FLOAT32_IEEE COMPU_METHOD.single 0 0 -3.4028234663852886E+38 3.4028234663852886E+38 ECU_ADDRESS 0x0 /end MEASUREMENT
/begin MEASUREMENT toa_inImuAcclZ "Signal" FLOAT32_IEEE COMPU_METHOD.single 0 0 -3.4028234663852886E+38 3.4028234663852886E+38 ECU_ADDRESS 0x0 /end MEASUREMENT
/begin MEASUREMENT toa_imu_eef_accl_vec_post_lpf "Signal" FLOAT32_IEEE COMPU_METHOD.single 0 0 -3.4028234663852886E+38 3.4028234663852886E+38 MATRIX_DIM 1 3 1 LAYOUT COLUMN_DIR ECU_ADDRESS 0x0 /end MEASUREMENT
/begin MEASUREMENT toa_sfuncInGravX "Signal" FLOAT32_IEEE COMPU_METHOD.single 0 0 -3.4028234663852886E+38 3.4028234663852886E+38 ECU_ADDRESS 0x0 /end MEASUREMENT
/begin MEASUREMENT toa_sfuncInGravY "Signal" FLOAT32_IEEE COMPU_METHOD.single 0 0 -3.4028234663852886E+38 3.4028234663852886E+38 ECU_ADDRESS 0x0 /end MEASUREMENT
/begin MEASUREMENT toa_sfuncOutRawMassTonne "Signal" FLOAT32_IEEE COMPU_METHOD.single 0 0 -3.4028234663852886E+38 3.4028234663852886E+38 ECU_ADDRESS 0x0 /end MEASUREMENT
/begin MEASUREMENT toa_rawPayload "Signal" FLOAT32_IEEE COMPU_METHOD.single 0 0 -3.4028234663852886E+38 3.4028234663852886E+38 ECU_ADDRESS 0x0 /end MEASUREMENT
/begin MEASUREMENT toa_payloadAncZeroed "Signal" FLOAT32_IEEE COMPU_METHOD.single 0 0 -3.4028234663852886E+38 3.4028234663852886E+38 ECU_ADDRESS 0x0 /end MEASUREMENT
/begin MEASUREMENT toa_payloadAncAdjusted "Signal" FLOAT32_IEEE COMPU_METHOD.single 0 0 -3.4028234663852886E+38 3.4028234663852886E+38 ECU_ADDRESS 0x0 /end MEASUREMENT
/begin MEASUREMENT toa_payloadZeroed "Signal" FLOAT32_IEEE COMPU_METHOD.single 0 0 -3.4028234663852886E+38 3.4028234663852886E+38 ECU_ADDRESS 0x0 /end MEASUREMENT
/begin MEASUREMENT toa_payloadAdjusted "Signal" FLOAT32_IEEE COMPU_METHOD.single 0 0 -3.4028234663852886E+38 3.4028234663852886E+38 ECU_ADDRESS 0x0 /end MEASUREMENT
/begin MEASUREMENT toa_pfwPayloadNotchPost "Signal" FLOAT32_IEEE COMPU_METHOD.single 0 0 -3.4028234663852886E+38 3.4028234663852886E+38 ECU_ADDRESS 0x0 /end MEASUREMENT
/begin MEASUREMENT toa_pfwPayloadNotchFiltFinal "Signal" FLOAT32_IEEE COMPU_METHOD.single 0 0 -3.4028234663852886E+38 3.4028234663852886E+38 ECU_ADDRESS 0x0 /end MEASUREMENT
/begin MEASUREMENT toa_pfwSecPayload "Signal" FLOAT32_IEEE COMPU_METHOD.single 0 0 -3.4028234663852886E+38 3.4028234663852886E+38 ECU_ADDRESS 0x0 /end MEASUREMENT
/begin MEASUREMENT toa_lwLpfPost "Signal" FLOAT32_IEEE COMPU_METHOD.single 0 0 -3.4028234663852886E+38 3.4028234663852886E+38 ECU_ADDRESS 0x0 /end MEASUREMENT
/begin MEASUREMENT toa_sendPayloadArb "Signal" FLOAT32_IEEE COMPU_METHOD.single 0 0 -3.4028234663852886E+38 3.4028234663852886E+38 ECU_ADDRESS 0x0 /end MEASUREMENT
/begin MEASUREMENT toa_targetPayloadPreComp "Signal" FLOAT32_IEEE COMPU_METHOD.single 0 0 -3.4028234663852886E+38 3.4028234663852886E+38 ECU_ADDRESS 0x0 /end MEASUREMENT
/begin MEASUREMENT toa_targetPayloadFinal "Signal" FLOAT32_IEEE COMPU_METHOD.single 0 0 -3.4028234663852886E+38 3.4028234663852886E+38 ECU_ADDRESS 0x0 /end MEASUREMENT
/begin MEASUREMENT toa_outPayloadArbNormError "Signal" FLOAT32_IEEE COMPU_METHOD.single 0 0 -3.4028234663852886E+38 3.4028234663852886E+38 ECU_ADDRESS 0x0 /end MEASUREMENT
/begin MEASUREMENT toa_pfwSecStDev "Signal" FLOAT32_IEEE COMPU_METHOD.single 0 0 -3.4028234663852886E+38 3.4028234663852886E+38 ECU_ADDRESS 0x0 /end MEASUREMENT
/begin MEASUREMENT toa_outPfwPayloadNormStdev "Signal" FLOAT32_IEEE COMPU_METHOD.single 0 0 -3.4028234663852886E+38 3.4028234663852886E+38 ECU_ADDRESS 0x0 /end MEASUREMENT
/begin MEASUREMENT toa_outCpmPayloadNormError "Signal" FLOAT32_IEEE COMPU_METHOD.single 0 0 -3.4028234663852886E+38 3.4028234663852886E+38 ECU_ADDRESS 0x0 /end MEASUREMENT
/begin MEASUREMENT toa_lwSpillRate "Signal" FLOAT32_IEEE COMPU_METHOD.single 0 0 -3.4028234663852886E+38 3.4028234663852886E+38 ECU_ADDRESS 0x0 /end MEASUREMENT
/begin MEASUREMENT toa_outSpillRateNorm "Signal" FLOAT32_IEEE COMPU_METHOD.single 0 0 -3.4028234663852886E+38 3.4028234663852886E+38 ECU_ADDRESS 0x0 /end MEASUREMENT
/begin MEASUREMENT toa_outBucketPayloadTarget "Signal" FLOAT32_IEEE COMPU_METHOD.single 0 0 -3.4028234663852886E+38 3.4028234663852886E+38 ECU_ADDRESS 0x0 /end MEASUREMENT
/begin MEASUREMENT toa_statPayloadSecureTwoSize "Signal" FLOAT32_IEEE COMPU_METHOD.single 0 0 -3.4028234663852886E+38 3.4028234663852886E+38 ECU_ADDRESS 0x0 /end MEASUREMENT
/begin MEASUREMENT toa_sendCpmPfwSecSize "Signal" FLOAT32_IEEE COMPU_METHOD.single 0 0 -3.4028234663852886E+38 3.4028234663852886E+38 ECU_ADDRESS 0x0 /end MEASUREMENT
/begin MEASUREMENT toa_sendCpmLivePayload "Signal" FLOAT32_IEEE COMPU_METHOD.single 0 0 -3.4028234663852886E+38 3.4028234663852886E+38 ECU_ADDRESS 0x0 /end MEASUREMENT
/begin MEASUREMENT toa_outSendCpmPayload "Signal" FLOAT32_IEEE COMPU_METHOD.single 0 0 -3.4028234663852886E+38 3.4028234663852886E+38 ECU_ADDRESS 0x0 /end MEASUREMENT
/begin MEASUREMENT toa_pfwNlNotchStDevEst "Signal" FLOAT32_IEEE COMPU_METHOD.single 0 0 -3.4028234663852886E+38 3.4028234663852886E+38 ECU_ADDRESS 0x0 /end MEASUREMENT
/begin MEASUREMENT toa_pfwNlNotchMeanEst "Signal" FLOAT32_IEEE COMPU_METHOD.single 0 0 -3.4028234663852886E+38 3.4028234663852886E+38 ECU_ADDRESS 0x0 /end MEASUREMENT
/begin MEASUREMENT toa_pfwUnsecBoundUpper "Signal" FLOAT32_IEEE COMPU_METHOD.single 0 0 -3.4028234663852886E+38 3.4028234663852886E+38 ECU_ADDRESS 0x0 /end MEASUREMENT
/begin MEASUREMENT toa_outUnsecPayloadNormUp "Signal" FLOAT32_IEEE COMPU_METHOD.single 0 0 -3.4028234663852886E+38 3.4028234663852886E+38 ECU_ADDRESS 0x0 /end MEASUREMENT
/begin MEASUREMENT toa_pfwUnsecBoundLower "Signal" FLOAT32_IEEE COMPU_METHOD.single 0 0 -3.4028234663852886E+38 3.4028234663852886E+38 ECU_ADDRESS 0x0 /end MEASUREMENT
/begin MEASUREMENT toa_outUnsecPayloadNormLow "Signal" FLOAT32_IEEE COMPU_METHOD.single 0 0 -3.4028234663852886E+38 3.4028234663852886E+38 ECU_ADDRESS 0x0 /end MEASUREMENT
/begin MEASUREMENT toa_pfwSecMinBucketAng "Signal" FLOAT32_IEEE COMPU_METHOD.single 0 0 -3.4028234663852886E+38 3.4028234663852886E+38 ECU_ADDRESS 0x0 /end MEASUREMENT
/begin MEASUREMENT toa_outMinSecBucketAng "Signal" FLOAT32_IEEE COMPU_METHOD.single 0 0 -3.4028234663852886E+38 3.4028234663852886E+38 ECU_ADDRESS 0x0 /end MEASUREMENT
/begin MEASUREMENT toa_imuRawEefAcclX "Signal" FLOAT32_IEEE COMPU_METHOD.single 0 0 -3.4028234663852886E+38 3.4028234663852886E+38 ECU_ADDRESS 0x0 /end MEASUREMENT
/begin MEASUREMENT toa_imuRawEefAcclY "Signal" FLOAT32_IEEE COMPU_METHOD.single 0 0 -3.4028234663852886E+38 3.4028234663852886E+38 ECU_ADDRESS 0x0 /end MEASUREMENT
/begin MEASUREMENT toa_imuRawEefAcclZ "Signal" FLOAT32_IEEE COMPU_METHOD.single 0 0 -3.4028234663852886E+38 3.4028234663852886E+38 ECU_ADDRESS 0x0 /end MEASUREMENT
/begin MEASUREMENT toa_imuNeefGravX "Signal" FLOAT32_IEEE COMPU_METHOD.single 0 0 -3.4028234663852886E+38 3.4028234663852886E+38 ECU_ADDRESS 0x0 /end MEASUREMENT
/begin MEASUREMENT toa_imuNeefGravY "Signal" FLOAT32_IEEE COMPU_METHOD.single 0 0 -3.4028234663852886E+38 3.4028234663852886E+38 ECU_ADDRESS 0x0 /end MEASUREMENT
/begin MEASUREMENT toa_imuNeefGravZ "Signal" FLOAT32_IEEE COMPU_METHOD.single 0 0 -3.4028234663852886E+38 3.4028234663852886E+38 ECU_ADDRESS 0x0 /end MEASUREMENT
/begin MEASUREMENT toa_grav_neef_xy_mag "Signal" FLOAT32_IEEE COMPU_METHOD.single 0 0 -3.4028234663852886E+38 3.4028234663852886E+38 ECU_ADDRESS 0x0 /end MEASUREMENT
/begin MEASUREMENT toa_rawDist "Signal" FLOAT32_IEEE COMPU_METHOD.single 0 0 -3.4028234663852886E+38 3.4028234663852886E+38 ECU_ADDRESS 0x0 /end MEASUREMENT
/begin MEASUREMENT toa_statPayloadSecureTwoLower "Signal" FLOAT32_IEEE COMPU_METHOD.single 0 0 -3.4028234663852886E+38 3.4028234663852886E+38 ECU_ADDRESS 0x0 /end MEASUREMENT
/begin MEASUREMENT toa_statPayloadNlNotchOneUp "Signal" FLOAT32_IEEE COMPU_METHOD.single 0 0 -3.4028234663852886E+38 3.4028234663852886E+38 ECU_ADDRESS 0x0 /end MEASUREMENT
/begin MEASUREMENT toa_statPayloadNlNotchOneSize "Signal" FLOAT32_IEEE COMPU_METHOD.single 0 0 -3.4028234663852886E+38 3.4028234663852886E+38 ECU_ADDRESS 0x0 /end MEASUREMENT
/begin MEASUREMENT toa_statPayloadNlNotchTwoUp "Signal" FLOAT32_IEEE COMPU_METHOD.single 0 0 -3.4028234663852886E+38 3.4028234663852886E+38 ECU_ADDRESS 0x0 /end MEASUREMENT
/begin MEASUREMENT toa_statPayloadNlNotchTwoSize "Signal" FLOAT32_IEEE COMPU_METHOD.single 0 0 -3.4028234663852886E+38 3.4028234663852886E+38 ECU_ADDRESS 0x0 /end MEASUREMENT
/begin MEASUREMENT toa_statPayloadNlNotchTwoLow "Signal" FLOAT32_IEEE COMPU_METHOD.single 0 0 -3.4028234663852886E+38 3.4028234663852886E+38 ECU_ADDRESS 0x0 /end MEASUREMENT
/begin MEASUREMENT toa_pfwPayloadFiltFinal "Signal" FLOAT32_IEEE COMPU_METHOD.single 0 0 -3.4028234663852886E+38 3.4028234663852886E+38 ECU_ADDRESS 0x0 /end MEASUREMENT
/begin MEASUREMENT toa_pfwNlStDevEst "Signal" FLOAT32_IEEE COMPU_METHOD.single 0 0 -3.4028234663852886E+38 3.4028234663852886E+38 ECU_ADDRESS 0x0 /end MEASUREMENT
/begin MEASUREMENT toa_pfwNlMeanEst "Signal" FLOAT32_IEEE COMPU_METHOD.single 0 0 -3.4028234663852886E+38 3.4028234663852886E+38 ECU_ADDRESS 0x0 /end MEASUREMENT
/begin MEASUREMENT toa_statPayloadNlOneUp "Signal" FLOAT32_IEEE COMPU_METHOD.single 0 0 -3.4028234663852886E+38 3.4028234663852886E+38 ECU_ADDRESS 0x0 /end MEASUREMENT
/begin MEASUREMENT toa_statPayloadNlOneSize "Signal" FLOAT32_IEEE COMPU_METHOD.single 0 0 -3.4028234663852886E+38 3.4028234663852886E+38 ECU_ADDRESS 0x0 /end MEASUREMENT
/begin MEASUREMENT toa_statPayloadNlTwoUp "Signal" FLOAT32_IEEE COMPU_METHOD.single 0 0 -3.4028234663852886E+38 3.4028234663852886E+38 ECU_ADDRESS 0x0 /end MEASUREMENT
/begin MEASUREMENT toa_statPayloadNlTwoSize "Signal" FLOAT32_IEEE COMPU_METHOD.single 0 0 -3.4028234663852886E+38 3.4028234663852886E+38 ECU_ADDRESS 0x0 /end MEASUREMENT
/begin MEASUREMENT toa_statPayloadNlTwoLow "Signal" FLOAT32_IEEE COMPU_METHOD.single 0 0 -3.4028234663852886E+38 3.4028234663852886E+38 ECU_ADDRESS 0x0 /end MEASUREMENT
/begin MEASUREMENT toa_statPayloadNlOneLow "Signal" FLOAT32_IEEE COMPU_METHOD.single 0 0 -3.4028234663852886E+38 3.4028234663852886E+38 ECU_ADDRESS 0x0 /end MEASUREMENT
/begin MEASUREMENT toa_statPayloadSecureOneUpper "Signal" FLOAT32_IEEE COMPU_METHOD.single 0 0 -3.4028234663852886E+38 3.4028234663852886E+38 ECU_ADDRESS 0x0 /end MEASUREMENT
/begin MEASUREMENT toa_statPayloadSecureOneLower "Signal" FLOAT32_IEEE COMPU_METHOD.single 0 0 -3.4028234663852886E+38 3.4028234663852886E+38 ECU_ADDRESS 0x0 /end MEASUREMENT
/begin MEASUREMENT toa_statPayloadSecureOneSize "Signal" FLOAT32_IEEE COMPU_METHOD.single 0 0 -3.4028234663852886E+38 3.4028234663852886E+38 ECU_ADDRESS 0x0 /end MEASUREMENT
/begin MEASUREMENT toa_statPayloadSecureTwoUpper "Signal" FLOAT32_IEEE COMPU_METHOD.single 0 0 -3.4028234663852886E+38 3.4028234663852886E+38 ECU_ADDRESS 0x0 /end MEASUREMENT
/begin MEASUREMENT toa_statPayloadNlNotchOneLow "Signal" FLOAT32_IEEE COMPU_METHOD.single 0 0 -3.4028234663852886E+38 3.4028234663852886E+38 ECU_ADDRESS 0x0 /end MEASUREMENT
/begin MEASUREMENT toa_grav_rotMatrix "Signal" FLOAT32_IEEE COMPU_METHOD.single 0 0 -3.4028234663852886E+38 3.4028234663852886E+38 MATRIX_DIM 3 3 1 LAYOUT COLUMN_DIR ECU_ADDRESS 0x0 /end MEASUREMENT
/begin MEASUREMENT toa_grav_rotAxis "Signal" FLOAT32_IEEE COMPU_METHOD.single 0 0 -3.4028234663852886E+38 3.4028234663852886E+38 MATRIX_DIM 1 3 1 LAYOUT COLUMN_DIR ECU_ADDRESS 0x0 /end MEASUREMENT
/begin MEASUREMENT toa_grav_angle "Signal" FLOAT32_IEEE COMPU_METHOD.single 0 0 -3.4028234663852886E+38 3.4028234663852886E+38 ECU_ADDRESS 0x0 /end MEASUREMENT
/begin MEASUREMENT toa_imu_neef_accl_vec "Signal" FLOAT32_IEEE COMPU_METHOD.single 0 0 -3.4028234663852886E+38 3.4028234663852886E+38 MATRIX_DIM 1 3 1 LAYOUT COLUMN_DIR ECU_ADDRESS 0x0 /end MEASUREMENT
/begin MEASUREMENT toa_pfwSecStatus "Signal" UBYTE COMPU_METHOD.TipAssistSecPfwStatus_t 0 0 0.0 255.0 ECU_ADDRESS 0x0 /end MEASUREMENT
/begin MEASUREMENT toa_outPfwStat "Signal" UBYTE COMPU_METHOD.TipAssistSecPfwStatus_t 0 0 0.0 255.0 ECU_ADDRESS 0x0 /end MEASUREMENT
/begin MEASUREMENT toa_lwStatus "Signal" UBYTE COMPU_METHOD.TipAssistLiveWeighStatus_t 0 0 0.0 255.0 ECU_ADDRESS 0x0 /end MEASUREMENT
/begin MEASUREMENT toa_pfwUnsecStatus "Signal" UBYTE COMPU_METHOD.TipAssistUnsecPfwStatus_t 0 0 0.0 255.0 ECU_ADDRESS 0x0 /end MEASUREMENT
/begin MEASUREMENT toa_outUnsecPayloadStatus "Signal" UBYTE COMPU_METHOD.TipAssistUnsecPfwStatus_t 0 0 0.0 255.0 ECU_ADDRESS 0x0 /end MEASUREMENT
/begin MEASUREMENT toa_outAdvErrorCode "Signal" UBYTE COMPU_METHOD.TipAssistAdvEcmError_t 0 0 0.0 255.0 ECU_ADDRESS 0x0 /end MEASUREMENT
/begin MEASUREMENT toa_sendPayloadType "Signal" UWORD COMPU_METHOD.TipAssistPayloadType_t 0 0 0.0 65535.0 ECU_ADDRESS 0x0 /end MEASUREMENT
/begin MEASUREMENT toa_outSendCpmStatus "Signal" UBYTE COMPU_METHOD.TipAssistSendCpmStatus_t 0 0 0.0 255.0 ECU_ADDRESS 0x0 /end MEASUREMENT
/begin MEASUREMENT toa_outCpmAccu "Signal" UBYTE COMPU_METHOD.uint8_t 0 0 0.0 255.0 ECU_ADDRESS 0x0 /end MEASUREMENT
/begin MEASUREMENT toa_pfwSecIsNoSliding "Signal" UBYTE COMPU_METHOD.boolean 0 0 0.0 1.0 ECU_ADDRESS 0x0 /end MEASUREMENT
/begin MEASUREMENT toa_pfwSecIsNoCollapsing "Signal" UBYTE COMPU_METHOD.boolean 0 0 0.0 1.0 ECU_ADDRESS 0x0 /end MEASUREMENT
/begin MEASUREMENT toa_pfwSecIsRacked "Signal" UBYTE COMPU_METHOD.boolean 0 0 0.0 1.0 ECU_ADDRESS 0x0 /end MEASUREMENT
/begin MEASUREMENT toa_pfwLatchInvalidate "Signal" UBYTE COMPU_METHOD.boolean 0 0 0.0 1.0 ECU_ADDRESS 0x0 /end MEASUREMENT
/begin MEASUREMENT toa_pfwMcMaybeRackStall "Signal" UBYTE COMPU_METHOD.boolean 0 0 0.0 1.0 ECU_ADDRESS 0x0 /end MEASUREMENT
/begin MEASUREMENT toa_pfwMcMaybeStalled "Signal" UBYTE COMPU_METHOD.boolean 0 0 0.0 1.0 ECU_ADDRESS 0x0 /end MEASUREMENT
/begin MEASUREMENT toa_pfwMcMaybeGrounded "Signal" UBYTE COMPU_METHOD.boolean 0 0 0.0 1.0 ECU_ADDRESS 0x0 /end MEASUREMENT
/begin MEASUREMENT toa_isLiftValveCmd "Signal" UBYTE COMPU_METHOD.boolean 0 0 0.0 1.0 ECU_ADDRESS 0x0 /end MEASUREMENT
/begin MEASUREMENT toa_isTiltValveCmd "Signal" UBYTE COMPU_METHOD.boolean 0 0 0.0 1.0 ECU_ADDRESS 0x0 /end MEASUREMENT
/begin MEASUREMENT toa_is_not_tilt_valve_cmd "Signal" UBYTE COMPU_METHOD.boolean 0 0 0.0 1.0 ECU_ADDRESS 0x0 /end MEASUREMENT
/begin MEASUREMENT toa_tilt_timer_expired "Signal" UBYTE COMPU_METHOD.boolean 0 0 0.0 1.0 ECU_ADDRESS 0x0 /end MEASUREMENT
/begin MEASUREMENT toa_tilt_timer_not_expired "Signal" UBYTE COMPU_METHOD.boolean 0 0 0.0 1.0 ECU_ADDRESS 0x0 /end MEASUREMENT
/begin MEASUREMENT toa_pfwMcOk "Signal" UBYTE COMPU_METHOD.boolean 0 0 0.0 1.0 ECU_ADDRESS 0x0 /end MEASUREMENT
/begin MEASUREMENT toa_pfwIsWarm "Signal" UBYTE COMPU_METHOD.boolean 0 0 0.0 1.0 ECU_ADDRESS 0x0 /end MEASUREMENT
/begin MEASUREMENT toa_pfwSecIsSecure "Signal" UBYTE COMPU_METHOD.boolean 0 0 0.0 1.0 ECU_ADDRESS 0x0 /end MEASUREMENT
/begin MEASUREMENT toa_pfwSecLatch "Signal" UBYTE COMPU_METHOD.boolean 0 0 0.0 1.0 ECU_ADDRESS 0x0 /end MEASUREMENT
/begin MEASUREMENT toa_targetPayloadStatus "Signal" UBYTE COMPU_METHOD.boolean 0 0 0.0 1.0 ECU_ADDRESS 0x0 /end MEASUREMENT
/begin MEASUREMENT toa_sendCpmPfwIsPrecise "Signal" UBYTE COMPU_METHOD.boolean 0 0 0.0 1.0 ECU_ADDRESS 0x0 /end MEASUREMENT
/begin MEASUREMENT UnitDelay1_DSTATE "State" FLOAT32_IEEE COMPU_METHOD.single 0 0 -3.4028234663852886E+38 3.4028234663852886E+38 DISPLAY_IDENTIFIER Unit_Delay1_DSTATE MATRIX_DIM 1 3 1 LAYOUT COLUMN_DIR READ_WRITE ECU_ADDRESS 0x0 /end MEASUREMENT
/begin MEASUREMENT UnitDelay1_DSTATE_mga0 "State" FLOAT32_IEEE COMPU_METHOD.single 0 0 -3.4028234663852886E+38 3.4028234663852886E+38 DISPLAY_IDENTIFIER Unit_Delay1_DSTATE MATRIX_DIM 1 3 1 LAYOUT COLUMN_DIR READ_WRITE ECU_ADDRESS 0x0 /end MEASUREMENT
/begin MEASUREMENT Delay2_DSTATE "State" FLOAT32_IEEE COMPU_METHOD.single 0 0 -3.4028234663852886E+38 3.4028234663852886E+38 READ_WRITE ECU_ADDRESS 0x0 /end MEASUREMENT
/begin MEASUREMENT UnitDelay_DSTATE "State" FLOAT32_IEEE COMPU_METHOD.single 0 0 -3.4028234663852886E+38 3.4028234663852886E+38 DISPLAY_IDENTIFIER Unit_Delay_DSTATE READ_WRITE ECU_ADDRESS 0x0 /end MEASUREMENT
/begin MEASUREMENT UnitDelay1_DSTATE_fp5d "State" FLOAT32_IEEE COMPU_METHOD.single 0 0 -3.4028234663852886E+38 3.4028234663852886E+38 DISPLAY_IDENTIFIER Unit_Delay1_DSTATE READ_WRITE ECU_ADDRESS 0x0 /end MEASUREMENT
/begin MEASUREMENT Delay_DSTATE "State" FLOAT32_IEEE COMPU_METHOD.single 0 0 -3.4028234663852886E+38 3.4028234663852886E+38 READ_WRITE ECU_ADDRESS 0x0 /end MEASUREMENT
/begin MEASUREMENT UnitDelay_DSTATE_hioq "State" FLOAT32_IEEE COMPU_METHOD.single 0 0 -3.4028234663852886E+38 3.4028234663852886E+38 DISPLAY_IDENTIFIER Unit_Delay_DSTATE READ_WRITE ECU_ADDRESS 0x0 /end MEASUREMENT
/begin MEASUREMENT UnitDelay1_DSTATE_bcfn "State" FLOAT32_IEEE COMPU_METHOD.single 0 0 -3.4028234663852886E+38 3.4028234663852886E+38 DISPLAY_IDENTIFIER Unit_Delay1_DSTATE READ_WRITE ECU_ADDRESS 0x0 /end MEASUREMENT
/begin MEASUREMENT UnitDelay_DSTATE_jlpe "State" FLOAT32_IEEE COMPU_METHOD.single 0 0 -3.4028234663852886E+38 3.4028234663852886E+38 DISPLAY_IDENTIFIER Unit_Delay_DSTATE READ_WRITE ECU_ADDRESS 0x0 /end MEASUREMENT
/begin MEASUREMENT ResettableDelay_DSTATE "State" FLOAT32_IEEE COMPU_METHOD.single 0 0 -3.4028234663852886E+38 3.4028234663852886E+38 DISPLAY_IDENTIFIER Resettable_Delay_DSTATE READ_WRITE ECU_ADDRESS 0x0 /end MEASUREMENT
/begin MEASUREMENT UnitDelay1_DSTATE_bo33 "State" FLOAT32_IEEE COMPU_METHOD.single 0 0 -3.4028234663852886E+38 3.4028234663852886E+38 DISPLAY_IDENTIFIER Unit_Delay1_DSTATE READ_WRITE ECU_ADDRESS 0x0 /end MEASUREMENT
/begin MEASUREMENT UnitDelay1_DSTATE_e2d2 "State" FLOAT32_IEEE COMPU_METHOD.single 0 0 -3.4028234663852886E+38 3.4028234663852886E+38 DISPLAY_IDENTIFIER Unit_Delay1_DSTATE READ_WRITE ECU_ADDRESS 0x0 /end MEASUREMENT
/begin MEASUREMENT lastSample "State" FLOAT32_IEEE COMPU_METHOD.single 0 0 -3.4028234663852886E+38 3.4028234663852886E+38 DISPLAY_IDENTIFIER MATLAB_Function_DWORK1 READ_WRITE ECU_ADDRESS 0x0 /end MEASUREMENT
/begin MEASUREMENT lastSample_kln4 "State" FLOAT32_IEEE COMPU_METHOD.single 0 0 -3.4028234663852886E+38 3.4028234663852886E+38 DISPLAY_IDENTIFIER MATLAB_Function_DWORK1 READ_WRITE ECU_ADDRESS 0x0 /end MEASUREMENT
/begin MEASUREMENT Timer_DSTATE "State" UWORD COMPU_METHOD.ufix16_Sp02 0 0 0.0 1310.7 READ_WRITE ECU_ADDRESS 0x0 /end MEASUREMENT
/begin MEASUREMENT Timer_DSTATE_dme3 "State" UWORD COMPU_METHOD.ufix16_Sp02 0 0 0.0 1310.7 DISPLAY_IDENTIFIER Timer_DSTATE READ_WRITE ECU_ADDRESS 0x0 /end MEASUREMENT
/begin MEASUREMENT Timer_DSTATE_jrr0 "State" UWORD COMPU_METHOD.ufix16_Sp02 0 0 0.0 1310.7 DISPLAY_IDENTIFIER Timer_DSTATE READ_WRITE ECU_ADDRESS 0x0 /end MEASUREMENT
/begin MEASUREMENT UnitDelay_DSTATE_mvg5 "State" UBYTE COMPU_METHOD.uint8 0 0 0.0 255.0 DISPLAY_IDENTIFIER Unit_Delay_DSTATE READ_WRITE ECU_ADDRESS 0x0 /end MEASUREMENT
/begin MEASUREMENT UnitDelay_DSTATE_j5gs "State" UBYTE COMPU_METHOD.uint8 0 0 0.0 255.0 DISPLAY_IDENTIFIER Unit_Delay_DSTATE READ_WRITE ECU_ADDRESS 0x0 /end MEASUREMENT
/begin MEASUREMENT UnitDelay_DSTATE_bw1s "State" UBYTE COMPU_METHOD.uint8 0 0 0.0 255.0 DISPLAY_IDENTIFIER Unit_Delay_DSTATE READ_WRITE ECU_ADDRESS 0x0 /end MEASUREMENT
/begin MEASUREMENT UnitDelay_DSTATE_fdvn "State" UBYTE COMPU_METHOD.uint8 0 0 0.0 255.0 DISPLAY_IDENTIFIER Unit_Delay_DSTATE READ_WRITE ECU_ADDRESS 0x0 /end MEASUREMENT
/begin MEASUREMENT UnitDelay_DSTATE_pigm "State" UBYTE COMPU_METHOD.uint8 0 0 0.0 255.0 DISPLAY_IDENTIFIER Unit_Delay_DSTATE READ_WRITE ECU_ADDRESS 0x0 /end MEASUREMENT
/begin MEASUREMENT UnitDelay_DSTATE_kdv5 "State" UBYTE COMPU_METHOD.uint8 0 0 0.0 255.0 DISPLAY_IDENTIFIER Unit_Delay_DSTATE READ_WRITE ECU_ADDRESS 0x0 /end MEASUREMENT
/begin MEASUREMENT DelayInput1_DSTATE "State" UBYTE COMPU_METHOD.boolean 0 0 0.0 1.0 DISPLAY_IDENTIFIER Delay_Input1_DSTATE READ_WRITE ECU_ADDRESS 0x0 /end MEASUREMENT
/begin MEASUREMENT DelayInput1_DSTATE_prcl "State" UBYTE COMPU_METHOD.boolean 0 0 0.0 1.0 DISPLAY_IDENTIFIER Delay_Input1_DSTATE READ_WRITE ECU_ADDRESS 0x0 /end MEASUREMENT
/begin MEASUREMENT UnitDelay_DSTATE_fett "State" UBYTE COMPU_METHOD.boolean 0 0 0.0 1.0 DISPLAY_IDENTIFIER Unit_Delay_DSTATE READ_WRITE ECU_ADDRESS 0x0 /end MEASUREMENT
/begin MEASUREMENT Delay_DSTATE_obnz "State" UBYTE COMPU_METHOD.boolean 0 0 0.0 1.0 DISPLAY_IDENTIFIER Delay_DSTATE READ_WRITE ECU_ADDRESS 0x0 /end MEASUREMENT
/begin MEASUREMENT UnitDelay_DSTATE_nds1 "State" UBYTE COMPU_METHOD.boolean 0 0 0.0 1.0 DISPLAY_IDENTIFIER Unit_Delay_DSTATE READ_WRITE ECU_ADDRESS 0x0 /end MEASUREMENT
/begin MEASUREMENT DelayInput1_DSTATE_nzby "State" UBYTE COMPU_METHOD.boolean 0 0 0.0 1.0 DISPLAY_IDENTIFIER Delay_Input1_DSTATE READ_WRITE ECU_ADDRESS 0x0 /end MEASUREMENT
/begin MEASUREMENT Memory2_PreviousInput "State" SBYTE COMPU_METHOD.int8 0 0 -128.0 127.0 DISPLAY_IDENTIFIER Memory_2_PreviousInput READ_WRITE ECU_ADDRESS 0x0 /end MEASUREMENT
/begin MEASUREMENT Memory2_PreviousInput_i53e "State" SBYTE COMPU_METHOD.int8 0 0 -128.0 127.0 DISPLAY_IDENTIFIER Memory_2_PreviousInput READ_WRITE ECU_ADDRESS 0x0 /end MEASUREMENT
/begin MEASUREMENT Memory2_PreviousInput_pgwc "State" SBYTE COMPU_METHOD.int8 0 0 -128.0 127.0 DISPLAY_IDENTIFIER Memory_2_PreviousInput READ_WRITE ECU_ADDRESS 0x0 /end MEASUREMENT
/begin MEASUREMENT Memory1_PreviousInput "State" UBYTE COMPU_METHOD.uint8 0 0 0.0 255.0 DISPLAY_IDENTIFIER Memory_1_PreviousInput READ_WRITE ECU_ADDRESS 0x0 /end MEASUREMENT
/begin MEASUREMENT Memory1_PreviousInput_ddl0 "State" UBYTE COMPU_METHOD.uint8 0 0 0.0 255.0 DISPLAY_IDENTIFIER Memory_1_PreviousInput READ_WRITE ECU_ADDRESS 0x0 /end MEASUREMENT
/begin MEASUREMENT Memory1_PreviousInput_gnui "State" UBYTE COMPU_METHOD.uint8 0 0 0.0 255.0 DISPLAY_IDENTIFIER Memory_1_PreviousInput READ_WRITE ECU_ADDRESS 0x0 /end MEASUREMENT
/begin MEASUREMENT icLoad "State" UBYTE COMPU_METHOD.uint8 0 0 0.0 255.0 DISPLAY_IDENTIFIER Resettable_Delay_icLoad READ_WRITE ECU_ADDRESS 0x0 /end MEASUREMENT
/begin MEASUREMENT lastSample_not_empty "State" UBYTE COMPU_METHOD.boolean 0 0 0.0 1.0 DISPLAY_IDENTIFIER MATLAB_Function_DWORK2 READ_WRITE ECU_ADDRESS 0x0 /end MEASUREMENT
/begin MEASUREMENT lastSample_not_empty_m4ln "State" UBYTE COMPU_METHOD.boolean 0 0 0.0 1.0 DISPLAY_IDENTIFIER MATLAB_Function_DWORK2 READ_WRITE ECU_ADDRESS 0x0 /end MEASUREMENT
/begin MEASUREMENT lastMeanEst "State" FLOAT32_IEEE COMPU_METHOD.single 0 0 -3.4028234663852886E+38 3.4028234663852886E+38 DISPLAY_IDENTIFIER MATLAB_Function_DWORK1 READ_WRITE ECU_ADDRESS 0x0 /end MEASUREMENT
/begin MEASUREMENT lastVarianceEst "State" FLOAT32_IEEE COMPU_METHOD.single 0 0 -3.4028234663852886E+38 3.4028234663852886E+38 DISPLAY_IDENTIFIER MATLAB_Function_DWORK3 READ_WRITE ECU_ADDRESS 0x0 /end MEASUREMENT
/begin MEASUREMENT lastMeanEst_not_empty "State" UBYTE COMPU_METHOD.boolean 0 0 0.0 1.0 DISPLAY_IDENTIFIER MATLAB_Function_DWORK2 READ_WRITE ECU_ADDRESS 0x0 /end MEASUREMENT
/begin MEASUREMENT lastMeanEst0 "State" FLOAT32_IEEE COMPU_METHOD.single 0 0 -3.4028234663852886E+38 3.4028234663852886E+38 DISPLAY_IDENTIFIER MATLAB_Function_DWORK1 READ_WRITE ECU_ADDRESS 0x0 /end MEASUREMENT
/begin MEASUREMENT lastVarianceEst0 "State" FLOAT32_IEEE COMPU_METHOD.single 0 0 -3.4028234663852886E+38 3.4028234663852886E+38 DISPLAY_IDENTIFIER MATLAB_Function_DWORK3 READ_WRITE ECU_ADDRESS 0x0 /end MEASUREMENT
/begin MEASUREMENT lastMeanEst_not_empty0 "State" UBYTE COMPU_METHOD.boolean 0 0 0.0 1.0 DISPLAY_IDENTIFIER MATLAB_Function_DWORK2 READ_WRITE ECU_ADDRESS 0x0 /end MEASUREMENT
/begin MEASUREMENT rawHist "State" FLOAT32_IEEE COMPU_METHOD.single 0 0 -3.4028234663852886E+38 3.4028234663852886E+38 DISPLAY_IDENTIFIER Filter_DWORK2 MATRIX_DIM 1 3 1 LAYOUT COLUMN_DIR READ_WRITE ECU_ADDRESS 0x0 /end MEASUREMENT
/begin MEASUREMENT filtHist "State" FLOAT32_IEEE COMPU_METHOD.single 0 0 -3.4028234663852886E+38 3.4028234663852886E+38 DISPLAY_IDENTIFIER Filter_DWORK3 MATRIX_DIM 1 3 1 LAYOUT COLUMN_DIR READ_WRITE ECU_ADDRESS 0x0 /end MEASUREMENT
/begin MEASUREMENT alpha "State" FLOAT32_IEEE COMPU_METHOD.single 0 0 -3.4028234663852886E+38 3.4028234663852886E+38 DISPLAY_IDENTIFIER Filter_DWORK4 READ_WRITE ECU_ADDRESS 0x0 /end MEASUREMENT
/begin MEASUREMENT beta "State" FLOAT32_IEEE COMPU_METHOD.single 0 0 -3.4028234663852886E+38 3.4028234663852886E+38 DISPLAY_IDENTIFIER Filter_DWORK5 READ_WRITE ECU_ADDRESS 0x0 /end MEASUREMENT
/begin MEASUREMENT gamma "State" FLOAT32_IEEE COMPU_METHOD.single 0 0 -3.4028234663852886E+38 3.4028234663852886E+38 DISPLAY_IDENTIFIER Filter_DWORK6 READ_WRITE ECU_ADDRESS 0x0 /end MEASUREMENT
/begin MEASUREMENT is_active_c24_tip_assist_lib_support "State" UBYTE COMPU_METHOD.uint8 0 0 0.0 255.0 DISPLAY_IDENTIFIER Filter_DWORK1 READ_WRITE ECU_ADDRESS 0x0 /end MEASUREMENT
/begin MEASUREMENT rawHist0 "State" FLOAT32_IEEE COMPU_METHOD.single 0 0 -3.4028234663852886E+38 3.4028234663852886E+38 DISPLAY_IDENTIFIER Filter_DWORK2 MATRIX_DIM 1 3 1 LAYOUT COLUMN_DIR READ_WRITE ECU_ADDRESS 0x0 /end MEASUREMENT
/begin MEASUREMENT filtHist0 "State" FLOAT32_IEEE COMPU_METHOD.single 0 0 -3.4028234663852886E+38 3.4028234663852886E+38 DISPLAY_IDENTIFIER Filter_DWORK3 MATRIX_DIM 1 3 1 LAYOUT COLUMN_DIR READ_WRITE ECU_ADDRESS 0x0 /end MEASUREMENT
/begin MEASUREMENT alpha0 "State" FLOAT32_IEEE COMPU_METHOD.single 0 0 -3.4028234663852886E+38 3.4028234663852886E+38 DISPLAY_IDENTIFIER Filter_DWORK4 READ_WRITE ECU_ADDRESS 0x0 /end MEASUREMENT
/begin MEASUREMENT beta0 "State" FLOAT32_IEEE COMPU_METHOD.single 0 0 -3.4028234663852886E+38 3.4028234663852886E+38 DISPLAY_IDENTIFIER Filter_DWORK5 READ_WRITE ECU_ADDRESS 0x0 /end MEASUREMENT
/begin MEASUREMENT gamma0 "State" FLOAT32_IEEE COMPU_METHOD.single 0 0 -3.4028234663852886E+38 3.4028234663852886E+38 DISPLAY_IDENTIFIER Filter_DWORK6 READ_WRITE ECU_ADDRESS 0x0 /end MEASUREMENT
/begin MEASUREMENT is_active_c24_tip_assist_lib_su0 "State" UBYTE COMPU_METHOD.uint8 0 0 0.0 255.0 DISPLAY_IDENTIFIER Filter_DWORK1 READ_WRITE ECU_ADDRESS 0x0 /end MEASUREMENT
/begin MEASUREMENT rawHist1 "State" FLOAT32_IEEE COMPU_METHOD.single 0 0 -3.4028234663852886E+38 3.4028234663852886E+38 DISPLAY_IDENTIFIER Filter_DWORK2 MATRIX_DIM 1 3 1 LAYOUT COLUMN_DIR READ_WRITE ECU_ADDRESS 0x0 /end MEASUREMENT
/begin MEASUREMENT filtHist1 "State" FLOAT32_IEEE COMPU_METHOD.single 0 0 -3.4028234663852886E+38 3.4028234663852886E+38 DISPLAY_IDENTIFIER Filter_DWORK3 MATRIX_DIM 1 3 1 LAYOUT COLUMN_DIR READ_WRITE ECU_ADDRESS 0x0 /end MEASUREMENT
/begin MEASUREMENT alpha1 "State" FLOAT32_IEEE COMPU_METHOD.single 0 0 -3.4028234663852886E+38 3.4028234663852886E+38 DISPLAY_IDENTIFIER Filter_DWORK4 READ_WRITE ECU_ADDRESS 0x0 /end MEASUREMENT
/begin MEASUREMENT beta1 "State" FLOAT32_IEEE COMPU_METHOD.single 0 0 -3.4028234663852886E+38 3.4028234663852886E+38 DISPLAY_IDENTIFIER Filter_DWORK5 READ_WRITE ECU_ADDRESS 0x0 /end MEASUREMENT
/begin MEASUREMENT gamma1 "State" FLOAT32_IEEE COMPU_METHOD.single 0 0 -3.4028234663852886E+38 3.4028234663852886E+38 DISPLAY_IDENTIFIER Filter_DWORK6 READ_WRITE ECU_ADDRESS 0x0 /end MEASUREMENT
/begin MEASUREMENT is_active_c24_tip_assist_lib_su1 "State" UBYTE COMPU_METHOD.uint8 0 0 0.0 255.0 DISPLAY_IDENTIFIER Filter_DWORK1 READ_WRITE ECU_ADDRESS 0x0 /end MEASUREMENT
/begin MEASUREMENT rawHist2 "State" FLOAT32_IEEE COMPU_METHOD.single 0 0 -3.4028234663852886E+38 3.4028234663852886E+38 DISPLAY_IDENTIFIER Filter_DWORK2 MATRIX_DIM 1 3 1 LAYOUT COLUMN_DIR READ_WRITE ECU_ADDRESS 0x0 /end MEASUREMENT
/begin MEASUREMENT filtHist2 "State" FLOAT32_IEEE COMPU_METHOD.single 0 0 -3.4028234663852886E+38 3.4028234663852886E+38 DISPLAY_IDENTIFIER Filter_DWORK3 MATRIX_DIM 1 3 1 LAYOUT COLUMN_DIR READ_WRITE ECU_ADDRESS 0x0 /end MEASUREMENT
/begin MEASUREMENT alpha2 "State" FLOAT32_IEEE COMPU_METHOD.single 0 0 -3.4028234663852886E+38 3.4028234663852886E+38 DISPLAY_IDENTIFIER Filter_DWORK4 READ_WRITE ECU_ADDRESS 0x0 /end MEASUREMENT
/begin MEASUREMENT beta2 "State" FLOAT32_IEEE COMPU_METHOD.single 0 0 -3.4028234663852886E+38 3.4028234663852886E+38 DISPLAY_IDENTIFIER Filter_DWORK5 READ_WRITE ECU_ADDRESS 0x0 /end MEASUREMENT
/begin MEASUREMENT gamma2 "State" FLOAT32_IEEE COMPU_METHOD.single 0 0 -3.4028234663852886E+38 3.4028234663852886E+38 DISPLAY_IDENTIFIER Filter_DWORK6 READ_WRITE ECU_ADDRESS 0x0 /end MEASUREMENT
/begin MEASUREMENT is_active_c24_tip_assist_lib_su2 "State" UBYTE COMPU_METHOD.uint8 0 0 0.0 255.0 DISPLAY_IDENTIFIER Filter_DWORK1 READ_WRITE ECU_ADDRESS 0x0 /end MEASUREMENT
/begin MEASUREMENT rawHist3 "State" FLOAT32_IEEE COMPU_METHOD.single 0 0 -3.4028234663852886E+38 3.4028234663852886E+38 DISPLAY_IDENTIFIER Filter_DWORK2 MATRIX_DIM 1 3 1 LAYOUT COLUMN_DIR READ_WRITE ECU_ADDRESS 0x0 /end MEASUREMENT
/begin MEASUREMENT filtHist3 "State" FLOAT32_IEEE COMPU_METHOD.single 0 0 -3.4028234663852886E+38 3.4028234663852886E+38 DISPLAY_IDENTIFIER Filter_DWORK3 MATRIX_DIM 1 3 1 LAYOUT COLUMN_DIR READ_WRITE ECU_ADDRESS 0x0 /end MEASUREMENT
/begin MEASUREMENT alpha3 "State" FLOAT32_IEEE COMPU_METHOD.single 0 0 -3.4028234663852886E+38 3.4028234663852886E+38 DISPLAY_IDENTIFIER Filter_DWORK4 READ_WRITE ECU_ADDRESS 0x0 /end MEASUREMENT
/begin MEASUREMENT beta3 "State" FLOAT32_IEEE COMPU_METHOD.single 0 0 -3.4028234663852886E+38 3.4028234663852886E+38 DISPLAY_IDENTIFIER Filter_DWORK5 READ_WRITE ECU_ADDRESS 0x0 /end MEASUREMENT
/begin MEASUREMENT gamma3 "State" FLOAT32_IEEE COMPU_METHOD.single 0 0 -3.4028234663852886E+38 3.4028234663852886E+38 DISPLAY_IDENTIFIER Filter_DWORK6 READ_WRITE ECU_ADDRESS 0x0 /end MEASUREMENT
/begin MEASUREMENT is_active_c24_tip_assist_lib_su3 "State" UBYTE COMPU_METHOD.uint8 0 0 0.0 255.0 DISPLAY_IDENTIFIER Filter_DWORK1 READ_WRITE ECU_ADDRESS 0x0 /end MEASUREMENT
/begin MEASUREMENT rawHist4 "State" FLOAT32_IEEE COMPU_METHOD.single 0 0 -3.4028234663852886E+38 3.4028234663852886E+38 DISPLAY_IDENTIFIER Filter_DWORK2 MATRIX_DIM 1 3 1 LAYOUT COLUMN_DIR READ_WRITE ECU_ADDRESS 0x0 /end MEASUREMENT
/begin MEASUREMENT filtHist4 "State" FLOAT32_IEEE COMPU_METHOD.single 0 0 -3.4028234663852886E+38 3.4028234663852886E+38 DISPLAY_IDENTIFIER Filter_DWORK3 MATRIX_DIM 1 3 1 LAYOUT COLUMN_DIR READ_WRITE ECU_ADDRESS 0x0 /end MEASUREMENT
/begin MEASUREMENT alpha4 "State" FLOAT32_IEEE COMPU_METHOD.single 0 0 -3.4028234663852886E+38 3.4028234663852886E+38 DISPLAY_IDENTIFIER Filter_DWORK4 READ_WRITE ECU_ADDRESS 0x0 /end MEASUREMENT
/begin MEASUREMENT beta4 "State" FLOAT32_IEEE COMPU_METHOD.single 0 0 -3.4028234663852886E+38 3.4028234663852886E+38 DISPLAY_IDENTIFIER Filter_DWORK5 READ_WRITE ECU_ADDRESS 0x0 /end MEASUREMENT
/begin MEASUREMENT gamma4 "State" FLOAT32_IEEE COMPU_METHOD.single 0 0 -3.4028234663852886E+38 3.4028234663852886E+38 DISPLAY_IDENTIFIER Filter_DWORK6 READ_WRITE ECU_ADDRESS 0x0 /end MEASUREMENT
/begin MEASUREMENT is_active_c24_tip_assist_lib_su4 "State" UBYTE COMPU_METHOD.uint8 0 0 0.0 255.0 DISPLAY_IDENTIFIER Filter_DWORK1 READ_WRITE ECU_ADDRESS 0x0 /end MEASUREMENT
/begin MEASUREMENT rawHist5 "State" FLOAT32_IEEE COMPU_METHOD.single 0 0 -3.4028234663852886E+38 3.4028234663852886E+38 DISPLAY_IDENTIFIER Filter_DWORK2 MATRIX_DIM 1 3 1 LAYOUT COLUMN_DIR READ_WRITE ECU_ADDRESS 0x0 /end MEASUREMENT
/begin MEASUREMENT filtHist5 "State" FLOAT32_IEEE COMPU_METHOD.single 0 0 -3.4028234663852886E+38 3.4028234663852886E+38 DISPLAY_IDENTIFIER Filter_DWORK3 MATRIX_DIM 1 3 1 LAYOUT COLUMN_DIR READ_WRITE ECU_ADDRESS 0x0 /end MEASUREMENT
/begin MEASUREMENT alpha5 "State" FLOAT32_IEEE COMPU_METHOD.single 0 0 -3.4028234663852886E+38 3.4028234663852886E+38 DISPLAY_IDENTIFIER Filter_DWORK4 READ_WRITE ECU_ADDRESS 0x0 /end MEASUREMENT
/begin MEASUREMENT beta5 "State" FLOAT32_IEEE COMPU_METHOD.single 0 0 -3.4028234663852886E+38 3.4028234663852886E+38 DISPLAY_IDENTIFIER Filter_DWORK5 READ_WRITE ECU_ADDRESS 0x0 /end MEASUREMENT
/begin MEASUREMENT gamma5 "State" FLOAT32_IEEE COMPU_METHOD.single 0 0 -3.4028234663852886E+38 3.4028234663852886E+38 DISPLAY_IDENTIFIER Filter_DWORK6 READ_WRITE ECU_ADDRESS 0x0 /end MEASUREMENT
/begin MEASUREMENT is_active_c24_tip_assist_lib_su5 "State" UBYTE COMPU_METHOD.uint8 0 0 0.0 255.0 DISPLAY_IDENTIFIER Filter_DWORK1 READ_WRITE ECU_ADDRESS 0x0 /end MEASUREMENT
/begin MEASUREMENT rawHist6 "State" FLOAT32_IEEE COMPU_METHOD.single 0 0 -3.4028234663852886E+38 3.4028234663852886E+38 DISPLAY_IDENTIFIER Filter_DWORK2 MATRIX_DIM 1 3 1 LAYOUT COLUMN_DIR READ_WRITE ECU_ADDRESS 0x0 /end MEASUREMENT
/begin MEASUREMENT filtHist6 "State" FLOAT32_IEEE COMPU_METHOD.single 0 0 -3.4028234663852886E+38 3.4028234663852886E+38 DISPLAY_IDENTIFIER Filter_DWORK3 MATRIX_DIM 1 3 1 LAYOUT COLUMN_DIR READ_WRITE ECU_ADDRESS 0x0 /end MEASUREMENT
/begin MEASUREMENT alpha6 "State" FLOAT32_IEEE COMPU_METHOD.single 0 0 -3.4028234663852886E+38 3.4028234663852886E+38 DISPLAY_IDENTIFIER Filter_DWORK4 READ_WRITE ECU_ADDRESS 0x0 /end MEASUREMENT
/begin MEASUREMENT beta6 "State" FLOAT32_IEEE COMPU_METHOD.single 0 0 -3.4028234663852886E+38 3.4028234663852886E+38 DISPLAY_IDENTIFIER Filter_DWORK5 READ_WRITE ECU_ADDRESS 0x0 /end MEASUREMENT
/begin MEASUREMENT gamma6 "State" FLOAT32_IEEE COMPU_METHOD.single 0 0 -3.4028234663852886E+38 3.4028234663852886E+38 DISPLAY_IDENTIFIER Filter_DWORK6 READ_WRITE ECU_ADDRESS 0x0 /end MEASUREMENT
/begin MEASUREMENT is_active_c24_tip_assist_lib_su6 "State" UBYTE COMPU_METHOD.uint8 0 0 0.0 255.0 DISPLAY_IDENTIFIER Filter_DWORK1 READ_WRITE ECU_ADDRESS 0x0 /end MEASUREMENT
/begin MEASUREMENT rawHist7 "State" FLOAT32_IEEE COMPU_METHOD.single 0 0 -3.4028234663852886E+38 3.4028234663852886E+38 DISPLAY_IDENTIFIER Filter_DWORK2 MATRIX_DIM 1 3 1 LAYOUT COLUMN_DIR READ_WRITE ECU_ADDRESS 0x0 /end MEASUREMENT
/begin MEASUREMENT filtHist7 "State" FLOAT32_IEEE COMPU_METHOD.single 0 0 -3.4028234663852886E+38 3.4028234663852886E+38 DISPLAY_IDENTIFIER Filter_DWORK3 MATRIX_DIM 1 3 1 LAYOUT COLUMN_DIR READ_WRITE ECU_ADDRESS 0x0 /end MEASUREMENT
/begin MEASUREMENT alpha7 "State" FLOAT32_IEEE COMPU_METHOD.single 0 0 -3.4028234663852886E+38 3.4028234663852886E+38 DISPLAY_IDENTIFIER Filter_DWORK4 READ_WRITE ECU_ADDRESS 0x0 /end MEASUREMENT
/begin MEASUREMENT beta7 "State" FLOAT32_IEEE COMPU_METHOD.single 0 0 -3.4028234663852886E+38 3.4028234663852886E+38 DISPLAY_IDENTIFIER Filter_DWORK5 READ_WRITE ECU_ADDRESS 0x0 /end MEASUREMENT
/begin MEASUREMENT gamma7 "State" FLOAT32_IEEE COMPU_METHOD.single 0 0 -3.4028234663852886E+38 3.4028234663852886E+38 DISPLAY_IDENTIFIER Filter_DWORK6 READ_WRITE ECU_ADDRESS 0x0 /end MEASUREMENT
/begin MEASUREMENT is_active_c24_tip_assist_lib_su7 "State" UBYTE COMPU_METHOD.uint8 0 0 0.0 255.0 DISPLAY_IDENTIFIER Filter_DWORK1 READ_WRITE ECU_ADDRESS 0x0 /end MEASUREMENT
/begin CHARACTERISTIC toa_liftBoreDia "Block parameter: toa_liftBoreDia Execution rates:  [0.02] secs" VALUE 0x0 RL_CHAR_COLUMN_FLOAT32_IEEE 0 COMPU_METHOD.single -3.4028234663852886E+38 3.4028234663852886E+38 /end CHARACTERISTIC
/begin CHARACTERISTIC toa_liftRodDia "Block parameter: toa_liftRodDia Execution rates:  [0.02] secs" VALUE 0x0 RL_CHAR_COLUMN_FLOAT32_IEEE 0 COMPU_METHOD.single -3.4028234663852886E+38 3.4028234663852886E+38 /end CHARACTERISTIC
/begin CHARACTERISTIC toa_ratedPayload "Block parameter: toa_ratedPayload Execution rates:  [0.02] secs" VALUE 0x0 RL_CHAR_COLUMN_FLOAT32_IEEE 0 COMPU_METHOD.single -3.4028234663852886E+38 3.4028234663852886E+38 /end CHARACTERISTIC
/begin CHARACTERISTIC toa_tiltBoreDia "Block parameter: toa_tiltBoreDia Execution rates:  [0.02] secs" VALUE 0x0 RL_CHAR_COLUMN_FLOAT32_IEEE 0 COMPU_METHOD.single -3.4028234663852886E+38 3.4028234663852886E+38 /end CHARACTERISTIC
/begin CHARACTERISTIC toa_tiltRodDia "Block parameter: toa_tiltRodDia Execution rates:  [0.02] secs" VALUE 0x0 RL_CHAR_COLUMN_FLOAT32_IEEE 0 COMPU_METHOD.single -3.4028234663852886E+38 3.4028234663852886E+38 /end CHARACTERISTIC
/begin CHARACTERISTIC toa_toolBcAngle "Block parameter: toa_toolBcAngle Execution rates:  [0.02] secs" VALUE 0x0 RL_CHAR_COLUMN_FLOAT32_IEEE 0 COMPU_METHOD.single -3.4028234663852886E+38 3.4028234663852886E+38 /end CHARACTERISTIC
/begin CHARACTERISTIC toa_toolBcLength "Block parameter: toa_toolBcLength Execution rates:  [0.02] secs" VALUE 0x0 RL_CHAR_COLUMN_FLOAT32_IEEE 0 COMPU_METHOD.single -3.4028234663852886E+38 3.4028234663852886E+38 /end CHARACTERISTIC
/begin CHARACTERISTIC toa_appNumber "Block parameter: toa_appNumber Execution rates:  [0.02] secs" VALUE 0x0 RL_CHAR_COLUMN_ULONG 0 COMPU_METHOD.uint32 0.0 4.294967295E+9 /end CHARACTERISTIC
/begin CHARACTERISTIC toa_tiltNumCyl "Block parameter: toa_tiltNumCyl Execution rates:  [0.02] secs" VALUE 0x0 RL_CHAR_COLUMN_UBYTE 0 COMPU_METHOD.uint8 0.0 255.0 /end CHARACTERISTIC
/*
* Define custom COMPU_METHODs
*/
/begin COMPU_METHOD COMPU_METHOD.double "FLOAT64_IEEE" RAT_FUNC "%0.15" "" COEFFS 0 1 0 0 0 1 /end COMPU_METHOD
/begin COMPU_METHOD COMPU_METHOD.single "FLOAT32_IEEE" RAT_FUNC "%0.15" "" COEFFS 0 1 0 0 0 1 /end COMPU_METHOD
/begin COMPU_METHOD COMPU_METHOD.TipAssistSecPfwStatus_t "UBYTE" TAB_VERB "%0.0" "" COMPU_TAB_REF COMPU_METHOD.TipAssistSecPfwStatus_t /end COMPU_METHOD
/begin COMPU_VTAB COMPU_METHOD.TipAssistSecPfwStatus_t "UBYTE" TAB_VERB 5 0 "Invalid" 1 "Valid-Measuring" 2 "Pending" 3 "Fault" /* Text Entry 4 */ 4 "Valid-Not Measuring" DEFAULT_VALUE "" /end COMPU_VTAB
/begin COMPU_METHOD COMPU_METHOD.TipAssistLiveWeighStatus_t "UBYTE" TAB_VERB "%0.0" "" COMPU_TAB_REF COMPU_METHOD.TipAssistLiveWeighStatus_t /end COMPU_METHOD
/begin COMPU_VTAB COMPU_METHOD.TipAssistLiveWeighStatus_t "UBYTE" TAB_VERB 2 0 "Valid" 1 "Fault" DEFAULT_VALUE "" /end COMPU_VTAB
/begin COMPU_METHOD COMPU_METHOD.TipAssistUnsecPfwStatus_t "UBYTE" TAB_VERB "%0.0" "" COMPU_TAB_REF COMPU_METHOD.TipAssistUnsecPfwStatus_t /end COMPU_METHOD
/begin COMPU_VTAB COMPU_METHOD.TipAssistUnsecPfwStatus_t "UBYTE" TAB_VERB 4 0 "Invalid" 1 "Valid" 2 "Pending" 3 "Fault" DEFAULT_VALUE "" /end COMPU_VTAB
/begin COMPU_METHOD COMPU_METHOD.TipAssistAdvEcmError_t "UBYTE" TAB_VERB "%0.0" "" COMPU_TAB_REF COMPU_METHOD.TipAssistAdvEcmError_t /end COMPU_METHOD
/begin COMPU_VTAB COMPU_METHOD.TipAssistAdvEcmError_t "UBYTE" TAB_VERB 5 0 "No Error" 1 "Tip-Off Mode Not Pile" 2 "Truck Target Weight Not Set" 3 "Payload Not Achievable" /* Text Entry 4 */ 4 "Fault" DEFAULT_VALUE "" /end COMPU_VTAB
/begin COMPU_METHOD COMPU_METHOD.TipAssistPayloadType_t "UWORD" TAB_VERB "%0.0" "" COMPU_TAB_REF COMPU_METHOD.TipAssistPayloadType_t /end COMPU_METHOD
/begin COMPU_VTAB COMPU_METHOD.TipAssistPayloadType_t "UWORD" TAB_VERB 2 0 "Live" 1 "Pseudo-Frictionless" DEFAULT_VALUE "" /end COMPU_VTAB
/begin COMPU_METHOD COMPU_METHOD.TipAssistSendCpmStatus_t "UBYTE" TAB_VERB "%0.0" "" COMPU_TAB_REF COMPU_METHOD.TipAssistSendCpmStatus_t /end COMPU_METHOD
/begin COMPU_VTAB COMPU_METHOD.TipAssistSendCpmStatus_t "UBYTE" TAB_VERB 3 0 "Invalid" 1 "Live" 2 "Pseudo-Frictionless" DEFAULT_VALUE "" /end COMPU_VTAB
/begin COMPU_METHOD COMPU_METHOD.uint8_t "UBYTE" RAT_FUNC "%0.0" "" COEFFS 0 1 0 0 0 1 /end COMPU_METHOD
/begin COMPU_METHOD COMPU_METHOD.boolean "UBYTE" TAB_VERB "%0.0" "" COMPU_TAB_REF COMPU_METHOD.boolean /end COMPU_METHOD
/begin COMPU_VTAB COMPU_METHOD.boolean "UBYTE" TAB_VERB 2 0 "FALSE" 1 "TRUE" DEFAULT_VALUE "" /end COMPU_VTAB
/begin COMPU_METHOD COMPU_METHOD.ufix16_Sp02 "UWORD" RAT_FUNC "%0.3" "" COEFFS 0 50 0 0 0 1 /* INT = (0*PHYS^2 + 50*PHYS + 0)/(0*PHYS^2 + 0*PHYS + 1) */ /end COMPU_METHOD
/begin COMPU_METHOD COMPU_METHOD.uint8 "UBYTE" RAT_FUNC "%0.0" "" COEFFS 0 1 0 0 0 1 /end COMPU_METHOD
/begin COMPU_METHOD COMPU_METHOD.int8 "SBYTE" RAT_FUNC "%0.0" "" COEFFS 0 1 0 0 0 1 /end COMPU_METHOD
/begin COMPU_METHOD COMPU_METHOD.uint32 "ULONG" RAT_FUNC "%0.0" "" COEFFS 0 1 0 0 0 1 /end COMPU_METHOD
/begin GROUP Listing "Listing of all calibration objects" ROOT /begin SUB_GROUP Signals States Parameters Maps /end SUB_GROUP /end GROUP
/begin GROUP Signals "Listing of all global signals"
 /begin REF_MEASUREMENT toa_sfuncInRawTiltForce toa_sfuncInRawLiftForce toa_sfuncInRawTiltExt toa_sfuncInRawLiftAng toa_sfuncInRawBcLength toa_sfuncInRawGravX toa_sfuncInRawGravY toa_sfuncOutRawMass toa_imuNeefPitch toa_sfuncOutRawDist toa_targetCompMargin toa_targetPayloadPostComp toa_grav_angles toa_inTsTiltExt toa_inTsLiftAngle toa_inTsBc toa_inTsBcAng toa_tiltSensitivity toa_outTiltSensToBucket toa_outTiltHePress toa_tiltForce toa_sfuncInTiltForce toa_fcLiftForceRaw toa_fcLiftForceComp toa_liftForce toa_sfuncInLiftForce toa_sfuncInTiltExt toa_sfuncInLiftAng toa_sfuncInBcLength toa_inImuAcclX toa_inImuAcclY toa_inImuAcclZ toa_imu_eef_accl_vec_post_lpf toa_sfuncInGravX toa_sfuncInGravY toa_sfuncOutRawMassTonne toa_rawPayload toa_payloadAncZeroed toa_payloadAncAdjusted toa_payloadZeroed toa_payloadAdjusted toa_pfwPayloadNotchPost toa_pfwPayloadNotchFiltFinal toa_pfwSecPayload toa_lwLpfPost toa_sendPayloadArb toa_targetPayloadPreComp toa_targetPayloadFinal toa_outPayloadArbNormError toa_pfwSecStDev toa_outPfwPayloadNormStdev toa_outCpmPayloadNormError toa_lwSpillRate toa_outSpillRateNorm toa_outBucketPayloadTarget toa_statPayloadSecureTwoSize toa_sendCpmPfwSecSize toa_sendCpmLivePayload toa_outSendCpmPayload toa_pfwNlNotchStDevEst toa_pfwNlNotchMeanEst toa_pfwUnsecBoundUpper toa_outUnsecPayloadNormUp toa_pfwUnsecBoundLower toa_outUnsecPayloadNormLow toa_pfwSecMinBucketAng toa_outMinSecBucketAng toa_imuRawEefAcclX toa_imuRawEefAcclY toa_imuRawEefAcclZ toa_imuNeefGravX toa_imuNeefGravY toa_imuNeefGravZ toa_grav_neef_xy_mag toa_rawDist toa_statPayloadSecureTwoLower toa_statPayloadNlNotchOneUp toa_statPayloadNlNotchOneSize toa_statPayloadNlNotchTwoUp toa_statPayloadNlNotchTwoSize toa_statPayloadNlNotchTwoLow toa_pfwPayloadFiltFinal toa_pfwNlStDevEst toa_pfwNlMeanEst toa_statPayloadNlOneUp toa_statPayloadNlOneSize toa_statPayloadNlTwoUp toa_statPayloadNlTwoSize toa_statPayloadNlTwoLow toa_statPayloadNlOneLow toa_statPayloadSecureOneUpper toa_statPayloadSecureOneLower toa_statPayloadSecureOneSize toa_statPayloadSecureTwoUpper toa_statPayloadNlNotchOneLow toa_grav_rotMatrix toa_grav_rotAxis toa_grav_angle toa_imu_neef_accl_vec toa_pfwSecStatus toa_outPfwStat toa_lwStatus toa_pfwUnsecStatus toa_outUnsecPayloadStatus toa_outAdvErrorCode toa_sendPayloadType toa_outSendCpmStatus toa_outCpmAccu toa_pfwSecIsNoSliding toa_pfwSecIsNoCollapsing toa_pfwSecIsRacked toa_pfwLatchInvalidate toa_pfwMcMaybeRackStall toa_pfwMcMaybeStalled toa_pfwMcMaybeGrounded toa_isLiftValveCmd toa_isTiltValveCmd toa_is_not_tilt_valve_cmd toa_tilt_timer_expired toa_tilt_timer_not_expired toa_pfwMcOk toa_pfwIsWarm toa_pfwSecIsSecure toa_pfwSecLatch toa_targetPayloadStatus toa_sendCpmPfwIsPrecise UnitDelay1_DSTATE UnitDelay1_DSTATE_mga0 Delay2_DSTATE UnitDelay_DSTATE UnitDelay1_DSTATE_fp5d Delay_DSTATE UnitDelay_DSTATE_hioq UnitDelay1_DSTATE_bcfn UnitDelay_DSTATE_jlpe ResettableDelay_DSTATE UnitDelay1_DSTATE_bo33 UnitDelay1_DSTATE_e2d2 lastSample lastSample_kln4 Timer_DSTATE Timer_DSTATE_dme3 Timer_DSTATE_jrr0 UnitDelay_DSTATE_mvg5 UnitDelay_DSTATE_j5gs UnitDelay_DSTATE_bw1s UnitDelay_DSTATE_fdvn UnitDelay_DSTATE_pigm UnitDelay_DSTATE_kdv5 DelayInput1_DSTATE DelayInput1_DSTATE_prcl UnitDelay_DSTATE_fett Delay_DSTATE_obnz UnitDelay_DSTATE_nds1 DelayInput1_DSTATE_nzby Memory2_PreviousInput Memory2_PreviousInput_i53e Memory2_PreviousInput_pgwc Memory1_PreviousInput Memory1_PreviousInput_ddl0 Memory1_PreviousInput_gnui icLoad lastSample_not_empty lastSample_not_empty_m4ln lastMeanEst lastVarianceEst lastMeanEst_not_empty lastMeanEst0 lastVarianceEst0 lastMeanEst_not_empty0 rawHist filtHist alpha beta gamma is_active_c24_tip_assist_lib_support rawHist0 filtHist0 alpha0 beta0 gamma0 is_active_c24_tip_assist_lib_su0 rawHist1 filtHist1 alpha1 beta1 gamma1 is_active_c24_tip_assist_lib_su1 rawHist2 filtHist2 alpha2 beta2 gamma2 is_active_c24_tip_assist_lib_su2 rawHist3 filtHist3 alpha3 beta3 gamma3 is_active_c24_tip_assist_lib_su3 rawHist4 filtHist4 alpha4 beta4 gamma4 is_active_c24_tip_assist_lib_su4 rawHist5 filtHist5 alpha5 beta5 gamma5 is_active_c24_tip_assist_lib_su5 rawHist6 filtHist6 alpha6 beta6 gamma6 is_active_c24_tip_assist_lib_su6 rawHist7 filtHist7 alpha7 beta7 gamma7 is_active_c24_tip_assist_lib_su7 /end REF_MEASUREMENT
/end GROUP
/begin GROUP States "Listing of all block states" /end GROUP
/begin GROUP Parameters "Listing of all parameters"
 /begin REF_CHARACTERISTIC toa_liftBoreDia toa_liftRodDia toa_ratedPayload toa_tiltBoreDia toa_tiltRodDia toa_toolBcAngle toa_toolBcLength toa_appNumber toa_tiltNumCyl /end REF_CHARACTERISTIC
/end GROUP
/begin GROUP Maps "Listing of all maps" /begin SUB_GROUP Axes /end SUB_GROUP /end GROUP
/begin GROUP Axes "Listing of all map axes" /end GROUP
/begin GROUP Enable_Condition_ "Calibration Objects for Subsystem: hilite_system('<S268>/Enable Condition')" /end GROUP
/begin GROUP Decrement_Timer_ "Calibration Objects for Subsystem: hilite_system('<S268>/Decrement Timer')" /end GROUP
/begin GROUP Compare_To_Zero3_ "Calibration Objects for Subsystem: hilite_system('<S268>/Compare To Zero3')" /end GROUP
/begin GROUP Compare_To_Zero_ "Calibration Objects for Subsystem: hilite_system('<S268>/Compare To Zero')" /begin REF_MEASUREMENT toa_tilt_timer_expired /end REF_MEASUREMENT /end GROUP
/begin GROUP Enable_Condition_0 "Calibration Objects for Subsystem: hilite_system('<S267>/Enable Condition')" /end GROUP
/begin GROUP Decrement_Timer_0 "Calibration Objects for Subsystem: hilite_system('<S267>/Decrement Timer')" /end GROUP
/begin GROUP Compare_To_Zero3_0 "Calibration Objects for Subsystem: hilite_system('<S267>/Compare To Zero3')" /end GROUP
/begin GROUP Compare_To_Zero_0 "Calibration Objects for Subsystem: hilite_system('<S267>/Compare To Zero')" /end GROUP
/begin GROUP Unit_Delay_External_IC_ "Calibration Objects for Subsystem: hilite_system('<S282>/Unit Delay External IC')" /begin REF_MEASUREMENT Memory2_PreviousInput Memory1_PreviousInput /end REF_MEASUREMENT /end GROUP
/begin GROUP Unit_Delay_External_IC_0 "Calibration Objects for Subsystem: hilite_system('<S277>/Unit Delay External IC')" /begin REF_MEASUREMENT Memory2_PreviousInput_pgwc Memory1_PreviousInput_gnui /end REF_MEASUREMENT /end GROUP
/begin GROUP Tilt_expired__ "Calibration Objects for Subsystem: hilite_system('<S260>/Tilt expired?')" /begin REF_MEASUREMENT Timer_DSTATE_dme3 /end REF_MEASUREMENT
 /begin SUB_GROUP Enable_Condition_ Decrement_Timer_ Compare_To_Zero3_ Compare_To_Zero_ /end SUB_GROUP
/end GROUP
/begin GROUP Lift_expired__ "Calibration Objects for Subsystem: hilite_system('<S260>/Lift expired?')" /begin REF_MEASUREMENT Timer_DSTATE /end REF_MEASUREMENT
 /begin SUB_GROUP Enable_Condition_0 Decrement_Timer_0 Compare_To_Zero3_0 Compare_To_Zero_0 /end SUB_GROUP
/end GROUP
/begin GROUP Valve_command_history_proves_not_rack_stalled_resets_to_false__ "Calibration Objects for Subsystem: hilite_system('<S259>/Valve command history proves not rack stalled (resets to false)')" /begin REF_MEASUREMENT UnitDelay_DSTATE_fett /end REF_MEASUREMENT /end GROUP
/begin GROUP Racking_ "Calibration Objects for Subsystem: hilite_system('<S259>/Racking')" /end GROUP
/begin GROUP Lowering_ "Calibration Objects for Subsystem: hilite_system('<S259>/Lowering')" /end GROUP
/begin GROUP Dumping_ "Calibration Objects for Subsystem: hilite_system('<S259>/Dumping')" /end GROUP
/begin GROUP Compare_to_Constant1_ "Calibration Objects for Subsystem: hilite_system('<S257>/Compare to Constant1')" /end GROUP
/begin GROUP Compare_to_Constant_ "Calibration Objects for Subsystem: hilite_system('<S257>/Compare to Constant')" /end GROUP
/begin GROUP Filter_ "Calibration Objects for Subsystem: hilite_system('<S245>/Filter')" /end GROUP
/begin GROUP Filter_0 "Calibration Objects for Subsystem: hilite_system('<S244>/Filter')" /end GROUP
/begin GROUP Filter_1 "Calibration Objects for Subsystem: hilite_system('<S243>/Filter')" /end GROUP
/begin GROUP Filter_2 "Calibration Objects for Subsystem: hilite_system('<S239>/Filter')" /end GROUP
/begin GROUP Filter_3 "Calibration Objects for Subsystem: hilite_system('<S238>/Filter')" /end GROUP
/begin GROUP Filter_4 "Calibration Objects for Subsystem: hilite_system('<S237>/Filter')" /end GROUP
/begin GROUP Unit_Delay_External_IC_1 "Calibration Objects for Subsystem: hilite_system('<S230>/Unit Delay External IC')" /begin REF_MEASUREMENT Memory2_PreviousInput_i53e Memory1_PreviousInput_ddl0 /end REF_MEASUREMENT /end GROUP
/begin GROUP Filter_5 "Calibration Objects for Subsystem: hilite_system('<S159>/Filter')" /end GROUP
/begin GROUP Filter_6 "Calibration Objects for Subsystem: hilite_system('<S158>/Filter')" /end GROUP
/begin GROUP Filter_7 "Calibration Objects for Subsystem: hilite_system('<S157>/Filter')" /end GROUP
/begin GROUP Two_Sided_Confidence_Limit_ "Calibration Objects for Subsystem: hilite_system('<S229>/Two Sided Confidence Limit')" /end GROUP
/begin GROUP One_Sided_Confidence_Limit_ "Calibration Objects for Subsystem: hilite_system('<S229>/One Sided Confidence Limit')" /end GROUP
/begin GROUP Two_Sided_Confidence_Limit_0 "Calibration Objects for Subsystem: hilite_system('<S228>/Two Sided Confidence Limit')" /end GROUP
/begin GROUP One_Sided_Confidence_Limit_0 "Calibration Objects for Subsystem: hilite_system('<S228>/One Sided Confidence Limit')" /end GROUP
/begin GROUP Two_Sided_Confidence_Limit_1 "Calibration Objects for Subsystem: hilite_system('<S227>/Two Sided Confidence Limit')" /end GROUP
/begin GROUP One_Sided_Confidence_Limit_1 "Calibration Objects for Subsystem: hilite_system('<S227>/One Sided Confidence Limit')" /end GROUP
/begin GROUP MATLAB_Function_ "Calibration Objects for Subsystem: hilite_system('<S226>/MATLAB Function')" /end GROUP
/begin GROUP MATLAB_Function_0 "Calibration Objects for Subsystem: hilite_system('<S225>/MATLAB Function')" /end GROUP
/begin GROUP Two_Sided_St._Dev._from_Bound_ "Calibration Objects for Subsystem: hilite_system('<S222>/Two Sided St. Dev. from Bound')" /end GROUP
/begin GROUP MATLAB_Function1_ "Calibration Objects for Subsystem: hilite_system('<S222>/MATLAB Function1')" /end GROUP
/begin GROUP MATLAB_Function_1 "Calibration Objects for Subsystem: hilite_system('<S222>/MATLAB Function')" /end GROUP
/begin GROUP Two_Sided_St._Dev._from_Bound_0 "Calibration Objects for Subsystem: hilite_system('<S221>/Two Sided St. Dev. from Bound')" /end GROUP
/begin GROUP MATLAB_Function1_0 "Calibration Objects for Subsystem: hilite_system('<S221>/MATLAB Function1')" /end GROUP
/begin GROUP MATLAB_Function_2 "Calibration Objects for Subsystem: hilite_system('<S221>/MATLAB Function')" /end GROUP
/begin GROUP Latched_Point_Hysteresis_ "Calibration Objects for Subsystem: hilite_system('<S220>/Latched Point Hysteresis')" /begin SUB_GROUP Unit_Delay_External_IC_ /end SUB_GROUP /end GROUP
/begin GROUP Reset_ "Calibration Objects for Subsystem: hilite_system('<S219>/Reset')" /end GROUP
/begin GROUP NotFirstLoop_ "Calibration Objects for Subsystem: hilite_system('<S219>/NotFirstLoop')" /begin REF_MEASUREMENT UnitDelay_DSTATE_bw1s /end REF_MEASUREMENT /end GROUP
/begin GROUP Apply_Name1_ "Calibration Objects for Subsystem: hilite_system('<S218>/Apply Name1')" /begin REF_MEASUREMENT toa_pfwLatchInvalidate /end REF_MEASUREMENT /end GROUP
/begin GROUP Latched_Point_Hysteresis_0 "Calibration Objects for Subsystem: hilite_system('<S212>/Latched Point Hysteresis')" /begin SUB_GROUP Unit_Delay_External_IC_0 /end SUB_GROUP /end GROUP
/begin GROUP Valve_commands_recently_became_zero_ "Calibration Objects for Subsystem: hilite_system('<S211>/Valve commands recently became zero')" /begin REF_MEASUREMENT toa_is_not_tilt_valve_cmd toa_tilt_timer_not_expired /end REF_MEASUREMENT /begin SUB_GROUP Tilt_expired__ Lift_expired__ /end SUB_GROUP /end GROUP
/begin GROUP Rack_Stall_Detection_ "Calibration Objects for Subsystem: hilite_system('<S211>/Rack Stall Detection')"
 /begin SUB_GROUP Valve_command_history_proves_not_rack_stalled_resets_to_false__ Racking_ Lowering_ Dumping_ /end SUB_GROUP
/end GROUP
/begin GROUP Ground_Heuristic_ "Calibration Objects for Subsystem: hilite_system('<S211>/Ground Heuristic')" /end GROUP
/begin GROUP False_to_True_Transition_ "Calibration Objects for Subsystem: hilite_system('<S211>/False to True Transition')" /begin REF_MEASUREMENT Delay_DSTATE_obnz /end REF_MEASUREMENT /begin SUB_GROUP Compare_to_Constant1_ Compare_to_Constant_ /end SUB_GROUP /end GROUP
/begin GROUP End_of_Travel_Detect3_ "Calibration Objects for Subsystem: hilite_system('<S211>/End of Travel Detect3')" /end GROUP
/begin GROUP End_of_Travel_Detect2_ "Calibration Objects for Subsystem: hilite_system('<S211>/End of Travel Detect2')" /end GROUP
/begin GROUP End_of_Travel_Detect1_ "Calibration Objects for Subsystem: hilite_system('<S211>/End of Travel Detect1')" /end GROUP
/begin GROUP End_of_Travel_Detect_ "Calibration Objects for Subsystem: hilite_system('<S211>/End of Travel Detect')" /end GROUP
/begin GROUP Apply_Name4_ "Calibration Objects for Subsystem: hilite_system('<S211>/Apply Name4')" /begin REF_MEASUREMENT toa_pfwMcOk /end REF_MEASUREMENT /end GROUP
/begin GROUP Apply_Name3_ "Calibration Objects for Subsystem: hilite_system('<S211>/Apply Name3')" /begin REF_MEASUREMENT toa_pfwMcMaybeGrounded /end REF_MEASUREMENT /end GROUP
/begin GROUP Apply_Name2_ "Calibration Objects for Subsystem: hilite_system('<S211>/Apply Name2')" /begin REF_MEASUREMENT toa_pfwMcMaybeStalled /end REF_MEASUREMENT /end GROUP
/begin GROUP Apply_Name1_0 "Calibration Objects for Subsystem: hilite_system('<S211>/Apply Name1')" /begin REF_MEASUREMENT toa_pfwMcMaybeRackStall /end REF_MEASUREMENT /end GROUP
/begin GROUP NotchFilter2_ "Calibration Objects for Subsystem: hilite_system('<S210>/NotchFilter2')"
 /begin REF_MEASUREMENT rawHist filtHist alpha beta gamma is_active_c24_tip_assist_lib_support /end REF_MEASUREMENT
 /begin SUB_GROUP Filter_ /end SUB_GROUP
/end GROUP
/begin GROUP NotchFilter1_ "Calibration Objects for Subsystem: hilite_system('<S210>/NotchFilter1')"
 /begin REF_MEASUREMENT rawHist0 filtHist0 alpha0 beta0 gamma0 is_active_c24_tip_assist_lib_su0 /end REF_MEASUREMENT
 /begin SUB_GROUP Filter_0 /end SUB_GROUP
/end GROUP
/begin GROUP NotchFilter_ "Calibration Objects for Subsystem: hilite_system('<S210>/NotchFilter')"
 /begin REF_MEASUREMENT rawHist1 filtHist1 alpha1 beta1 gamma1 is_active_c24_tip_assist_lib_su1 /end REF_MEASUREMENT
 /begin SUB_GROUP Filter_1 /end SUB_GROUP
/end GROUP
/begin GROUP NotchFilter2_0 "Calibration Objects for Subsystem: hilite_system('<S209>/NotchFilter2')"
 /begin REF_MEASUREMENT rawHist2 filtHist2 alpha2 beta2 gamma2 is_active_c24_tip_assist_lib_su2 /end REF_MEASUREMENT
 /begin SUB_GROUP Filter_2 /end SUB_GROUP
/end GROUP
/begin GROUP NotchFilter1_0 "Calibration Objects for Subsystem: hilite_system('<S209>/NotchFilter1')"
 /begin REF_MEASUREMENT rawHist3 filtHist3 alpha3 beta3 gamma3 is_active_c24_tip_assist_lib_su3 /end REF_MEASUREMENT
 /begin SUB_GROUP Filter_3 /end SUB_GROUP
/end GROUP
/begin GROUP NotchFilter_0 "Calibration Objects for Subsystem: hilite_system('<S209>/NotchFilter')"
 /begin REF_MEASUREMENT rawHist4 filtHist4 alpha4 beta4 gamma4 is_active_c24_tip_assist_lib_su4 /end REF_MEASUREMENT
 /begin SUB_GROUP Filter_4 /end SUB_GROUP
/end GROUP
/begin GROUP Enable_Condition_1 "Calibration Objects for Subsystem: hilite_system('<S208>/Enable Condition')" /end GROUP
/begin GROUP Decrement_Timer_1 "Calibration Objects for Subsystem: hilite_system('<S208>/Decrement Timer')" /end GROUP
/begin GROUP Compare_To_Zero3_1 "Calibration Objects for Subsystem: hilite_system('<S208>/Compare To Zero3')" /end GROUP
/begin GROUP Compare_To_Zero_1 "Calibration Objects for Subsystem: hilite_system('<S208>/Compare To Zero')" /end GROUP
/begin GROUP EmptySubsystem_ "Calibration Objects for Subsystem: hilite_system('<S206>/EmptySubsystem')" /end GROUP
/begin GROUP Minimum_Angle_For_Current_Load_resets_to_99__ "Calibration Objects for Subsystem: hilite_system('<S202>/Minimum Angle For Current Load (resets to 99)')" /begin REF_MEASUREMENT UnitDelay_DSTATE /end REF_MEASUREMENT /end GROUP
/begin GROUP Latched_Point_Hysteresis_1 "Calibration Objects for Subsystem: hilite_system('<S202>/Latched Point Hysteresis')" /begin SUB_GROUP Unit_Delay_External_IC_1 /end SUB_GROUP /end GROUP
/begin GROUP Reset_0 "Calibration Objects for Subsystem: hilite_system('<S156>/Reset')" /end GROUP
/begin GROUP NotFirstLoop_0 "Calibration Objects for Subsystem: hilite_system('<S156>/NotFirstLoop')" /begin REF_MEASUREMENT UnitDelay_DSTATE_pigm /end REF_MEASUREMENT /end GROUP
/begin GROUP Reset_1 "Calibration Objects for Subsystem: hilite_system('<S155>/Reset')" /end GROUP
/begin GROUP NotFirstLoop_1 "Calibration Objects for Subsystem: hilite_system('<S155>/NotFirstLoop')" /begin REF_MEASUREMENT UnitDelay_DSTATE_kdv5 /end REF_MEASUREMENT /end GROUP
/begin GROUP Reset_2 "Calibration Objects for Subsystem: hilite_system('<S154>/Reset')" /end GROUP
/begin GROUP NotFirstLoop_2 "Calibration Objects for Subsystem: hilite_system('<S154>/NotFirstLoop')" /begin REF_MEASUREMENT UnitDelay_DSTATE_fdvn /end REF_MEASUREMENT /end GROUP
/begin GROUP NotchFilter2_1 "Calibration Objects for Subsystem: hilite_system('<S151>/NotchFilter2')"
 /begin REF_MEASUREMENT rawHist5 filtHist5 alpha5 beta5 gamma5 is_active_c24_tip_assist_lib_su5 /end REF_MEASUREMENT
 /begin SUB_GROUP Filter_5 /end SUB_GROUP
/end GROUP
/begin GROUP NotchFilter1_1 "Calibration Objects for Subsystem: hilite_system('<S151>/NotchFilter1')"
 /begin REF_MEASUREMENT rawHist6 filtHist6 alpha6 beta6 gamma6 is_active_c24_tip_assist_lib_su6 /end REF_MEASUREMENT
 /begin SUB_GROUP Filter_6 /end SUB_GROUP
/end GROUP
/begin GROUP NotchFilter_1 "Calibration Objects for Subsystem: hilite_system('<S151>/NotchFilter')"
 /begin REF_MEASUREMENT rawHist7 filtHist7 alpha7 beta7 gamma7 is_active_c24_tip_assist_lib_su7 /end REF_MEASUREMENT
 /begin SUB_GROUP Filter_7 /end SUB_GROUP
/end GROUP
/begin GROUP Apply_Name3_0 "Calibration Objects for Subsystem: hilite_system('<S117>/Apply Name3')" /begin REF_MEASUREMENT toa_targetCompMargin /end REF_MEASUREMENT /end GROUP
/begin GROUP Apply_Name1_1 "Calibration Objects for Subsystem: hilite_system('<S117>/Apply Name1')" /begin REF_MEASUREMENT toa_targetPayloadPostComp /end REF_MEASUREMENT /end GROUP
/begin GROUP OV_if_mismatched_ "Calibration Objects for Subsystem: hilite_system('<S69>/OV if mismatched')" /end GROUP
/begin GROUP OV_if_mismatched_0 "Calibration Objects for Subsystem: hilite_system('<S67>/OV if mismatched')" /end GROUP
/begin GROUP Reset_3 "Calibration Objects for Subsystem: hilite_system('<S57>/Reset')" /end GROUP
/begin GROUP NotFirstLoop_3 "Calibration Objects for Subsystem: hilite_system('<S57>/NotFirstLoop')" /begin REF_MEASUREMENT UnitDelay_DSTATE_j5gs /end REF_MEASUREMENT /end GROUP
/begin GROUP Reset_4 "Calibration Objects for Subsystem: hilite_system('<S56>/Reset')" /end GROUP
/begin GROUP NotFirstLoop_4 "Calibration Objects for Subsystem: hilite_system('<S56>/NotFirstLoop')" /begin REF_MEASUREMENT UnitDelay_DSTATE_mvg5 /end REF_MEASUREMENT /end GROUP
/begin GROUP OV_if_mismatched_1 "Calibration Objects for Subsystem: hilite_system('<S53>/OV if mismatched')" /end GROUP
/begin GROUP Unsecure_Payload_Status_ "Calibration Objects for Subsystem: hilite_system('<S143>/Unsecure Payload Status')" /end GROUP
/begin GROUP Secure_Payload_Status_ "Calibration Objects for Subsystem: hilite_system('<S143>/Secure Payload Status')" /end GROUP
/begin GROUP MATLAB_Function1_1 "Calibration Objects for Subsystem: hilite_system('<S143>/MATLAB Function1')" /end GROUP
/begin GROUP Weighing_Statistics_Secure_Latched_ "Calibration Objects for Subsystem: hilite_system('<S143>/Weighing Statistics, Secure Latched')" /begin SUB_GROUP Two_Sided_Confidence_Limit_ One_Sided_Confidence_Limit_ /end SUB_GROUP /end GROUP
/begin GROUP Weighing_Statistics_Notch_No_Latch_ "Calibration Objects for Subsystem: hilite_system('<S143>/Weighing Statistics, Notch, No Latch')" /begin SUB_GROUP Two_Sided_Confidence_Limit_0 One_Sided_Confidence_Limit_0 /end SUB_GROUP /end GROUP
/begin GROUP Weighing_Statistics_No_Notch_No_Latch_ "Calibration Objects for Subsystem: hilite_system('<S143>/Weighing Statistics, No Notch, No Latch')" /begin SUB_GROUP Two_Sided_Confidence_Limit_1 One_Sided_Confidence_Limit_1 /end SUB_GROUP /end GROUP
/begin GROUP Variance_Anti_Noise_Filter2_ "Calibration Objects for Subsystem: hilite_system('<S143>/Variance Anti-Noise Filter2')" /begin REF_MEASUREMENT lastSample lastSample_not_empty /end REF_MEASUREMENT /begin SUB_GROUP MATLAB_Function_ /end SUB_GROUP /end GROUP
/begin GROUP Variance_Anti_Noise_Filter1_ "Calibration Objects for Subsystem: hilite_system('<S143>/Variance Anti-Noise Filter1')" /begin REF_MEASUREMENT lastSample_kln4 lastSample_not_empty_m4ln /end REF_MEASUREMENT /begin SUB_GROUP MATLAB_Function_0 /end SUB_GROUP /end GROUP
/begin GROUP Statistics_Estimation2_ "Calibration Objects for Subsystem: hilite_system('<S143>/Statistics Estimation2')" /begin REF_MEASUREMENT lastMeanEst lastVarianceEst lastMeanEst_not_empty /end REF_MEASUREMENT
 /begin SUB_GROUP Two_Sided_St._Dev._from_Bound_ MATLAB_Function1_ MATLAB_Function_1 /end SUB_GROUP
/end GROUP
/begin GROUP Statistics_Estimation1_ "Calibration Objects for Subsystem: hilite_system('<S143>/Statistics Estimation1')" /begin REF_MEASUREMENT lastMeanEst0 lastVarianceEst0 lastMeanEst_not_empty0 /end REF_MEASUREMENT
 /begin SUB_GROUP Two_Sided_St._Dev._from_Bound_0 MATLAB_Function1_0 MATLAB_Function_2 /end SUB_GROUP
/end GROUP
/begin GROUP Sliding_ "Calibration Objects for Subsystem: hilite_system('<S143>/Sliding')" /begin SUB_GROUP Latched_Point_Hysteresis_ /end SUB_GROUP /end GROUP
/begin GROUP Single_Pole_Low_Pass_Filter1_ "Calibration Objects for Subsystem: hilite_system('<S143>/Single Pole Low Pass Filter1')" /begin REF_MEASUREMENT UnitDelay1_DSTATE_fp5d /end REF_MEASUREMENT /begin SUB_GROUP Reset_ NotFirstLoop_ /end SUB_GROUP /end GROUP
/begin GROUP Secure_Payload_Unlatch_Logic_ "Calibration Objects for Subsystem: hilite_system('<S143>/Secure Payload Unlatch Logic')" /begin SUB_GROUP Apply_Name1_ /end SUB_GROUP /end GROUP
/begin GROUP Secure_Payload_Latch_State_ "Calibration Objects for Subsystem: hilite_system('<S143>/Secure Payload Latch State')" /begin REF_MEASUREMENT UnitDelay_DSTATE_nds1 /end REF_MEASUREMENT /end GROUP
/begin GROUP Secure_Latched_Standard_Deviation_resets_to_inf__ "Calibration Objects for Subsystem: hilite_system('<S143>/Secure Latched Standard Deviation (resets to inf)')" /begin REF_MEASUREMENT UnitDelay_DSTATE_jlpe /end REF_MEASUREMENT /end GROUP
/begin GROUP Secure_Latched_Payload_resets_to_NaN__ "Calibration Objects for Subsystem: hilite_system('<S143>/Secure Latched Payload (resets to NaN)')" /begin REF_MEASUREMENT UnitDelay_DSTATE_hioq /end REF_MEASUREMENT /end GROUP
/begin GROUP Reset_when_inputs_become_OK_ "Calibration Objects for Subsystem: hilite_system('<S143>/Reset when inputs become OK')" /begin REF_MEASUREMENT DelayInput1_DSTATE /end REF_MEASUREMENT /end GROUP
/begin GROUP Racked_ "Calibration Objects for Subsystem: hilite_system('<S143>/Racked')" /begin SUB_GROUP Latched_Point_Hysteresis_0 /end SUB_GROUP /end GROUP
/begin GROUP Pseudo_Frictionless_Weigh_Common_Measurement_Conditions_ "Calibration Objects for Subsystem: hilite_system('<S143>/Pseudo-Frictionless Weigh Common Measurement Conditions')"
 /begin SUB_GROUP Valve_commands_recently_became_zero_ Rack_Stall_Detection_ Ground_Heuristic_ False_to_True_Transition_ End_of_Travel_Detect3_ End_of_Travel_Detect2_ End_of_Travel_Detect1_ End_of_Travel_Detect_ Apply_Name4_ Apply_Name3_ Apply_Name2_ Apply_Name1_0 /end SUB_GROUP
/end GROUP
/begin GROUP Notch_filter1_ "Calibration Objects for Subsystem: hilite_system('<S143>/Notch filter1')" /begin SUB_GROUP NotchFilter2_ NotchFilter1_ NotchFilter_ /end SUB_GROUP /end GROUP
/begin GROUP Notch_filter_ "Calibration Objects for Subsystem: hilite_system('<S143>/Notch filter')" /begin SUB_GROUP NotchFilter2_0 NotchFilter1_0 NotchFilter_0 /end SUB_GROUP /end GROUP
/begin GROUP Minimum_Measurement_Duration_ "Calibration Objects for Subsystem: hilite_system('<S143>/Minimum Measurement Duration')" /begin REF_MEASUREMENT Timer_DSTATE_jrr0 /end REF_MEASUREMENT
 /begin SUB_GROUP Enable_Condition_1 Decrement_Timer_1 Compare_To_Zero3_1 Compare_To_Zero_1 /end SUB_GROUP
/end GROUP
/begin GROUP DocBlock_ "Calibration Objects for Subsystem: hilite_system('<S143>/DocBlock')" /begin SUB_GROUP EmptySubsystem_ /end SUB_GROUP /end GROUP
/begin GROUP Detect_Decrease_ "Calibration Objects for Subsystem: hilite_system('<S143>/Detect Decrease')" /begin REF_MEASUREMENT DelayInput1_DSTATE_prcl /end REF_MEASUREMENT /end GROUP
/begin GROUP Compare_To_Zero1_ "Calibration Objects for Subsystem: hilite_system('<S143>/Compare To Zero1')" /end GROUP
/begin GROUP Compare_To_Zero_2 "Calibration Objects for Subsystem: hilite_system('<S143>/Compare To Zero')" /end GROUP
/begin GROUP Collapsing_ "Calibration Objects for Subsystem: hilite_system('<S143>/Collapsing')" /begin REF_MEASUREMENT Delay2_DSTATE /end REF_MEASUREMENT
 /begin SUB_GROUP Minimum_Angle_For_Current_Load_resets_to_99__ Latched_Point_Hysteresis_1 /end SUB_GROUP
/end GROUP
/begin GROUP Apply_Name9_ "Calibration Objects for Subsystem: hilite_system('<S143>/Apply Name9')" /begin REF_MEASUREMENT toa_pfwNlNotchStDevEst /end REF_MEASUREMENT /end GROUP
/begin GROUP Apply_Name8_ "Calibration Objects for Subsystem: hilite_system('<S143>/Apply Name8')" /begin REF_MEASUREMENT toa_statPayloadNlNotchOneLow /end REF_MEASUREMENT /end GROUP
/begin GROUP Apply_Name7_ "Calibration Objects for Subsystem: hilite_system('<S143>/Apply Name7')" /begin REF_MEASUREMENT toa_pfwPayloadFiltFinal /end REF_MEASUREMENT /end GROUP
/begin GROUP Apply_Name6_ "Calibration Objects for Subsystem: hilite_system('<S143>/Apply Name6')" /begin REF_MEASUREMENT toa_pfwPayloadNotchPost /end REF_MEASUREMENT /end GROUP
/begin GROUP Apply_Name5_ "Calibration Objects for Subsystem: hilite_system('<S143>/Apply Name5')" /begin REF_MEASUREMENT toa_pfwPayloadNotchFiltFinal /end REF_MEASUREMENT /end GROUP
/begin GROUP Apply_Name34_ "Calibration Objects for Subsystem: hilite_system('<S143>/Apply Name34')" /begin REF_MEASUREMENT toa_pfwSecIsRacked /end REF_MEASUREMENT /end GROUP
/begin GROUP Apply_Name33_ "Calibration Objects for Subsystem: hilite_system('<S143>/Apply Name33')" /begin REF_MEASUREMENT toa_pfwSecMinBucketAng /end REF_MEASUREMENT /end GROUP
/begin GROUP Apply_Name32_ "Calibration Objects for Subsystem: hilite_system('<S143>/Apply Name32')" /begin REF_MEASUREMENT toa_pfwSecIsNoCollapsing /end REF_MEASUREMENT /end GROUP
/begin GROUP Apply_Name31_ "Calibration Objects for Subsystem: hilite_system('<S143>/Apply Name31')" /begin REF_MEASUREMENT toa_isLiftValveCmd /end REF_MEASUREMENT /end GROUP
/begin GROUP Apply_Name30_ "Calibration Objects for Subsystem: hilite_system('<S143>/Apply Name30')" /begin REF_MEASUREMENT toa_isTiltValveCmd /end REF_MEASUREMENT /end GROUP
/begin GROUP Apply_Name3_1 "Calibration Objects for Subsystem: hilite_system('<S143>/Apply Name3')" /begin REF_MEASUREMENT toa_pfwIsWarm /end REF_MEASUREMENT /end GROUP
/begin GROUP Apply_Name29_ "Calibration Objects for Subsystem: hilite_system('<S143>/Apply Name29')" /begin REF_MEASUREMENT toa_statPayloadSecureTwoUpper /end REF_MEASUREMENT /end GROUP
/begin GROUP Apply_Name28_ "Calibration Objects for Subsystem: hilite_system('<S143>/Apply Name28')" /begin REF_MEASUREMENT toa_statPayloadSecureOneSize /end REF_MEASUREMENT /end GROUP
/begin GROUP Apply_Name27_ "Calibration Objects for Subsystem: hilite_system('<S143>/Apply Name27')" /begin REF_MEASUREMENT toa_statPayloadSecureOneLower /end REF_MEASUREMENT /end GROUP
/begin GROUP Apply_Name26_ "Calibration Objects for Subsystem: hilite_system('<S143>/Apply Name26')" /begin REF_MEASUREMENT toa_statPayloadSecureOneUpper /end REF_MEASUREMENT /end GROUP
/begin GROUP Apply_Name25_ "Calibration Objects for Subsystem: hilite_system('<S143>/Apply Name25')" /begin REF_MEASUREMENT toa_pfwSecIsNoSliding /end REF_MEASUREMENT /end GROUP
/begin GROUP Apply_Name24_ "Calibration Objects for Subsystem: hilite_system('<S143>/Apply Name24')" /begin REF_MEASUREMENT toa_pfwSecIsSecure /end REF_MEASUREMENT /end GROUP
/begin GROUP Apply_Name23_ "Calibration Objects for Subsystem: hilite_system('<S143>/Apply Name23')" /begin REF_MEASUREMENT toa_pfwNlStDevEst /end REF_MEASUREMENT /end GROUP
/begin GROUP Apply_Name22_ "Calibration Objects for Subsystem: hilite_system('<S143>/Apply Name22')" /begin REF_MEASUREMENT toa_pfwNlMeanEst /end REF_MEASUREMENT /end GROUP
/begin GROUP Apply_Name21_ "Calibration Objects for Subsystem: hilite_system('<S143>/Apply Name21')" /begin REF_MEASUREMENT toa_statPayloadNlOneLow /end REF_MEASUREMENT /end GROUP
/begin GROUP Apply_Name20_ "Calibration Objects for Subsystem: hilite_system('<S143>/Apply Name20')" /begin REF_MEASUREMENT toa_statPayloadNlTwoLow /end REF_MEASUREMENT /end GROUP
/begin GROUP Apply_Name2_0 "Calibration Objects for Subsystem: hilite_system('<S143>/Apply Name2')" /begin REF_MEASUREMENT toa_statPayloadSecureTwoSize /end REF_MEASUREMENT /end GROUP
/begin GROUP Apply_Name19_ "Calibration Objects for Subsystem: hilite_system('<S143>/Apply Name19')" /begin REF_MEASUREMENT toa_statPayloadNlTwoSize /end REF_MEASUREMENT /end GROUP
/begin GROUP Apply_Name18_ "Calibration Objects for Subsystem: hilite_system('<S143>/Apply Name18')" /begin REF_MEASUREMENT toa_statPayloadNlTwoUp /end REF_MEASUREMENT /end GROUP
/begin GROUP Apply_Name17_ "Calibration Objects for Subsystem: hilite_system('<S143>/Apply Name17')" /begin REF_MEASUREMENT toa_statPayloadNlOneSize /end REF_MEASUREMENT /end GROUP
/begin GROUP Apply_Name16_ "Calibration Objects for Subsystem: hilite_system('<S143>/Apply Name16')" /begin REF_MEASUREMENT toa_statPayloadNlOneUp /end REF_MEASUREMENT /end GROUP
/begin GROUP Apply_Name15_ "Calibration Objects for Subsystem: hilite_system('<S143>/Apply Name15')" /begin REF_MEASUREMENT toa_statPayloadNlNotchTwoLow /end REF_MEASUREMENT /end GROUP
/begin GROUP Apply_Name14_ "Calibration Objects for Subsystem: hilite_system('<S143>/Apply Name14')" /begin REF_MEASUREMENT toa_statPayloadNlNotchTwoSize /end REF_MEASUREMENT /end GROUP
/begin GROUP Apply_Name13_ "Calibration Objects for Subsystem: hilite_system('<S143>/Apply Name13')" /begin REF_MEASUREMENT toa_statPayloadNlNotchTwoUp /end REF_MEASUREMENT /end GROUP
/begin GROUP Apply_Name12_ "Calibration Objects for Subsystem: hilite_system('<S143>/Apply Name12')" /begin REF_MEASUREMENT toa_statPayloadNlNotchOneSize /end REF_MEASUREMENT /end GROUP
/begin GROUP Apply_Name11_ "Calibration Objects for Subsystem: hilite_system('<S143>/Apply Name11')" /begin REF_MEASUREMENT toa_statPayloadNlNotchOneUp /end REF_MEASUREMENT /end GROUP
/begin GROUP Apply_Name10_ "Calibration Objects for Subsystem: hilite_system('<S143>/Apply Name10')" /begin REF_MEASUREMENT toa_pfwNlNotchMeanEst /end REF_MEASUREMENT /end GROUP
/begin GROUP Apply_Name1_2 "Calibration Objects for Subsystem: hilite_system('<S143>/Apply Name1')" /begin REF_MEASUREMENT toa_statPayloadSecureTwoLower /end REF_MEASUREMENT /end GROUP
/begin GROUP MATLAB_Function2_ "Calibration Objects for Subsystem: hilite_system('<S142>/MATLAB Function2')" /end GROUP
/begin GROUP MATLAB_Function1_2 "Calibration Objects for Subsystem: hilite_system('<S142>/MATLAB Function1')" /end GROUP
/begin GROUP MATLAB_Function_3 "Calibration Objects for Subsystem: hilite_system('<S142>/MATLAB Function')" /end GROUP
/begin GROUP Single_Pole_Low_Pass_Filter2_ "Calibration Objects for Subsystem: hilite_system('<S142>/Single Pole Low Pass Filter2')" /begin REF_MEASUREMENT UnitDelay1_DSTATE_bo33 /end REF_MEASUREMENT /begin SUB_GROUP Reset_0 NotFirstLoop_0 /end SUB_GROUP /end GROUP
/begin GROUP Single_Pole_Low_Pass_Filter1_0 "Calibration Objects for Subsystem: hilite_system('<S142>/Single Pole Low Pass Filter1')" /begin REF_MEASUREMENT UnitDelay1_DSTATE_e2d2 /end REF_MEASUREMENT /begin SUB_GROUP Reset_1 NotFirstLoop_1 /end SUB_GROUP /end GROUP
/begin GROUP Single_Pole_Low_Pass_Filter_ "Calibration Objects for Subsystem: hilite_system('<S142>/Single Pole Low Pass Filter')" /begin REF_MEASUREMENT UnitDelay1_DSTATE_bcfn /end REF_MEASUREMENT /begin SUB_GROUP Reset_2 NotFirstLoop_2 /end SUB_GROUP /end GROUP
/begin GROUP Resettable_Discrete_Derivative_ "Calibration Objects for Subsystem: hilite_system('<S142>/Resettable Discrete Derivative')" /begin REF_MEASUREMENT ResettableDelay_DSTATE icLoad /end REF_MEASUREMENT /end GROUP
/begin GROUP Reset_when_inputs_become_OK_0 "Calibration Objects for Subsystem: hilite_system('<S142>/Reset when inputs become OK')" /begin REF_MEASUREMENT DelayInput1_DSTATE_nzby /end REF_MEASUREMENT /end GROUP
/begin GROUP Notch_filter_0 "Calibration Objects for Subsystem: hilite_system('<S142>/Notch filter')" /begin SUB_GROUP NotchFilter2_1 NotchFilter1_1 NotchFilter_1 /end SUB_GROUP /end GROUP
/begin GROUP Apply_Name4_0 "Calibration Objects for Subsystem: hilite_system('<S142>/Apply Name4')" /begin REF_MEASUREMENT toa_lwSpillRate /end REF_MEASUREMENT /end GROUP
/begin GROUP Apply_Name3_2 "Calibration Objects for Subsystem: hilite_system('<S142>/Apply Name3')" /begin REF_MEASUREMENT toa_lwLpfPost /end REF_MEASUREMENT /end GROUP
/begin GROUP Apply_Name2_1 "Calibration Objects for Subsystem: hilite_system('<S142>/Apply Name2')" /begin REF_MEASUREMENT toa_sendCpmLivePayload /end REF_MEASUREMENT /end GROUP
/begin GROUP Apply_Name1_3 "Calibration Objects for Subsystem: hilite_system('<S142>/Apply Name1')" /begin REF_MEASUREMENT toa_lwStatus /end REF_MEASUREMENT /end GROUP
/begin GROUP Normalize_Payload_ "Calibration Objects for Subsystem: hilite_system('<S105>/Normalize Payload')" /end GROUP
/begin GROUP Compare_To_Constant5_ "Calibration Objects for Subsystem: hilite_system('<S105>/Compare To Constant5')" /end GROUP
/begin GROUP Compare_To_Constant4_ "Calibration Objects for Subsystem: hilite_system('<S105>/Compare To Constant4')" /end GROUP
/begin GROUP Compare_To_Constant3_ "Calibration Objects for Subsystem: hilite_system('<S105>/Compare To Constant3')" /end GROUP
/begin GROUP Compare_To_Constant2_ "Calibration Objects for Subsystem: hilite_system('<S105>/Compare To Constant2')" /end GROUP
/begin GROUP Compare_To_Constant1_ "Calibration Objects for Subsystem: hilite_system('<S105>/Compare To Constant1')" /end GROUP
/begin GROUP Compare_To_Constant_ "Calibration Objects for Subsystem: hilite_system('<S105>/Compare To Constant')" /end GROUP
/begin GROUP Bucket_Target_Compensation_ "Calibration Objects for Subsystem: hilite_system('<S104>/Bucket Target Compensation')" /begin SUB_GROUP Apply_Name3_0 Apply_Name1_1 /end SUB_GROUP /end GROUP
/begin GROUP Bad_Status_if_0_ "Calibration Objects for Subsystem: hilite_system('<S104>/Bad Status if 0')" /end GROUP
/begin GROUP Apply_Name3_3 "Calibration Objects for Subsystem: hilite_system('<S104>/Apply Name3')" /begin REF_MEASUREMENT toa_targetPayloadPreComp /end REF_MEASUREMENT /end GROUP
/begin GROUP Apply_Name2_2 "Calibration Objects for Subsystem: hilite_system('<S104>/Apply Name2')" /begin REF_MEASUREMENT toa_targetPayloadStatus /end REF_MEASUREMENT /end GROUP
/begin GROUP Apply_Name1_4 "Calibration Objects for Subsystem: hilite_system('<S104>/Apply Name1')" /begin REF_MEASUREMENT toa_targetPayloadFinal /end REF_MEASUREMENT /end GROUP
/begin GROUP library_ "Calibration Objects for Subsystem: hilite_system('<S65>/library')" /begin SUB_GROUP OV_if_mismatched_ /end SUB_GROUP /end GROUP
/begin GROUP library_0 "Calibration Objects for Subsystem: hilite_system('<S64>/library')" /begin SUB_GROUP OV_if_mismatched_0 /end SUB_GROUP /end GROUP
/begin GROUP Single_Pole_Low_Pass_Filter1_1 "Calibration Objects for Subsystem: hilite_system('<S50>/Single Pole Low Pass Filter1')" /begin REF_MEASUREMENT toa_imu_eef_accl_vec_post_lpf UnitDelay1_DSTATE_mga0 /end REF_MEASUREMENT /begin SUB_GROUP Reset_3 NotFirstLoop_3 /end SUB_GROUP /end GROUP
/begin GROUP Single_Pole_Low_Pass_Filter_0 "Calibration Objects for Subsystem: hilite_system('<S50>/Single Pole Low Pass Filter')" /begin REF_MEASUREMENT UnitDelay1_DSTATE /end REF_MEASUREMENT /begin SUB_GROUP Reset_4 NotFirstLoop_4 /end SUB_GROUP /end GROUP
/begin GROUP Filter_Factor_Calc_ "Calibration Objects for Subsystem: hilite_system('<S50>/Filter Factor Calc')" /end GROUP
/begin GROUP library_1 "Calibration Objects for Subsystem: hilite_system('<S47>/library')" /begin SUB_GROUP OV_if_mismatched_1 /end SUB_GROUP /end GROUP
/begin GROUP Pseudo_Frictionless_Weigh_ "Calibration Objects for Subsystem: hilite_system('<S35>/Pseudo-Frictionless Weigh')" /begin REF_MEASUREMENT Delay_DSTATE /end REF_MEASUREMENT
 /begin SUB_GROUP Unsecure_Payload_Status_ Secure_Payload_Status_ MATLAB_Function1_1 Weighing_Statistics_Secure_Latched_ Weighing_Statistics_Notch_No_Latch_ Weighing_Statistics_No_Notch_No_Latch_ Variance_Anti_Noise_Filter2_ Variance_Anti_Noise_Filter1_ Statistics_Estimation2_ Statistics_Estimation1_ Sliding_ Single_Pole_Low_Pass_Filter1_ Secure_Payload_Unlatch_Logic_ Secure_Payload_Latch_State_ Secure_Latched_Standard_Deviation_resets_to_inf__ Secure_Latched_Payload_resets_to_NaN__ Reset_when_inputs_become_OK_ Racked_ Pseudo_Frictionless_Weigh_Common_Measurement_Conditions_ Notch_filter1_ Notch_filter_ Minimum_Measurement_Duration_ DocBlock_ Detect_Decrease_ Compare_To_Zero1_ Compare_To_Zero_2 Collapsing_ Apply_Name9_ Apply_Name8_ Apply_Name7_ Apply_Name6_ Apply_Name5_ Apply_Name34_ Apply_Name33_ Apply_Name32_ Apply_Name31_ Apply_Name30_ Apply_Name3_1 Apply_Name29_ Apply_Name28_ Apply_Name27_ Apply_Name26_ Apply_Name25_ Apply_Name24_ Apply_Name23_ Apply_Name22_ Apply_Name21_ Apply_Name20_ Apply_Name2_0 Apply_Name19_ Apply_Name18_ Apply_Name17_ Apply_Name16_ Apply_Name15_ Apply_Name14_ Apply_Name13_ Apply_Name12_ Apply_Name11_ Apply_Name10_ Apply_Name1_2 /end SUB_GROUP
/end GROUP
/begin GROUP Live_Weigh_ "Calibration Objects for Subsystem: hilite_system('<S35>/Live Weigh')"
 /begin SUB_GROUP MATLAB_Function2_ MATLAB_Function1_2 MATLAB_Function_3 Single_Pole_Low_Pass_Filter2_ Single_Pole_Low_Pass_Filter1_0 Single_Pole_Low_Pass_Filter_ Resettable_Discrete_Derivative_ Reset_when_inputs_become_OK_0 Notch_filter_0 Apply_Name4_0 Apply_Name3_2 Apply_Name2_1 Apply_Name1_3 /end SUB_GROUP
/end GROUP
/begin GROUP Apply_Name7_0 "Calibration Objects for Subsystem: hilite_system('<S35>/Apply Name7')" /begin REF_MEASUREMENT toa_pfwUnsecBoundUpper /end REF_MEASUREMENT /end GROUP
/begin GROUP Apply_Name6_0 "Calibration Objects for Subsystem: hilite_system('<S35>/Apply Name6')" /begin REF_MEASUREMENT toa_pfwUnsecBoundLower /end REF_MEASUREMENT /end GROUP
/begin GROUP Apply_Name5_0 "Calibration Objects for Subsystem: hilite_system('<S35>/Apply Name5')" /begin REF_MEASUREMENT toa_pfwUnsecStatus /end REF_MEASUREMENT /end GROUP
/begin GROUP Apply_Name4_1 "Calibration Objects for Subsystem: hilite_system('<S35>/Apply Name4')" /begin REF_MEASUREMENT toa_pfwSecLatch /end REF_MEASUREMENT /end GROUP
/begin GROUP Apply_Name3_4 "Calibration Objects for Subsystem: hilite_system('<S35>/Apply Name3')" /begin REF_MEASUREMENT toa_pfwSecStDev /end REF_MEASUREMENT /end GROUP
/begin GROUP Apply_Name2_3 "Calibration Objects for Subsystem: hilite_system('<S35>/Apply Name2')" /begin REF_MEASUREMENT toa_pfwSecPayload /end REF_MEASUREMENT /end GROUP
/begin GROUP Apply_Name1_5 "Calibration Objects for Subsystem: hilite_system('<S35>/Apply Name1')" /begin REF_MEASUREMENT toa_pfwSecStatus /end REF_MEASUREMENT /end GROUP
/begin GROUP Degrees_to_Radians1_ "Calibration Objects for Subsystem: hilite_system('<S34>/Degrees to Radians1')" /end GROUP
/begin GROUP Degrees_to_Radians_ "Calibration Objects for Subsystem: hilite_system('<S34>/Degrees to Radians')" /end GROUP
/begin GROUP Apply_Name3_5 "Calibration Objects for Subsystem: hilite_system('<S34>/Apply Name3')" /begin REF_MEASUREMENT toa_inTsBcAng /end REF_MEASUREMENT /end GROUP
/begin GROUP Apply_Name2_4 "Calibration Objects for Subsystem: hilite_system('<S34>/Apply Name2')" /begin REF_MEASUREMENT toa_inTsTiltExt /end REF_MEASUREMENT /end GROUP
/begin GROUP Apply_Name1_6 "Calibration Objects for Subsystem: hilite_system('<S34>/Apply Name1')" /begin REF_MEASUREMENT toa_inTsBc /end REF_MEASUREMENT /end GROUP
/begin GROUP Apply_Name_ "Calibration Objects for Subsystem: hilite_system('<S34>/Apply Name')" /begin REF_MEASUREMENT toa_inTsLiftAngle /end REF_MEASUREMENT /end GROUP
/begin GROUP diameter_to_area1_ "Calibration Objects for Subsystem: hilite_system('<S33>/diameter to area1')" /end GROUP
/begin GROUP diameter_to_area_ "Calibration Objects for Subsystem: hilite_system('<S33>/diameter to area')" /end GROUP
/begin GROUP Payload_Multiplexing_ "Calibration Objects for Subsystem: hilite_system('<S32>/Payload Multiplexing')" /end GROUP
/begin GROUP Normalize_Spill_Rate_ "Calibration Objects for Subsystem: hilite_system('<S32>/Normalize Spill Rate')" /end GROUP
/begin GROUP Normalize_PFW_Std._Dev._ "Calibration Objects for Subsystem: hilite_system('<S32>/Normalize PFW Std. Dev.')" /end GROUP
/begin GROUP Normalize_CPM_Bucket_Current_Weight_Error2_ "Calibration Objects for Subsystem: hilite_system('<S32>/Normalize CPM Bucket Current Weight Error2')" /end GROUP
/begin GROUP Normalize_CPM_Bucket_Current_Weight_Error1_ "Calibration Objects for Subsystem: hilite_system('<S32>/Normalize CPM Bucket Current Weight Error1')" /end GROUP
/begin GROUP Normalize_CPM_Bucket_Current_Weight_Error_ "Calibration Objects for Subsystem: hilite_system('<S32>/Normalize CPM Bucket Current Weight Error')" /end GROUP
/begin GROUP Normalize_Arbitrated_Payload_Error_ "Calibration Objects for Subsystem: hilite_system('<S32>/Normalize Arbitrated Payload Error')" /end GROUP
/begin GROUP Combine_Errors_ "Calibration Objects for Subsystem: hilite_system('<S32>/Combine Errors')"
 /begin SUB_GROUP Normalize_Payload_ Compare_To_Constant5_ Compare_To_Constant4_ Compare_To_Constant3_ Compare_To_Constant2_ Compare_To_Constant1_ Compare_To_Constant_ /end SUB_GROUP
/end GROUP
/begin GROUP Bucket_Target_Payload_ "Calibration Objects for Subsystem: hilite_system('<S32>/Bucket Target Payload')"
 /begin SUB_GROUP Bucket_Target_Compensation_ Bad_Status_if_0_ Apply_Name3_3 Apply_Name2_2 Apply_Name1_4 /end SUB_GROUP
/end GROUP
/begin GROUP Arbitrated_Payload_Fit_in_Datalink_Representation_ "Calibration Objects for Subsystem: hilite_system('<S32>/Arbitrated Payload Fit in Datalink Representation')" /end GROUP
/begin GROUP Apply_Name4_2 "Calibration Objects for Subsystem: hilite_system('<S32>/Apply Name4')" /begin REF_MEASUREMENT toa_sendPayloadArb /end REF_MEASUREMENT /end GROUP
/begin GROUP Apply_Name1_7 "Calibration Objects for Subsystem: hilite_system('<S32>/Apply Name1')" /begin REF_MEASUREMENT toa_sendPayloadType /end REF_MEASUREMENT /end GROUP
/begin GROUP Degrees_to_Radians_0 "Calibration Objects for Subsystem: hilite_system('<S31>/Degrees to Radians')" /end GROUP
/begin GROUP Apply_Name9_0 "Calibration Objects for Subsystem: hilite_system('<S31>/Apply Name9')" /begin REF_MEASUREMENT toa_payloadZeroed /end REF_MEASUREMENT /end GROUP
/begin GROUP Apply_Name8_0 "Calibration Objects for Subsystem: hilite_system('<S31>/Apply Name8')" /begin REF_MEASUREMENT toa_sfuncInLiftAng /end REF_MEASUREMENT /end GROUP
/begin GROUP Apply_Name7_1 "Calibration Objects for Subsystem: hilite_system('<S31>/Apply Name7')" /begin REF_MEASUREMENT toa_payloadAdjusted /end REF_MEASUREMENT /end GROUP
/begin GROUP Apply_Name6_1 "Calibration Objects for Subsystem: hilite_system('<S31>/Apply Name6')" /begin REF_MEASUREMENT toa_rawPayload /end REF_MEASUREMENT /end GROUP
/begin GROUP Apply_Name5_1 "Calibration Objects for Subsystem: hilite_system('<S31>/Apply Name5')" /begin REF_MEASUREMENT toa_sfuncInBcLength /end REF_MEASUREMENT /end GROUP
/begin GROUP Apply_Name4_3 "Calibration Objects for Subsystem: hilite_system('<S31>/Apply Name4')" /begin REF_MEASUREMENT toa_sfuncInRawGravY /end REF_MEASUREMENT /end GROUP
/begin GROUP Apply_Name3_6 "Calibration Objects for Subsystem: hilite_system('<S31>/Apply Name3')" /begin REF_MEASUREMENT toa_sfuncInRawGravX /end REF_MEASUREMENT /end GROUP
/begin GROUP Apply_Name23_0 "Calibration Objects for Subsystem: hilite_system('<S31>/Apply Name23')" /begin REF_MEASUREMENT toa_sfuncInGravY /end REF_MEASUREMENT /end GROUP
/begin GROUP Apply_Name21_0 "Calibration Objects for Subsystem: hilite_system('<S31>/Apply Name21')" /begin REF_MEASUREMENT toa_sfuncInGravX /end REF_MEASUREMENT /end GROUP
/begin GROUP Apply_Name20_0 "Calibration Objects for Subsystem: hilite_system('<S31>/Apply Name20')" /begin REF_MEASUREMENT toa_sfuncInLiftForce /end REF_MEASUREMENT /end GROUP
/begin GROUP Apply_Name2_5 "Calibration Objects for Subsystem: hilite_system('<S31>/Apply Name2')" /begin REF_MEASUREMENT toa_sfuncOutRawMass /end REF_MEASUREMENT /end GROUP
/begin GROUP Apply_Name19_0 "Calibration Objects for Subsystem: hilite_system('<S31>/Apply Name19')" /begin REF_MEASUREMENT toa_sfuncInTiltForce /end REF_MEASUREMENT /end GROUP
/begin GROUP Apply_Name18_0 "Calibration Objects for Subsystem: hilite_system('<S31>/Apply Name18')" /begin REF_MEASUREMENT toa_payloadAncAdjusted /end REF_MEASUREMENT /end GROUP
/begin GROUP Apply_Name17_0 "Calibration Objects for Subsystem: hilite_system('<S31>/Apply Name17')" /begin REF_MEASUREMENT toa_payloadAncZeroed /end REF_MEASUREMENT /end GROUP
/begin GROUP Apply_Name16_0 "Calibration Objects for Subsystem: hilite_system('<S31>/Apply Name16')" /begin REF_MEASUREMENT toa_sfuncInRawBcLength /end REF_MEASUREMENT /end GROUP
/begin GROUP Apply_Name15_0 "Calibration Objects for Subsystem: hilite_system('<S31>/Apply Name15')" /begin REF_MEASUREMENT toa_sfuncInRawLiftAng /end REF_MEASUREMENT /end GROUP
/begin GROUP Apply_Name14_0 "Calibration Objects for Subsystem: hilite_system('<S31>/Apply Name14')" /begin REF_MEASUREMENT toa_sfuncInRawTiltExt /end REF_MEASUREMENT /end GROUP
/begin GROUP Apply_Name13_0 "Calibration Objects for Subsystem: hilite_system('<S31>/Apply Name13')" /begin REF_MEASUREMENT toa_sfuncInRawLiftForce /end REF_MEASUREMENT /end GROUP
/begin GROUP Apply_Name12_0 "Calibration Objects for Subsystem: hilite_system('<S31>/Apply Name12')" /begin REF_MEASUREMENT toa_sfuncInRawTiltForce /end REF_MEASUREMENT /end GROUP
/begin GROUP Apply_Name11_0 "Calibration Objects for Subsystem: hilite_system('<S31>/Apply Name11')" /begin REF_MEASUREMENT toa_rawDist /end REF_MEASUREMENT /end GROUP
/begin GROUP Apply_Name10_0 "Calibration Objects for Subsystem: hilite_system('<S31>/Apply Name10')" /begin REF_MEASUREMENT toa_sfuncOutRawMassTonne /end REF_MEASUREMENT /end GROUP
/begin GROUP Apply_Name1_8 "Calibration Objects for Subsystem: hilite_system('<S31>/Apply Name1')" /begin REF_MEASUREMENT toa_sfuncInTiltExt /end REF_MEASUREMENT /end GROUP
/begin GROUP Apply_Name_0 "Calibration Objects for Subsystem: hilite_system('<S31>/Apply Name')" /begin REF_MEASUREMENT toa_sfuncOutRawDist /end REF_MEASUREMENT /end GROUP
/begin GROUP MATLAB_Function_4 "Calibration Objects for Subsystem: hilite_system('<S29>/MATLAB Function')" /end GROUP
/begin GROUP diameter_to_area_0 "Calibration Objects for Subsystem: hilite_system('<S29>/diameter to area')" /end GROUP
/begin GROUP Apply_Name1_9 "Calibration Objects for Subsystem: hilite_system('<S29>/Apply Name1')" /begin REF_MEASUREMENT toa_fcLiftForceRaw /end REF_MEASUREMENT /end GROUP
/begin GROUP Apply_Name_1 "Calibration Objects for Subsystem: hilite_system('<S29>/Apply Name')" /begin REF_MEASUREMENT toa_fcLiftForceComp /end REF_MEASUREMENT /end GROUP
/begin GROUP diameter_to_area1_0 "Calibration Objects for Subsystem: hilite_system('<S28>/diameter to area1')" /end GROUP
/begin GROUP diameter_to_area_1 "Calibration Objects for Subsystem: hilite_system('<S28>/diameter to area')" /end GROUP
/begin GROUP Radians_to_Degrees_ "Calibration Objects for Subsystem: hilite_system('<S27>/Radians to Degrees')" /end GROUP
/begin GROUP Override1_ "Calibration Objects for Subsystem: hilite_system('<S27>/Override1')" /begin SUB_GROUP library_ /end SUB_GROUP /end GROUP
/begin GROUP Override_ "Calibration Objects for Subsystem: hilite_system('<S27>/Override')" /begin SUB_GROUP library_0 /end SUB_GROUP /end GROUP
/begin GROUP Magnitude_ "Calibration Objects for Subsystem: hilite_system('<S27>/Magnitude')" /begin REF_MEASUREMENT toa_grav_neef_xy_mag /end REF_MEASUREMENT /end GROUP
/begin GROUP Apply_Name3_7 "Calibration Objects for Subsystem: hilite_system('<S27>/Apply Name3')" /begin REF_MEASUREMENT toa_imuNeefPitch /end REF_MEASUREMENT /end GROUP
/begin GROUP rotation_matrix_calc_from_two_vectors_ "Calibration Objects for Subsystem: hilite_system('<S26>/rotation matrix calc from two vectors')" /end GROUP
/begin GROUP euler_angles_from_rot_matrix_ "Calibration Objects for Subsystem: hilite_system('<S26>/euler angles from rot matrix')" /end GROUP
/begin GROUP Rotation_Matrix_About_Z_ "Calibration Objects for Subsystem: hilite_system('<S26>/Rotation Matrix About Z')" /end GROUP
/begin GROUP EEF_vector_to_NEEF_vector_ "Calibration Objects for Subsystem: hilite_system('<S26>/EEF vector to NEEF vector')" /end GROUP
/begin GROUP normalize_vector_ "Calibration Objects for Subsystem: hilite_system('<S26>/normalize vector')" /end GROUP
/begin GROUP imu_lpf_x1_ "Calibration Objects for Subsystem: hilite_system('<S26>/imu lpf x1')"
 /begin SUB_GROUP Single_Pole_Low_Pass_Filter1_1 Single_Pole_Low_Pass_Filter_0 Filter_Factor_Calc_ /end SUB_GROUP
/end GROUP
/begin GROUP Override_Pitch_Cal_for_Development_ "Calibration Objects for Subsystem: hilite_system('<S26>/Override Pitch Cal for Development')" /begin SUB_GROUP library_1 /end SUB_GROUP /end GROUP
/begin GROUP Degrees_to_Radians_1 "Calibration Objects for Subsystem: hilite_system('<S26>/Degrees to Radians')" /end GROUP
/begin GROUP Apply_Name6_2 "Calibration Objects for Subsystem: hilite_system('<S26>/Apply Name6')" /begin REF_MEASUREMENT toa_imuNeefGravZ /end REF_MEASUREMENT /end GROUP
/begin GROUP Apply_Name5_2 "Calibration Objects for Subsystem: hilite_system('<S26>/Apply Name5')" /begin REF_MEASUREMENT toa_imuNeefGravY /end REF_MEASUREMENT /end GROUP
/begin GROUP Apply_Name4_4 "Calibration Objects for Subsystem: hilite_system('<S26>/Apply Name4')" /begin REF_MEASUREMENT toa_imuNeefGravX /end REF_MEASUREMENT /end GROUP
/begin GROUP Apply_Name3_8 "Calibration Objects for Subsystem: hilite_system('<S26>/Apply Name3')" /begin REF_MEASUREMENT toa_imuRawEefAcclZ /end REF_MEASUREMENT /end GROUP
/begin GROUP Apply_Name2_6 "Calibration Objects for Subsystem: hilite_system('<S26>/Apply Name2')" /begin REF_MEASUREMENT toa_imuRawEefAcclY /end REF_MEASUREMENT /end GROUP
/begin GROUP Apply_Name1_a "Calibration Objects for Subsystem: hilite_system('<S26>/Apply Name1')" /begin REF_MEASUREMENT toa_imuRawEefAcclX /end REF_MEASUREMENT /end GROUP
/begin GROUP MATLAB_Function_5 "Calibration Objects for Subsystem: hilite_system('<S25>/MATLAB Function')" /end GROUP
/begin GROUP Apply_Name9_1 "Calibration Objects for Subsystem: hilite_system('<S25>/Apply Name9')" /begin REF_MEASUREMENT toa_sendCpmPfwSecSize /end REF_MEASUREMENT /end GROUP
/begin GROUP Apply_Name1_b "Calibration Objects for Subsystem: hilite_system('<S25>/Apply Name1')" /begin REF_MEASUREMENT toa_sendCpmPfwIsPrecise /end REF_MEASUREMENT /end GROUP
/begin GROUP Tip_Off_Assist_Payload_ "Calibration Objects for Subsystem: hilite_system('<S5>/Tip-Off Assist Payload')"
 /begin SUB_GROUP Pseudo_Frictionless_Weigh_ Live_Weigh_ Apply_Name7_0 Apply_Name6_0 Apply_Name5_0 Apply_Name4_1 Apply_Name3_4 Apply_Name2_3 Apply_Name1_5 /end SUB_GROUP
/end GROUP
/begin GROUP Tilt_Sensitivity_to_Bucket_Angle_ "Calibration Objects for Subsystem: hilite_system('<S5>/Tilt Sensitivity to Bucket Angle')"
 /begin SUB_GROUP Degrees_to_Radians1_ Degrees_to_Radians_ Apply_Name3_5 Apply_Name2_4 Apply_Name1_6 Apply_Name_ /end SUB_GROUP
/end GROUP
/begin GROUP Tilt_Cylinder_Force_ "Calibration Objects for Subsystem: hilite_system('<S5>/Tilt Cylinder Force')" /begin SUB_GROUP diameter_to_area1_ diameter_to_area_ /end SUB_GROUP /end GROUP
/begin GROUP Send_to_Implement_ "Calibration Objects for Subsystem: hilite_system('<S5>/Send to Implement')"
 /begin SUB_GROUP Payload_Multiplexing_ Normalize_Spill_Rate_ Normalize_PFW_Std._Dev._ Normalize_CPM_Bucket_Current_Weight_Error2_ Normalize_CPM_Bucket_Current_Weight_Error1_ Normalize_CPM_Bucket_Current_Weight_Error_ Normalize_Arbitrated_Payload_Error_ Combine_Errors_ Bucket_Target_Payload_ Arbitrated_Payload_Fit_in_Datalink_Representation_ Apply_Name4_2 Apply_Name1_7 /end SUB_GROUP
/end GROUP
/begin GROUP Non_Bucket_Payload_ "Calibration Objects for Subsystem: hilite_system('<S5>/Non Bucket Payload')"
 /begin SUB_GROUP Degrees_to_Radians_0 Apply_Name9_0 Apply_Name8_0 Apply_Name7_1 Apply_Name6_1 Apply_Name5_1 Apply_Name4_3 Apply_Name3_6 Apply_Name23_0 Apply_Name21_0 Apply_Name20_0 Apply_Name2_5 Apply_Name19_0 Apply_Name18_0 Apply_Name17_0 Apply_Name16_0 Apply_Name15_0 Apply_Name14_0 Apply_Name13_0 Apply_Name12_0 Apply_Name11_0 Apply_Name10_0 Apply_Name1_8 Apply_Name_0 /end SUB_GROUP
/end GROUP
/begin GROUP Machine_Properties_ "Calibration Objects for Subsystem: hilite_system('<S5>/Machine Properties')"
 /begin REF_CHARACTERISTIC toa_liftBoreDia toa_liftRodDia toa_ratedPayload toa_tiltBoreDia toa_tiltRodDia toa_toolBcAngle toa_toolBcLength toa_appNumber toa_tiltNumCyl /end REF_CHARACTERISTIC
/end GROUP
/begin GROUP Lift_Friction_Compensation_ "Calibration Objects for Subsystem: hilite_system('<S5>/Lift Friction Compensation')"
 /begin SUB_GROUP MATLAB_Function_4 diameter_to_area_0 Apply_Name1_9 Apply_Name_1 /end SUB_GROUP
/end GROUP
/begin GROUP Lift_Cylinder_Force_ "Calibration Objects for Subsystem: hilite_system('<S5>/Lift Cylinder Force')" /begin SUB_GROUP diameter_to_area1_0 diameter_to_area_1 /end SUB_GROUP /end GROUP
/begin GROUP Gravity_Relevant_Components_ "Calibration Objects for Subsystem: hilite_system('<S5>/Gravity Relevant Components')"
 /begin SUB_GROUP Radians_to_Degrees_ Override1_ Override_ Magnitude_ Apply_Name3_7 /end SUB_GROUP
/end GROUP
/begin GROUP EEF_IMU_to_NEEF_gravity_vector_ "Calibration Objects for Subsystem: hilite_system('<S5>/EEF IMU to NEEF gravity vector')"
 /begin REF_MEASUREMENT toa_grav_angles toa_grav_rotMatrix toa_grav_rotAxis toa_grav_angle toa_imu_neef_accl_vec /end REF_MEASUREMENT
 /begin SUB_GROUP rotation_matrix_calc_from_two_vectors_ euler_angles_from_rot_matrix_ Rotation_Matrix_About_Z_ EEF_vector_to_NEEF_vector_ normalize_vector_ imu_lpf_x1_ Override_Pitch_Cal_for_Development_ Degrees_to_Radians_1 Apply_Name6_2 Apply_Name5_2 Apply_Name4_4 Apply_Name3_8 Apply_Name2_6 Apply_Name1_a /end SUB_GROUP
/end GROUP
/begin GROUP CPM_Payload_Send_ "Calibration Objects for Subsystem: hilite_system('<S5>/CPM Payload Send')" /begin SUB_GROUP MATLAB_Function_5 Apply_Name9_1 Apply_Name1_b /end SUB_GROUP /end GROUP
/begin GROUP Apply_Name9_2 "Calibration Objects for Subsystem: hilite_system('<S5>/Apply Name9')" /begin REF_MEASUREMENT toa_outUnsecPayloadNormUp /end REF_MEASUREMENT /end GROUP
/begin GROUP Apply_Name8_1 "Calibration Objects for Subsystem: hilite_system('<S5>/Apply Name8')" /begin REF_MEASUREMENT toa_outBucketPayloadTarget /end REF_MEASUREMENT /end GROUP
/begin GROUP Apply_Name7_2 "Calibration Objects for Subsystem: hilite_system('<S5>/Apply Name7')" /begin REF_MEASUREMENT toa_outTiltSensToBucket /end REF_MEASUREMENT /end GROUP
/begin GROUP Apply_Name6_3 "Calibration Objects for Subsystem: hilite_system('<S5>/Apply Name6')" /begin REF_MEASUREMENT toa_outAdvErrorCode /end REF_MEASUREMENT /end GROUP
/begin GROUP Apply_Name5_3 "Calibration Objects for Subsystem: hilite_system('<S5>/Apply Name5')" /begin REF_MEASUREMENT toa_outSendCpmStatus /end REF_MEASUREMENT /end GROUP
/begin GROUP Apply_Name4_5 "Calibration Objects for Subsystem: hilite_system('<S5>/Apply Name4')" /begin REF_MEASUREMENT toa_liftForce /end REF_MEASUREMENT /end GROUP
/begin GROUP Apply_Name3_9 "Calibration Objects for Subsystem: hilite_system('<S5>/Apply Name3')" /begin REF_MEASUREMENT toa_tiltForce /end REF_MEASUREMENT /end GROUP
/begin GROUP Apply_Name21_1 "Calibration Objects for Subsystem: hilite_system('<S5>/Apply Name21')" /begin REF_MEASUREMENT toa_outPfwPayloadNormStdev /end REF_MEASUREMENT /end GROUP
/begin GROUP Apply_Name20_1 "Calibration Objects for Subsystem: hilite_system('<S5>/Apply Name20')" /begin REF_MEASUREMENT toa_outPfwStat /end REF_MEASUREMENT /end GROUP
/begin GROUP Apply_Name2_7 "Calibration Objects for Subsystem: hilite_system('<S5>/Apply Name2')" /begin REF_MEASUREMENT toa_tiltSensitivity /end REF_MEASUREMENT /end GROUP
/begin GROUP Apply_Name19_1 "Calibration Objects for Subsystem: hilite_system('<S5>/Apply Name19')" /begin REF_MEASUREMENT toa_outPayloadArbNormError /end REF_MEASUREMENT /end GROUP
/begin GROUP Apply_Name16_1 "Calibration Objects for Subsystem: hilite_system('<S5>/Apply Name16')" /begin REF_MEASUREMENT toa_outMinSecBucketAng /end REF_MEASUREMENT /end GROUP
/begin GROUP Apply_Name15_1 "Calibration Objects for Subsystem: hilite_system('<S5>/Apply Name15')" /begin REF_MEASUREMENT toa_outCpmPayloadNormError /end REF_MEASUREMENT /end GROUP
/begin GROUP Apply_Name14_1 "Calibration Objects for Subsystem: hilite_system('<S5>/Apply Name14')" /begin REF_MEASUREMENT toa_outCpmAccu /end REF_MEASUREMENT /end GROUP
/begin GROUP Apply_Name13_1 "Calibration Objects for Subsystem: hilite_system('<S5>/Apply Name13')" /begin REF_MEASUREMENT toa_outSpillRateNorm /end REF_MEASUREMENT /end GROUP
/begin GROUP Apply_Name12_1 "Calibration Objects for Subsystem: hilite_system('<S5>/Apply Name12')" /begin REF_MEASUREMENT toa_outUnsecPayloadStatus /end REF_MEASUREMENT /end GROUP
/begin GROUP Apply_Name11_1 "Calibration Objects for Subsystem: hilite_system('<S5>/Apply Name11')" /begin REF_MEASUREMENT toa_outTiltHePress /end REF_MEASUREMENT /end GROUP
/begin GROUP Apply_Name10_1 "Calibration Objects for Subsystem: hilite_system('<S5>/Apply Name10')" /begin REF_MEASUREMENT toa_outUnsecPayloadNormLow /end REF_MEASUREMENT /end GROUP
/begin GROUP Apply_Name1_c "Calibration Objects for Subsystem: hilite_system('<S5>/Apply Name1')" /begin REF_MEASUREMENT toa_outSendCpmPayload /end REF_MEASUREMENT /end GROUP
/begin GROUP Tip_Off_Assist_Support_Lib_ "Calibration Objects for Subsystem: hilite_system('<Root>/Tip-Off Assist Support Lib')"
 /begin SUB_GROUP Tip_Off_Assist_Payload_ Tilt_Sensitivity_to_Bucket_Angle_ Tilt_Cylinder_Force_ Send_to_Implement_ Non_Bucket_Payload_ Machine_Properties_ Lift_Friction_Compensation_ Lift_Cylinder_Force_ Gravity_Relevant_Components_ EEF_IMU_to_NEEF_gravity_vector_ CPM_Payload_Send_ Apply_Name9_2 Apply_Name8_1 Apply_Name7_2 Apply_Name6_3 Apply_Name5_3 Apply_Name4_5 Apply_Name3_9 Apply_Name21_1 Apply_Name20_1 Apply_Name2_7 Apply_Name19_1 Apply_Name16_1 Apply_Name15_1 Apply_Name14_1 Apply_Name13_1 Apply_Name12_1 Apply_Name11_1 Apply_Name10_1 Apply_Name1_c /end SUB_GROUP
/end GROUP
/begin GROUP Package_Instance_ "Calibration Objects for Subsystem: hilite_system('<Root>/Package Instance')" /end GROUP
/begin GROUP Apply_Name3_a "Calibration Objects for Subsystem: hilite_system('<Root>/Apply Name3')" /begin REF_MEASUREMENT toa_inImuAcclZ /end REF_MEASUREMENT /end GROUP
/begin GROUP Apply_Name2_8 "Calibration Objects for Subsystem: hilite_system('<Root>/Apply Name2')" /begin REF_MEASUREMENT toa_inImuAcclY /end REF_MEASUREMENT /end GROUP
/begin GROUP Apply_Name_2 "Calibration Objects for Subsystem: hilite_system('<Root>/Apply Name')" /begin REF_MEASUREMENT toa_inImuAcclX /end REF_MEASUREMENT /end GROUP
/begin GROUP ModelHierarchy "Calibration Objects for Model: hilite_system('toa_wl00')" ROOT
 /begin SUB_GROUP Tip_Off_Assist_Support_Lib_ Package_Instance_ Apply_Name3_a Apply_Name2_8 Apply_Name_2 /end SUB_GROUP
/end GROUP
/begin GROUP ModelHierarchyTagged "Calibration Objects for Model: hilite_system('toa_wl00')" ROOT
 /begin REF_MEASUREMENT toa_pfwLatchInvalidate toa_tilt_timer_expired toa_is_not_tilt_valve_cmd toa_tilt_timer_not_expired toa_pfwMcOk toa_pfwMcMaybeGrounded toa_pfwMcMaybeStalled toa_pfwMcMaybeRackStall toa_pfwNlNotchStDevEst toa_statPayloadNlNotchOneLow toa_pfwPayloadFiltFinal toa_pfwPayloadNotchPost toa_pfwPayloadNotchFiltFinal toa_pfwSecIsRacked toa_pfwSecMinBucketAng toa_pfwSecIsNoCollapsing toa_isLiftValveCmd toa_isTiltValveCmd toa_pfwIsWarm toa_statPayloadSecureTwoUpper toa_statPayloadSecureOneSize toa_statPayloadSecureOneLower toa_statPayloadSecureOneUpper toa_pfwSecIsNoSliding toa_pfwSecIsSecure toa_pfwNlStDevEst toa_pfwNlMeanEst toa_statPayloadNlOneLow toa_statPayloadNlTwoLow toa_statPayloadSecureTwoSize toa_statPayloadNlTwoSize toa_statPayloadNlTwoUp toa_statPayloadNlOneSize toa_statPayloadNlOneUp toa_statPayloadNlNotchTwoLow toa_statPayloadNlNotchTwoSize toa_statPayloadNlNotchTwoUp toa_statPayloadNlNotchOneSize toa_statPayloadNlNotchOneUp toa_pfwNlNotchMeanEst toa_statPayloadSecureTwoLower toa_lwSpillRate toa_lwLpfPost toa_sendCpmLivePayload toa_lwStatus toa_pfwUnsecBoundUpper toa_pfwUnsecBoundLower toa_pfwUnsecStatus toa_pfwSecLatch toa_pfwSecStDev toa_pfwSecPayload toa_pfwSecStatus toa_inTsBcAng toa_inTsTiltExt toa_inTsBc toa_inTsLiftAngle toa_targetCompMargin toa_targetPayloadPostComp toa_targetPayloadPreComp toa_targetPayloadStatus toa_targetPayloadFinal toa_sendPayloadArb toa_sendPayloadType toa_payloadZeroed toa_sfuncInLiftAng toa_payloadAdjusted toa_rawPayload toa_sfuncInBcLength toa_sfuncInRawGravY toa_sfuncInRawGravX toa_sfuncInGravY toa_sfuncInGravX toa_sfuncInLiftForce toa_sfuncOutRawMass toa_sfuncInTiltForce toa_payloadAncAdjusted toa_payloadAncZeroed toa_sfuncInRawBcLength toa_sfuncInRawLiftAng toa_sfuncInRawTiltExt toa_sfuncInRawLiftForce toa_sfuncInRawTiltForce toa_rawDist toa_sfuncOutRawMassTonne toa_sfuncInTiltExt toa_sfuncOutRawDist toa_fcLiftForceRaw toa_fcLiftForceComp toa_grav_neef_xy_mag toa_imuNeefPitch toa_imu_eef_accl_vec_post_lpf toa_imuNeefGravZ toa_imuNeefGravY toa_imuNeefGravX toa_imuRawEefAcclZ toa_imuRawEefAcclY toa_imuRawEefAcclX toa_grav_angles toa_grav_rotMatrix toa_grav_rotAxis toa_grav_angle toa_imu_neef_accl_vec toa_sendCpmPfwSecSize toa_sendCpmPfwIsPrecise toa_outUnsecPayloadNormUp toa_outBucketPayloadTarget toa_outTiltSensToBucket toa_outAdvErrorCode toa_outSendCpmStatus toa_liftForce toa_tiltForce toa_outPfwPayloadNormStdev toa_outPfwStat toa_tiltSensitivity toa_outPayloadArbNormError toa_outMinSecBucketAng toa_outCpmPayloadNormError toa_outCpmAccu toa_outSpillRateNorm toa_outUnsecPayloadStatus toa_outTiltHePress toa_outUnsecPayloadNormLow toa_outSendCpmPayload toa_inImuAcclZ toa_inImuAcclY toa_inImuAcclX /end REF_MEASUREMENT
 /begin REF_CHARACTERISTIC toa_liftBoreDia toa_liftRodDia toa_ratedPayload toa_tiltBoreDia toa_tiltRodDia toa_toolBcAngle toa_toolBcLength toa_appNumber toa_tiltNumCyl /end REF_CHARACTERISTIC
/end GROUP
/end MODULE
/end PROJECT
