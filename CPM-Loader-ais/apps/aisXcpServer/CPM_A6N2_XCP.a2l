/* @@@@ File written by CANAPE_VERSION 14 0 39 @@@@ */ ASAP2_VERSION 1 61
/begin PROJECT New ""
/begin MODULE New ""
/begin MOD_COMMON "" BYTE_ORDER MSB_LAST ALIGNMENT_BYTE 1 ALIGNMENT_WORD 2 ALIGNMENT_LONG 4 ALIGNMENT_INT64 8 ALIGNMENT_FLOAT32_IEEE 4 ALIGNMENT_FLOAT64_IEEE 8 /end MOD_COMMON
/begin IF_DATA XCP
 /begin PROTOCOL_LAYER 0x0100 0x07D0 0x2710 0x00 0x00 0x00 0x00 0x00 0xFF 0x0400 BYTE_ORDER_MSB_LAST ADDRESS_GRANULARITY_BYTE OPTIONAL_CMD GET_DAQ_EVENT_INFO OPTIONAL_CMD GET_DAQ_LIST_INFO OPTIONAL_CMD GET_DAQ_RESOLUTION_INFO OPTIONAL_CMD GET_DAQ_PROCESSOR_INFO OPTIONAL_CMD START_STOP_SYNCH OPTIONAL_CMD START_STOP_DAQ_LIST OPTIONAL_CMD SET_DAQ_LIST_MODE OPTIONAL_CMD WRITE_DAQ OPTIONAL_CMD SET_DAQ_PTR OPTIONAL_CMD CLEAR_DAQ_LIST OPTIONAL_CMD SHORT_UPLOAD OPTIONAL_CMD UPLOAD OPTIONAL_CMD SET_MTA OPTIONAL_CMD UNLOCK OPTIONAL_CMD GET_SEED OPTIONAL_CMD GET_COMM_MODE_INFO SEED_AND_KEY_EXTERNAL_FUNCTION "seedkey1.DLL" /end PROTOCOL_LAYER
 /begin DAQ STATIC 0x0A 0x01 0x00 OPTIMISATION_TYPE_DEFAULT ADDRESS_EXTENSION_FREE IDENTIFICATION_FIELD_TYPE_ABSOLUTE GRANULARITY_ODT_ENTRY_SIZE_DAQ_BYTE 0x08 NO_OVERLOAD_INDICATION PRESCALER_SUPPORTED /begin STIM GRANULARITY_ODT_ENTRY_SIZE_STIM_BYTE 0x08 /end STIM
  /begin DAQ_LIST 0x00 DAQ_LIST_TYPE DAQ MAX_ODT 0x01 MAX_ODT_ENTRIES 0xFF FIRST_PID 0x00 /end DAQ_LIST
  /begin DAQ_LIST 0x01 DAQ_LIST_TYPE DAQ MAX_ODT 0x01 MAX_ODT_ENTRIES 0xFF FIRST_PID 0x01 /end DAQ_LIST
  /begin DAQ_LIST 0x02 DAQ_LIST_TYPE DAQ MAX_ODT 0x01 MAX_ODT_ENTRIES 0xFF /end DAQ_LIST
  /begin DAQ_LIST 0x03 DAQ_LIST_TYPE DAQ MAX_ODT 0x01 MAX_ODT_ENTRIES 0xFF /end DAQ_LIST
  /begin DAQ_LIST 0x04 DAQ_LIST_TYPE DAQ MAX_ODT 0x01 MAX_ODT_ENTRIES 0xFF /end DAQ_LIST
  /begin DAQ_LIST 0x05 DAQ_LIST_TYPE DAQ MAX_ODT 0x01 MAX_ODT_ENTRIES 0xFF /end DAQ_LIST
  /begin DAQ_LIST 0x06 DAQ_LIST_TYPE DAQ MAX_ODT 0x01 MAX_ODT_ENTRIES 0xFF /end DAQ_LIST
  /begin DAQ_LIST 0x07 DAQ_LIST_TYPE DAQ MAX_ODT 0x01 MAX_ODT_ENTRIES 0xFF /end DAQ_LIST
  /begin DAQ_LIST 0x08 DAQ_LIST_TYPE DAQ MAX_ODT 0x01 MAX_ODT_ENTRIES 0xFF /end DAQ_LIST
  /begin DAQ_LIST 0x09 DAQ_LIST_TYPE DAQ MAX_ODT 0x01 MAX_ODT_ENTRIES 0xFF /end DAQ_LIST
  /begin EVENT "BaseRate" "BaseRate" 0x00 DAQ_STIM 0xFF 0x01 0x07 0xFF /end EVENT
 /end DAQ
 /begin PAG 0x00 /end PAG
 /begin PGM PGM_MODE_ABSOLUTE 0x00 0x00 /end PGM
 /begin XCP_ON_UDP_IP 0x0100 0xEA60 ADDRESS "165.26.79.19" /end XCP_ON_UDP_IP
/end IF_DATA
/begin MOD_PAR "" /end MOD_PAR
/begin COMPU_VTAB TipAssistAdvEcmError_t "" TAB_VERB 5 0 "NO_ERROR" 1 "TIP_OFF_MODE_NOT_PILE" 2 "TRUCK_TARGET_NOT_SET" 3 "PAYLOAD_NOT_ACHIEVABLE" 4 "FAULT" DEFAULT_VALUE "" /end COMPU_VTAB
/begin COMPU_VTAB TipAssistCpmTipOffMode_t "" TAB_VERB 2 1 "TRUCK" 2 "PILE" DEFAULT_VALUE "" /end COMPU_VTAB
/begin COMPU_VTAB TipAssistLiveWeighStatus_t "" TAB_VERB 2 0 "INVALID" 1 "VALID" DEFAULT_VALUE "" /end COMPU_VTAB
/begin COMPU_VTAB TipAssistSecPfwStatus_t "" TAB_VERB 5 0 "INVALID" 1 "VALID_MEASURING" 2 "PENDING" 3 "FAULT" 4 "VALID_NOT_MEASURING" DEFAULT_VALUE "" /end COMPU_VTAB
/begin COMPU_VTAB TipAssistSendCpmStatus_t "" TAB_VERB 3 0 "INVALID" 1 "LIVE" 2 "PSEUDO_FRICTIONLESS" DEFAULT_VALUE "" /end COMPU_VTAB
/begin COMPU_VTAB TipAssistUnsecPfwStatus_t "" TAB_VERB 4 0 "INVALID" 1 "VALID" 2 "PENDING" 3 "FAULT" DEFAULT_VALUE "" /end COMPU_VTAB
/begin COMPU_VTAB toa_pfwIsWarm "" TAB_VERB 2 0 "NOT WARM" 1 "WARM" DEFAULT_VALUE "" /end COMPU_VTAB
/begin COMPU_VTAB toa_pfwLatchInvalidate "" TAB_VERB 2 0 "DON\\\'T INVALIDATE" 1 "INVALIDATE" DEFAULT_VALUE "" /end COMPU_VTAB
/begin COMPU_VTAB toa_pfwMcMaybeGrounded "" TAB_VERB 2 0 "NOT GROUNDED" 1 "MAYBE GROUNDED" DEFAULT_VALUE "" /end COMPU_VTAB
/begin COMPU_VTAB toa_pfwMcMaybeRackStall "" TAB_VERB 2 0 "NOT RACK STALLED" 1 "MAYBE RACK STALLED" DEFAULT_VALUE "" /end COMPU_VTAB
/begin COMPU_VTAB toa_pfwMcMaybeStalled "" TAB_VERB 2 0 "NOT STALLED" 1 "MAYBE STALLED" DEFAULT_VALUE "" /end COMPU_VTAB
/begin COMPU_VTAB toa_pfwMcOk "" TAB_VERB 2 0 "NOT OK MEAS. CONDITIONS" 1 "OK MEAS. CONDITIONS" DEFAULT_VALUE "" /end COMPU_VTAB
/begin COMPU_VTAB toa_pfwSecIsNoCollapsing "" TAB_VERB 2 0 "MAYBE COLLAPSING" 1 "NOT COLLAPSING" DEFAULT_VALUE "" /end COMPU_VTAB
/begin COMPU_VTAB toa_pfwSecIsNoSliding "" TAB_VERB 2 0 "MAYBE SLIDING" 1 "NOT SLIDING" DEFAULT_VALUE "" /end COMPU_VTAB
/begin COMPU_VTAB toa_pfwSecIsRacked "" TAB_VERB 2 0 "NOT RACKED" 1 "RACKED" DEFAULT_VALUE "" /end COMPU_VTAB
/begin COMPU_VTAB toa_pfwSecIsSecure "" TAB_VERB 2 0 "NOT SECURE" 1 "SECURE" DEFAULT_VALUE "" /end COMPU_VTAB
/begin COMPU_VTAB toa_pfwSecLatch "" TAB_VERB 2 0 "UNLATCHED" 1 "LATCHED" DEFAULT_VALUE "" /end COMPU_VTAB
/begin COMPU_VTAB toa_targetPayloadStatus "" TAB_VERB 2 0 "truck target not set" 1 "truck target set" DEFAULT_VALUE "" /end COMPU_VTAB
/begin COMPU_VTAB_RANGE TOAinput_status "" 2 0 0 "OK" 1 255 "NOK" DEFAULT_VALUE "" /end COMPU_VTAB_RANGE
/begin COMPU_VTAB TOAinvalidate_outputs "" TAB_VERB 2 0 "DON\\\'T INVALIDATE" 1 "INVALIDATE" DEFAULT_VALUE "" /end COMPU_VTAB
/begin COMPU_METHOD TOAtestPts.toa_lwStatus.CONVERSION "" IDENTICAL "%3.1" "" STATUS_STRING_REF TipAssistLiveWeighStatus_t /end COMPU_METHOD
/begin COMPU_METHOD TOAtestPts.toa_pfwIsWarm.CONVERSION "" IDENTICAL "%3.1" "" STATUS_STRING_REF toa_pfwIsWarm /end COMPU_METHOD
/begin COMPU_METHOD TOAtestPts.toa_pfwLatchInvalidate.CONVERSION "" IDENTICAL "%3.1" "" STATUS_STRING_REF toa_pfwLatchInvalidate /end COMPU_METHOD
/begin COMPU_METHOD TOAtestPts.toa_pfwMcMaybeGrounded.CONVERSION "" IDENTICAL "%3.1" "" STATUS_STRING_REF toa_pfwMcMaybeGrounded /end COMPU_METHOD
/begin COMPU_METHOD TOAtestPts.toa_pfwMcMaybeRackStall.CONVERSION "" IDENTICAL "%3.1" "" STATUS_STRING_REF toa_pfwMcMaybeRackStall /end COMPU_METHOD
/begin COMPU_METHOD TOAtestPts.toa_pfwMcMaybeStalled.CONVERSION "" IDENTICAL "%3.1" "" STATUS_STRING_REF toa_pfwMcMaybeStalled /end COMPU_METHOD
/begin COMPU_METHOD TOAtestPts.toa_pfwMcOk.CONVERSION "" IDENTICAL "%3.1" "" STATUS_STRING_REF toa_pfwMcOk /end COMPU_METHOD
/begin COMPU_METHOD TOAtestPts.toa_pfwSecIsNoCollapsing.CONVERSION "" IDENTICAL "%3.1" "" STATUS_STRING_REF toa_pfwSecIsNoCollapsing /end COMPU_METHOD
/begin COMPU_METHOD TOAtestPts.toa_pfwSecIsNoSliding.CONVERSION "" IDENTICAL "%3.1" "" STATUS_STRING_REF toa_pfwSecIsNoSliding /end COMPU_METHOD
/begin COMPU_METHOD TOAtestPts.toa_pfwSecIsRacked.CONVERSION "" IDENTICAL "%3.1" "" STATUS_STRING_REF toa_pfwSecIsRacked /end COMPU_METHOD
/begin COMPU_METHOD TOAtestPts.toa_pfwSecIsSecure.CONVERSION "" IDENTICAL "%3.1" "" STATUS_STRING_REF toa_pfwSecIsSecure /end COMPU_METHOD
/begin COMPU_METHOD TOAtestPts.toa_pfwSecLatch.CONVERSION "" IDENTICAL "%3.1" "" STATUS_STRING_REF toa_pfwSecLatch /end COMPU_METHOD
/begin COMPU_METHOD TOAtestPts.toa_pfwSecStatus.CONVERSION "" IDENTICAL "%3.1" "" STATUS_STRING_REF TipAssistSecPfwStatus_t /end COMPU_METHOD
/begin COMPU_METHOD TOAtestPts.toa_pfwUnsecStatus.CONVERSION "" IDENTICAL "%3.1" "" STATUS_STRING_REF TipAssistUnsecPfwStatus_t /end COMPU_METHOD
/begin COMPU_METHOD TOAtestPts.toa_targetPayloadStatus.CONVERSION "" IDENTICAL "%3.1" "" STATUS_STRING_REF toa_targetPayloadStatus /end COMPU_METHOD
/begin COMPU_METHOD WeighDebug.TOAerror_code_out.CONVERSION "" IDENTICAL "%3.1" "" STATUS_STRING_REF TipAssistAdvEcmError_t /end COMPU_METHOD
/begin COMPU_METHOD WeighDebug.TOAinput_status.CONVERSION "" IDENTICAL "%3.1" "" STATUS_STRING_REF TOAinput_status /end COMPU_METHOD
/begin COMPU_METHOD WeighDebug.TOAinvalidate_outputs.CONVERSION "" IDENTICAL "%3.1" "" STATUS_STRING_REF TOAinvalidate_outputs /end COMPU_METHOD
/begin COMPU_METHOD WeighDebug.TOApayload_status_send_to_CPM.CONVERSION "" IDENTICAL "%3.1" "" STATUS_STRING_REF TipAssistSendCpmStatus_t /end COMPU_METHOD
/begin COMPU_METHOD WeighDebug.TOAtipoff_mode.CONVERSION "" IDENTICAL "%3.1" "" STATUS_STRING_REF TipAssistCpmTipOffMode_t /end COMPU_METHOD
/begin COMPU_METHOD WeighDebug.TOAunsecured_PFW_status.CONVERSION "" IDENTICAL "%3.1" "" STATUS_STRING_REF TipAssistUnsecPfwStatus_t /end COMPU_METHOD
/begin COMPU_METHOD WeighDebug.TOAweigh_status_out.CONVERSION "" IDENTICAL "%3.1" "" STATUS_STRING_REF TipAssistSecPfwStatus_t /end COMPU_METHOD
/begin MEASUREMENT ACD.TX.Counter "" SLONG NO_COMPU_METHOD 0 0 -2147483648 2147483647 ECU_ADDRESS 0x1300FF FORMAT "%.15" /end MEASUREMENT
/begin MEASUREMENT ACD.TX.DisplayEthernetBad "" SBYTE NO_COMPU_METHOD 0 0 -128 127 ECU_ADDRESS 0x130000 FORMAT "%.15" /end MEASUREMENT
/begin MEASUREMENT ACD.TX.ProductLinkEthernetBad "" SBYTE NO_COMPU_METHOD 0 0 -128 127 ECU_ADDRESS 0x130001 FORMAT "%.15" /end MEASUREMENT
/begin MEASUREMENT CAN11MessageTimeoutFlag "" UBYTE NO_COMPU_METHOD 0 0 0 255 ECU_ADDRESS 0x5000C FORMAT "%.15" PHYS_UNIT "%" /end MEASUREMENT
/begin MEASUREMENT Cal.Curve.EmptySlowImuOffsetFinal "" FLOAT32_IEEE NO_COMPU_METHOD 0 0 -3.40282346639e+038 3.40282346639e+038 ECU_ADDRESS 0xD0079 FORMAT "%.15" /end MEASUREMENT
/begin MEASUREMENT Cal.Curve.EmptySlowLumpedWeightFinal "" FLOAT32_IEEE NO_COMPU_METHOD 0 0 -3.40282346639e+038 3.40282346639e+038 ECU_ADDRESS 0xD007B FORMAT "%.15" /end MEASUREMENT
/begin MEASUREMENT Cal.Curve.FullSlowLumpedWeightFinal "" FLOAT32_IEEE NO_COMPU_METHOD 0 0 -3.40282346639e+038 3.40282346639e+038 ECU_ADDRESS 0xD007A FORMAT "%.15" /end MEASUREMENT
/begin MEASUREMENT Cal.EmptySlowImuOffsetTemp1 "" FLOAT32_IEEE NO_COMPU_METHOD 0 0 -3.40282346639e+038 3.40282346639e+038 ECU_ADDRESS 0xD0070 FORMAT "%.15" /end MEASUREMENT
/begin MEASUREMENT Cal.EmptySlowImuOffsetTemp2 "" FLOAT32_IEEE NO_COMPU_METHOD 0 0 -3.40282346639e+038 3.40282346639e+038 ECU_ADDRESS 0xD0071 FORMAT "%.15" /end MEASUREMENT
/begin MEASUREMENT Cal.EmptySlowImuOffsetTemp3 "" FLOAT32_IEEE NO_COMPU_METHOD 0 0 -3.40282346639e+038 3.40282346639e+038 ECU_ADDRESS 0xD0072 FORMAT "%.15" /end MEASUREMENT
/begin MEASUREMENT Cal.EmptySlowLumpedWeightTemp1 "" FLOAT32_IEEE NO_COMPU_METHOD 0 0 -3.40282346639e+038 3.40282346639e+038 ECU_ADDRESS 0xD0076 FORMAT "%.15" /end MEASUREMENT
/begin MEASUREMENT Cal.EmptySlowLumpedWeightTemp2 "" FLOAT32_IEEE NO_COMPU_METHOD 0 0 -3.40282346639e+038 3.40282346639e+038 ECU_ADDRESS 0xD0077 FORMAT "%.15" /end MEASUREMENT
/begin MEASUREMENT Cal.EmptySlowLumpedWeightTemp3 "" FLOAT32_IEEE NO_COMPU_METHOD 0 0 -3.40282346639e+038 3.40282346639e+038 ECU_ADDRESS 0xD0078 FORMAT "%.15" /end MEASUREMENT
/begin MEASUREMENT Cal.FullSlowImuOffsetFinal "" FLOAT32_IEEE NO_COMPU_METHOD 0 0 -3.40282346639e+038 3.40282346639e+038 ECU_ADDRESS 0xD006C FORMAT "%.15" /end MEASUREMENT
/begin MEASUREMENT Cal.FullSlowImuOffsetTemp1 "" FLOAT32_IEEE NO_COMPU_METHOD 0 0 -3.40282346639e+038 3.40282346639e+038 ECU_ADDRESS 0xD006D FORMAT "%.15" /end MEASUREMENT
/begin MEASUREMENT Cal.FullSlowImuOffsetTemp2 "" FLOAT32_IEEE NO_COMPU_METHOD 0 0 -3.40282346639e+038 3.40282346639e+038 ECU_ADDRESS 0xD006E FORMAT "%.15" /end MEASUREMENT
/begin MEASUREMENT Cal.FullSlowImuOffsetTemp3 "" FLOAT32_IEEE NO_COMPU_METHOD 0 0 -3.40282346639e+038 3.40282346639e+038 ECU_ADDRESS 0xD006F FORMAT "%.15" /end MEASUREMENT
/begin MEASUREMENT Cal.FullSlowLumpedWeightTemp1 "" FLOAT32_IEEE NO_COMPU_METHOD 0 0 -3.40282346639e+038 3.40282346639e+038 ECU_ADDRESS 0xD0073 FORMAT "%.15" /end MEASUREMENT
/begin MEASUREMENT Cal.FullSlowLumpedWeightTemp2 "" FLOAT32_IEEE NO_COMPU_METHOD 0 0 -3.40282346639e+038 3.40282346639e+038 ECU_ADDRESS 0xD0074 FORMAT "%.15" /end MEASUREMENT
/begin MEASUREMENT Cal.FullSlowLumpedWeightTemp3 "" FLOAT32_IEEE NO_COMPU_METHOD 0 0 -3.40282346639e+038 3.40282346639e+038 ECU_ADDRESS 0xD0075 FORMAT "%.15" /end MEASUREMENT
/begin CHARACTERISTIC Cal.PCS_Vel_Slope "" VALUE 0xD0062 __FLOAT32_IEEE_S 0 NO_COMPU_METHOD -3.40282346639e+038 3.40282346639e+038 READ_ONLY FORMAT "%.15" /end CHARACTERISTIC
/begin CHARACTERISTIC Cal.PCS_cal_weight "" VALUE 0xD0063 __FLOAT32_IEEE_S 0 NO_COMPU_METHOD -3.40282346639e+038 3.40282346639e+038 READ_ONLY FORMAT "%.15" /end CHARACTERISTIC
/begin CHARACTERISTIC Cal.cal_adjust "" VALUE 0xD0065 __FLOAT32_IEEE_S 0 NO_COMPU_METHOD -3.40282346639e+038 3.40282346639e+038 READ_ONLY FORMAT "%.15" /end CHARACTERISTIC
/begin CHARACTERISTIC Cal.cal_adjust_temp "" VALUE 0xD006A __FLOAT32_IEEE_S 0 NO_COMPU_METHOD -3.40282346639e+038 3.40282346639e+038 READ_ONLY FORMAT "%.15" /end CHARACTERISTIC
/begin CHARACTERISTIC Cal.empty_bucket_weight_est "" VALUE 0xD0069 __FLOAT32_IEEE_S 0 NO_COMPU_METHOD -3.40282346639e+038 3.40282346639e+038 READ_ONLY FORMAT "%.15" /end CHARACTERISTIC
/begin CHARACTERISTIC Cal.empty_temp "" VALUE 0xD0067 __FLOAT32_IEEE_S 0 NO_COMPU_METHOD -3.40282346639e+038 3.40282346639e+038 READ_ONLY FORMAT "%.15" /end CHARACTERISTIC
/begin CHARACTERISTIC Cal.full_temp "" VALUE 0xD0068 __FLOAT32_IEEE_S 0 NO_COMPU_METHOD -3.40282346639e+038 3.40282346639e+038 READ_ONLY FORMAT "%.15" /end CHARACTERISTIC
/begin CHARACTERISTIC Cal.hyd_oil_type_index "" VALUE 0xD006B __ULONG_S 0 NO_COMPU_METHOD 0 4294967295 READ_ONLY FORMAT "%.15" /end CHARACTERISTIC
/begin CHARACTERISTIC Cal.lift_full_lower_DC_inf.val "" VALUE 0xD005E __SLONG_S 0 NO_COMPU_METHOD -2147483648 2147483647 READ_ONLY FORMAT "%.15" /end CHARACTERISTIC
/begin CHARACTERISTIC Cal.lift_full_raise_DC_inf.val "" VALUE 0xD005F __SLONG_S 0 NO_COMPU_METHOD -2147483648 2147483647 READ_ONLY FORMAT "%.15" /end CHARACTERISTIC
/begin AXIS_PTS Cal.lower_slow_empty_lift_ht "" 0xD0016 NO_INPUT_QUANTITY SSV__FLOAT32_IEEE_S 0 NO_COMPU_METHOD 11 -3.40282346639e+038 3.40282346639e+038 READ_ONLY DEPOSIT ABSOLUTE FORMAT "%.15" /end AXIS_PTS
/begin CHARACTERISTIC Cal.lower_slow_empty_lift_ht_0 "" VALUE 0xD0016 __FLOAT32_IEEE_S 0 NO_COMPU_METHOD -3.40282346639e+038 3.40282346639e+038 READ_ONLY FORMAT "%.15" /end CHARACTERISTIC
/begin CHARACTERISTIC Cal.lower_slow_empty_lift_ht_1 "" VALUE 0xD0017 __FLOAT32_IEEE_S 0 NO_COMPU_METHOD -3.40282346639e+038 3.40282346639e+038 READ_ONLY FORMAT "%.15" /end CHARACTERISTIC
/begin CHARACTERISTIC Cal.lower_slow_empty_lift_ht_10 "" VALUE 0xD0020 __FLOAT32_IEEE_S 0 NO_COMPU_METHOD -3.40282346639e+038 3.40282346639e+038 READ_ONLY FORMAT "%.15" /end CHARACTERISTIC
/begin CHARACTERISTIC Cal.lower_slow_empty_lift_ht_2 "" VALUE 0xD0018 __FLOAT32_IEEE_S 0 NO_COMPU_METHOD -3.40282346639e+038 3.40282346639e+038 READ_ONLY FORMAT "%.15" /end CHARACTERISTIC
/begin CHARACTERISTIC Cal.lower_slow_empty_lift_ht_3 "" VALUE 0xD0019 __FLOAT32_IEEE_S 0 NO_COMPU_METHOD -3.40282346639e+038 3.40282346639e+038 READ_ONLY FORMAT "%.15" /end CHARACTERISTIC
/begin CHARACTERISTIC Cal.lower_slow_empty_lift_ht_4 "" VALUE 0xD001A __FLOAT32_IEEE_S 0 NO_COMPU_METHOD -3.40282346639e+038 3.40282346639e+038 READ_ONLY FORMAT "%.15" /end CHARACTERISTIC
/begin CHARACTERISTIC Cal.lower_slow_empty_lift_ht_5 "" VALUE 0xD001B __FLOAT32_IEEE_S 0 NO_COMPU_METHOD -3.40282346639e+038 3.40282346639e+038 READ_ONLY FORMAT "%.15" /end CHARACTERISTIC
/begin CHARACTERISTIC Cal.lower_slow_empty_lift_ht_6 "" VALUE 0xD001C __FLOAT32_IEEE_S 0 NO_COMPU_METHOD -3.40282346639e+038 3.40282346639e+038 READ_ONLY FORMAT "%.15" /end CHARACTERISTIC
/begin CHARACTERISTIC Cal.lower_slow_empty_lift_ht_7 "" VALUE 0xD001D __FLOAT32_IEEE_S 0 NO_COMPU_METHOD -3.40282346639e+038 3.40282346639e+038 READ_ONLY FORMAT "%.15" /end CHARACTERISTIC
/begin CHARACTERISTIC Cal.lower_slow_empty_lift_ht_8 "" VALUE 0xD001E __FLOAT32_IEEE_S 0 NO_COMPU_METHOD -3.40282346639e+038 3.40282346639e+038 READ_ONLY FORMAT "%.15" /end CHARACTERISTIC
/begin CHARACTERISTIC Cal.lower_slow_empty_lift_ht_9 "" VALUE 0xD001F __FLOAT32_IEEE_S 0 NO_COMPU_METHOD -3.40282346639e+038 3.40282346639e+038 READ_ONLY FORMAT "%.15" /end CHARACTERISTIC
/begin CHARACTERISTIC Cal.lower_slow_empty_pres "" CURVE 0xD0021 __FLOAT32_IEEE_Z 0 NO_COMPU_METHOD -3.40282346639e+038 3.40282346639e+038 READ_ONLY
 /begin AXIS_DESCR COM_AXIS NO_INPUT_QUANTITY NO_COMPU_METHOD 11 -3.40282346639e+038 3.40282346639e+038 READ_ONLY DEPOSIT ABSOLUTE FORMAT "%.15" AXIS_PTS_REF Cal.lower_slow_empty_lift_ht /end AXIS_DESCR
 FORMAT "%.15" /end CHARACTERISTIC
/begin CHARACTERISTIC Cal.lower_slow_empty_pres_0 "" VALUE 0xD0021 __FLOAT32_IEEE_S 0 NO_COMPU_METHOD -3.40282346639e+038 3.40282346639e+038 READ_ONLY FORMAT "%.15" /end CHARACTERISTIC
/begin CHARACTERISTIC Cal.lower_slow_empty_pres_1 "" VALUE 0xD0022 __FLOAT32_IEEE_S 0 NO_COMPU_METHOD -3.40282346639e+038 3.40282346639e+038 READ_ONLY FORMAT "%.15" /end CHARACTERISTIC
/begin CHARACTERISTIC Cal.lower_slow_empty_pres_10 "" VALUE 0xD002B __FLOAT32_IEEE_S 0 NO_COMPU_METHOD -3.40282346639e+038 3.40282346639e+038 READ_ONLY FORMAT "%.15" /end CHARACTERISTIC
/begin CHARACTERISTIC Cal.lower_slow_empty_pres_2 "" VALUE 0xD0023 __FLOAT32_IEEE_S 0 NO_COMPU_METHOD -3.40282346639e+038 3.40282346639e+038 READ_ONLY FORMAT "%.15" /end CHARACTERISTIC
/begin CHARACTERISTIC Cal.lower_slow_empty_pres_3 "" VALUE 0xD0024 __FLOAT32_IEEE_S 0 NO_COMPU_METHOD -3.40282346639e+038 3.40282346639e+038 READ_ONLY FORMAT "%.15" /end CHARACTERISTIC
/begin CHARACTERISTIC Cal.lower_slow_empty_pres_4 "" VALUE 0xD0025 __FLOAT32_IEEE_S 0 NO_COMPU_METHOD -3.40282346639e+038 3.40282346639e+038 READ_ONLY FORMAT "%.15" /end CHARACTERISTIC
/begin CHARACTERISTIC Cal.lower_slow_empty_pres_5 "" VALUE 0xD0026 __FLOAT32_IEEE_S 0 NO_COMPU_METHOD -3.40282346639e+038 3.40282346639e+038 READ_ONLY FORMAT "%.15" /end CHARACTERISTIC
/begin CHARACTERISTIC Cal.lower_slow_empty_pres_6 "" VALUE 0xD0027 __FLOAT32_IEEE_S 0 NO_COMPU_METHOD -3.40282346639e+038 3.40282346639e+038 READ_ONLY FORMAT "%.15" /end CHARACTERISTIC
/begin CHARACTERISTIC Cal.lower_slow_empty_pres_7 "" VALUE 0xD0028 __FLOAT32_IEEE_S 0 NO_COMPU_METHOD -3.40282346639e+038 3.40282346639e+038 READ_ONLY FORMAT "%.15" /end CHARACTERISTIC
/begin CHARACTERISTIC Cal.lower_slow_empty_pres_8 "" VALUE 0xD0029 __FLOAT32_IEEE_S 0 NO_COMPU_METHOD -3.40282346639e+038 3.40282346639e+038 READ_ONLY FORMAT "%.15" /end CHARACTERISTIC
/begin CHARACTERISTIC Cal.lower_slow_empty_pres_9 "" VALUE 0xD002A __FLOAT32_IEEE_S 0 NO_COMPU_METHOD -3.40282346639e+038 3.40282346639e+038 READ_ONLY FORMAT "%.15" /end CHARACTERISTIC
/begin AXIS_PTS Cal.lower_slow_full_lift_ht "" 0xD0042 NO_INPUT_QUANTITY SSV__FLOAT32_IEEE_S 0 NO_COMPU_METHOD 11 -3.40282346639e+038 3.40282346639e+038 READ_ONLY DEPOSIT ABSOLUTE FORMAT "%.15" /end AXIS_PTS
/begin CHARACTERISTIC Cal.lower_slow_full_lift_ht_0 "" VALUE 0xD0042 __FLOAT32_IEEE_S 0 NO_COMPU_METHOD -3.40282346639e+038 3.40282346639e+038 READ_ONLY FORMAT "%.15" /end CHARACTERISTIC
/begin CHARACTERISTIC Cal.lower_slow_full_lift_ht_1 "" VALUE 0xD0043 __FLOAT32_IEEE_S 0 NO_COMPU_METHOD -3.40282346639e+038 3.40282346639e+038 READ_ONLY FORMAT "%.15" /end CHARACTERISTIC
/begin CHARACTERISTIC Cal.lower_slow_full_lift_ht_10 "" VALUE 0xD004C __FLOAT32_IEEE_S 0 NO_COMPU_METHOD -3.40282346639e+038 3.40282346639e+038 READ_ONLY FORMAT "%.15" /end CHARACTERISTIC
/begin CHARACTERISTIC Cal.lower_slow_full_lift_ht_2 "" VALUE 0xD0044 __FLOAT32_IEEE_S 0 NO_COMPU_METHOD -3.40282346639e+038 3.40282346639e+038 READ_ONLY FORMAT "%.15" /end CHARACTERISTIC
/begin CHARACTERISTIC Cal.lower_slow_full_lift_ht_3 "" VALUE 0xD0045 __FLOAT32_IEEE_S 0 NO_COMPU_METHOD -3.40282346639e+038 3.40282346639e+038 READ_ONLY FORMAT "%.15" /end CHARACTERISTIC
/begin CHARACTERISTIC Cal.lower_slow_full_lift_ht_4 "" VALUE 0xD0046 __FLOAT32_IEEE_S 0 NO_COMPU_METHOD -3.40282346639e+038 3.40282346639e+038 READ_ONLY FORMAT "%.15" /end CHARACTERISTIC
/begin CHARACTERISTIC Cal.lower_slow_full_lift_ht_5 "" VALUE 0xD0047 __FLOAT32_IEEE_S 0 NO_COMPU_METHOD -3.40282346639e+038 3.40282346639e+038 READ_ONLY FORMAT "%.15" /end CHARACTERISTIC
/begin CHARACTERISTIC Cal.lower_slow_full_lift_ht_6 "" VALUE 0xD0048 __FLOAT32_IEEE_S 0 NO_COMPU_METHOD -3.40282346639e+038 3.40282346639e+038 READ_ONLY FORMAT "%.15" /end CHARACTERISTIC
/begin CHARACTERISTIC Cal.lower_slow_full_lift_ht_7 "" VALUE 0xD0049 __FLOAT32_IEEE_S 0 NO_COMPU_METHOD -3.40282346639e+038 3.40282346639e+038 READ_ONLY FORMAT "%.15" /end CHARACTERISTIC
/begin CHARACTERISTIC Cal.lower_slow_full_lift_ht_8 "" VALUE 0xD004A __FLOAT32_IEEE_S 0 NO_COMPU_METHOD -3.40282346639e+038 3.40282346639e+038 READ_ONLY FORMAT "%.15" /end CHARACTERISTIC
/begin CHARACTERISTIC Cal.lower_slow_full_lift_ht_9 "" VALUE 0xD004B __FLOAT32_IEEE_S 0 NO_COMPU_METHOD -3.40282346639e+038 3.40282346639e+038 READ_ONLY FORMAT "%.15" /end CHARACTERISTIC
/begin CHARACTERISTIC Cal.lower_slow_full_pres "" CURVE 0xD004D __FLOAT32_IEEE_Z 0 NO_COMPU_METHOD -3.40282346639e+038 3.40282346639e+038 READ_ONLY
 /begin AXIS_DESCR COM_AXIS NO_INPUT_QUANTITY NO_COMPU_METHOD 11 -3.40282346639e+038 3.40282346639e+038 READ_ONLY DEPOSIT ABSOLUTE FORMAT "%.15" AXIS_PTS_REF Cal.lower_slow_full_lift_ht /end AXIS_DESCR
 FORMAT "%.15" /end CHARACTERISTIC
/begin CHARACTERISTIC Cal.lower_slow_full_pres_0 "" VALUE 0xD004D __FLOAT32_IEEE_S 0 NO_COMPU_METHOD -3.40282346639e+038 3.40282346639e+038 READ_ONLY FORMAT "%.15" /end CHARACTERISTIC
/begin CHARACTERISTIC Cal.lower_slow_full_pres_1 "" VALUE 0xD004E __FLOAT32_IEEE_S 0 NO_COMPU_METHOD -3.40282346639e+038 3.40282346639e+038 READ_ONLY FORMAT "%.15" /end CHARACTERISTIC
/begin CHARACTERISTIC Cal.lower_slow_full_pres_10 "" VALUE 0xD0057 __FLOAT32_IEEE_S 0 NO_COMPU_METHOD -3.40282346639e+038 3.40282346639e+038 READ_ONLY FORMAT "%.15" /end CHARACTERISTIC
/begin CHARACTERISTIC Cal.lower_slow_full_pres_2 "" VALUE 0xD004F __FLOAT32_IEEE_S 0 NO_COMPU_METHOD -3.40282346639e+038 3.40282346639e+038 READ_ONLY FORMAT "%.15" /end CHARACTERISTIC
/begin CHARACTERISTIC Cal.lower_slow_full_pres_3 "" VALUE 0xD0050 __FLOAT32_IEEE_S 0 NO_COMPU_METHOD -3.40282346639e+038 3.40282346639e+038 READ_ONLY FORMAT "%.15" /end CHARACTERISTIC
/begin CHARACTERISTIC Cal.lower_slow_full_pres_4 "" VALUE 0xD0051 __FLOAT32_IEEE_S 0 NO_COMPU_METHOD -3.40282346639e+038 3.40282346639e+038 READ_ONLY FORMAT "%.15" /end CHARACTERISTIC
/begin CHARACTERISTIC Cal.lower_slow_full_pres_5 "" VALUE 0xD0052 __FLOAT32_IEEE_S 0 NO_COMPU_METHOD -3.40282346639e+038 3.40282346639e+038 READ_ONLY FORMAT "%.15" /end CHARACTERISTIC
/begin CHARACTERISTIC Cal.lower_slow_full_pres_6 "" VALUE 0xD0053 __FLOAT32_IEEE_S 0 NO_COMPU_METHOD -3.40282346639e+038 3.40282346639e+038 READ_ONLY FORMAT "%.15" /end CHARACTERISTIC
/begin CHARACTERISTIC Cal.lower_slow_full_pres_7 "" VALUE 0xD0054 __FLOAT32_IEEE_S 0 NO_COMPU_METHOD -3.40282346639e+038 3.40282346639e+038 READ_ONLY FORMAT "%.15" /end CHARACTERISTIC
/begin CHARACTERISTIC Cal.lower_slow_full_pres_8 "" VALUE 0xD0055 __FLOAT32_IEEE_S 0 NO_COMPU_METHOD -3.40282346639e+038 3.40282346639e+038 READ_ONLY FORMAT "%.15" /end CHARACTERISTIC
/begin CHARACTERISTIC Cal.lower_slow_full_pres_9 "" VALUE 0xD0056 __FLOAT32_IEEE_S 0 NO_COMPU_METHOD -3.40282346639e+038 3.40282346639e+038 READ_ONLY FORMAT "%.15" /end CHARACTERISTIC
/begin CHARACTERISTIC Cal.raise_fast_delta_p_empty "" VALUE 0xD005A __FLOAT32_IEEE_S 0 NO_COMPU_METHOD -3.40282346639e+038 3.40282346639e+038 READ_ONLY FORMAT "%.15" /end CHARACTERISTIC
/begin CHARACTERISTIC Cal.raise_fast_delta_p_full "" VALUE 0xD005D __FLOAT32_IEEE_S 0 NO_COMPU_METHOD -3.40282346639e+038 3.40282346639e+038 READ_ONLY FORMAT "%.15" /end CHARACTERISTIC
/begin AXIS_PTS Cal.raise_slow_empty_lift_ht "" 0xD0000 NO_INPUT_QUANTITY SSV__FLOAT32_IEEE_S 0 NO_COMPU_METHOD 11 -3.40282346639e+038 3.40282346639e+038 READ_ONLY DEPOSIT ABSOLUTE FORMAT "%.15" /end AXIS_PTS
/begin CHARACTERISTIC Cal.raise_slow_empty_lift_ht_0 "" VALUE 0xD0000 __FLOAT32_IEEE_S 0 NO_COMPU_METHOD -3.40282346639e+038 3.40282346639e+038 READ_ONLY FORMAT "%.15" /end CHARACTERISTIC
/begin CHARACTERISTIC Cal.raise_slow_empty_lift_ht_1 "" VALUE 0xD0001 __FLOAT32_IEEE_S 0 NO_COMPU_METHOD -3.40282346639e+038 3.40282346639e+038 READ_ONLY FORMAT "%.15" /end CHARACTERISTIC
/begin CHARACTERISTIC Cal.raise_slow_empty_lift_ht_10 "" VALUE 0xD000A __FLOAT32_IEEE_S 0 NO_COMPU_METHOD -3.40282346639e+038 3.40282346639e+038 READ_ONLY FORMAT "%.15" /end CHARACTERISTIC
/begin CHARACTERISTIC Cal.raise_slow_empty_lift_ht_2 "" VALUE 0xD0002 __FLOAT32_IEEE_S 0 NO_COMPU_METHOD -3.40282346639e+038 3.40282346639e+038 READ_ONLY FORMAT "%.15" /end CHARACTERISTIC
/begin CHARACTERISTIC Cal.raise_slow_empty_lift_ht_3 "" VALUE 0xD0003 __FLOAT32_IEEE_S 0 NO_COMPU_METHOD -3.40282346639e+038 3.40282346639e+038 READ_ONLY FORMAT "%.15" /end CHARACTERISTIC
/begin CHARACTERISTIC Cal.raise_slow_empty_lift_ht_4 "" VALUE 0xD0004 __FLOAT32_IEEE_S 0 NO_COMPU_METHOD -3.40282346639e+038 3.40282346639e+038 READ_ONLY FORMAT "%.15" /end CHARACTERISTIC
/begin CHARACTERISTIC Cal.raise_slow_empty_lift_ht_5 "" VALUE 0xD0005 __FLOAT32_IEEE_S 0 NO_COMPU_METHOD -3.40282346639e+038 3.40282346639e+038 READ_ONLY FORMAT "%.15" /end CHARACTERISTIC
/begin CHARACTERISTIC Cal.raise_slow_empty_lift_ht_6 "" VALUE 0xD0006 __FLOAT32_IEEE_S 0 NO_COMPU_METHOD -3.40282346639e+038 3.40282346639e+038 READ_ONLY FORMAT "%.15" /end CHARACTERISTIC
/begin CHARACTERISTIC Cal.raise_slow_empty_lift_ht_7 "" VALUE 0xD0007 __FLOAT32_IEEE_S 0 NO_COMPU_METHOD -3.40282346639e+038 3.40282346639e+038 READ_ONLY FORMAT "%.15" /end CHARACTERISTIC
/begin CHARACTERISTIC Cal.raise_slow_empty_lift_ht_8 "" VALUE 0xD0008 __FLOAT32_IEEE_S 0 NO_COMPU_METHOD -3.40282346639e+038 3.40282346639e+038 READ_ONLY FORMAT "%.15" /end CHARACTERISTIC
/begin CHARACTERISTIC Cal.raise_slow_empty_lift_ht_9 "" VALUE 0xD0009 __FLOAT32_IEEE_S 0 NO_COMPU_METHOD -3.40282346639e+038 3.40282346639e+038 READ_ONLY FORMAT "%.15" /end CHARACTERISTIC
/begin CHARACTERISTIC Cal.raise_slow_empty_pres "" CURVE 0xD000B __FLOAT32_IEEE_Z 0 NO_COMPU_METHOD -3.40282346639e+038 3.40282346639e+038 READ_ONLY
 /begin AXIS_DESCR COM_AXIS NO_INPUT_QUANTITY NO_COMPU_METHOD 11 -3.40282346639e+038 3.40282346639e+038 READ_ONLY DEPOSIT ABSOLUTE FORMAT "%.15" AXIS_PTS_REF Cal.raise_slow_empty_lift_ht /end AXIS_DESCR
 FORMAT "%.15" /end CHARACTERISTIC
/begin CHARACTERISTIC Cal.raise_slow_empty_pres_0 "" VALUE 0xD000B __FLOAT32_IEEE_S 0 NO_COMPU_METHOD -3.40282346639e+038 3.40282346639e+038 READ_ONLY FORMAT "%.15" /end CHARACTERISTIC
/begin CHARACTERISTIC Cal.raise_slow_empty_pres_1 "" VALUE 0xD000C __FLOAT32_IEEE_S 0 NO_COMPU_METHOD -3.40282346639e+038 3.40282346639e+038 READ_ONLY FORMAT "%.15" /end CHARACTERISTIC
/begin CHARACTERISTIC Cal.raise_slow_empty_pres_10 "" VALUE 0xD0015 __FLOAT32_IEEE_S 0 NO_COMPU_METHOD -3.40282346639e+038 3.40282346639e+038 READ_ONLY FORMAT "%.15" /end CHARACTERISTIC
/begin CHARACTERISTIC Cal.raise_slow_empty_pres_2 "" VALUE 0xD000D __FLOAT32_IEEE_S 0 NO_COMPU_METHOD -3.40282346639e+038 3.40282346639e+038 READ_ONLY FORMAT "%.15" /end CHARACTERISTIC
/begin CHARACTERISTIC Cal.raise_slow_empty_pres_3 "" VALUE 0xD000E __FLOAT32_IEEE_S 0 NO_COMPU_METHOD -3.40282346639e+038 3.40282346639e+038 READ_ONLY FORMAT "%.15" /end CHARACTERISTIC
/begin CHARACTERISTIC Cal.raise_slow_empty_pres_4 "" VALUE 0xD000F __FLOAT32_IEEE_S 0 NO_COMPU_METHOD -3.40282346639e+038 3.40282346639e+038 READ_ONLY FORMAT "%.15" /end CHARACTERISTIC
/begin CHARACTERISTIC Cal.raise_slow_empty_pres_5 "" VALUE 0xD0010 __FLOAT32_IEEE_S 0 NO_COMPU_METHOD -3.40282346639e+038 3.40282346639e+038 READ_ONLY FORMAT "%.15" /end CHARACTERISTIC
/begin CHARACTERISTIC Cal.raise_slow_empty_pres_6 "" VALUE 0xD0011 __FLOAT32_IEEE_S 0 NO_COMPU_METHOD -3.40282346639e+038 3.40282346639e+038 READ_ONLY FORMAT "%.15" /end CHARACTERISTIC
/begin CHARACTERISTIC Cal.raise_slow_empty_pres_7 "" VALUE 0xD0012 __FLOAT32_IEEE_S 0 NO_COMPU_METHOD -3.40282346639e+038 3.40282346639e+038 READ_ONLY FORMAT "%.15" /end CHARACTERISTIC
/begin CHARACTERISTIC Cal.raise_slow_empty_pres_8 "" VALUE 0xD0013 __FLOAT32_IEEE_S 0 NO_COMPU_METHOD -3.40282346639e+038 3.40282346639e+038 READ_ONLY FORMAT "%.15" /end CHARACTERISTIC
/begin CHARACTERISTIC Cal.raise_slow_empty_pres_9 "" VALUE 0xD0014 __FLOAT32_IEEE_S 0 NO_COMPU_METHOD -3.40282346639e+038 3.40282346639e+038 READ_ONLY FORMAT "%.15" /end CHARACTERISTIC
/begin AXIS_PTS Cal.raise_slow_full_lift_ht "" 0xD002C NO_INPUT_QUANTITY SSV__FLOAT32_IEEE_S 0 NO_COMPU_METHOD 11 -3.40282346639e+038 3.40282346639e+038 READ_ONLY DEPOSIT ABSOLUTE FORMAT "%.15" /end AXIS_PTS
/begin CHARACTERISTIC Cal.raise_slow_full_lift_ht_0 "" VALUE 0xD002C __FLOAT32_IEEE_S 0 NO_COMPU_METHOD -3.40282346639e+038 3.40282346639e+038 READ_ONLY FORMAT "%.15" /end CHARACTERISTIC
/begin CHARACTERISTIC Cal.raise_slow_full_lift_ht_1 "" VALUE 0xD002D __FLOAT32_IEEE_S 0 NO_COMPU_METHOD -3.40282346639e+038 3.40282346639e+038 READ_ONLY FORMAT "%.15" /end CHARACTERISTIC
/begin CHARACTERISTIC Cal.raise_slow_full_lift_ht_10 "" VALUE 0xD0036 __FLOAT32_IEEE_S 0 NO_COMPU_METHOD -3.40282346639e+038 3.40282346639e+038 READ_ONLY FORMAT "%.15" /end CHARACTERISTIC
/begin CHARACTERISTIC Cal.raise_slow_full_lift_ht_2 "" VALUE 0xD002E __FLOAT32_IEEE_S 0 NO_COMPU_METHOD -3.40282346639e+038 3.40282346639e+038 READ_ONLY FORMAT "%.15" /end CHARACTERISTIC
/begin CHARACTERISTIC Cal.raise_slow_full_lift_ht_3 "" VALUE 0xD002F __FLOAT32_IEEE_S 0 NO_COMPU_METHOD -3.40282346639e+038 3.40282346639e+038 READ_ONLY FORMAT "%.15" /end CHARACTERISTIC
/begin CHARACTERISTIC Cal.raise_slow_full_lift_ht_4 "" VALUE 0xD0030 __FLOAT32_IEEE_S 0 NO_COMPU_METHOD -3.40282346639e+038 3.40282346639e+038 READ_ONLY FORMAT "%.15" /end CHARACTERISTIC
/begin CHARACTERISTIC Cal.raise_slow_full_lift_ht_5 "" VALUE 0xD0031 __FLOAT32_IEEE_S 0 NO_COMPU_METHOD -3.40282346639e+038 3.40282346639e+038 READ_ONLY FORMAT "%.15" /end CHARACTERISTIC
/begin CHARACTERISTIC Cal.raise_slow_full_lift_ht_6 "" VALUE 0xD0032 __FLOAT32_IEEE_S 0 NO_COMPU_METHOD -3.40282346639e+038 3.40282346639e+038 READ_ONLY FORMAT "%.15" /end CHARACTERISTIC
/begin CHARACTERISTIC Cal.raise_slow_full_lift_ht_7 "" VALUE 0xD0033 __FLOAT32_IEEE_S 0 NO_COMPU_METHOD -3.40282346639e+038 3.40282346639e+038 READ_ONLY FORMAT "%.15" /end CHARACTERISTIC
/begin CHARACTERISTIC Cal.raise_slow_full_lift_ht_8 "" VALUE 0xD0034 __FLOAT32_IEEE_S 0 NO_COMPU_METHOD -3.40282346639e+038 3.40282346639e+038 READ_ONLY FORMAT "%.15" /end CHARACTERISTIC
/begin CHARACTERISTIC Cal.raise_slow_full_lift_ht_9 "" VALUE 0xD0035 __FLOAT32_IEEE_S 0 NO_COMPU_METHOD -3.40282346639e+038 3.40282346639e+038 READ_ONLY FORMAT "%.15" /end CHARACTERISTIC
/begin CHARACTERISTIC Cal.raise_slow_full_pres "" CURVE 0xD0037 __FLOAT32_IEEE_Z 0 NO_COMPU_METHOD -3.40282346639e+038 3.40282346639e+038 READ_ONLY
 /begin AXIS_DESCR COM_AXIS NO_INPUT_QUANTITY NO_COMPU_METHOD 11 -3.40282346639e+038 3.40282346639e+038 READ_ONLY DEPOSIT ABSOLUTE FORMAT "%.15" AXIS_PTS_REF Cal.raise_slow_full_lift_ht /end AXIS_DESCR
 FORMAT "%.15" /end CHARACTERISTIC
/begin CHARACTERISTIC Cal.raise_slow_full_pres_0 "" VALUE 0xD0037 __FLOAT32_IEEE_S 0 NO_COMPU_METHOD -3.40282346639e+038 3.40282346639e+038 READ_ONLY FORMAT "%.15" /end CHARACTERISTIC
/begin CHARACTERISTIC Cal.raise_slow_full_pres_1 "" VALUE 0xD0038 __FLOAT32_IEEE_S 0 NO_COMPU_METHOD -3.40282346639e+038 3.40282346639e+038 READ_ONLY FORMAT "%.15" /end CHARACTERISTIC
/begin CHARACTERISTIC Cal.raise_slow_full_pres_10 "" VALUE 0xD0041 __FLOAT32_IEEE_S 0 NO_COMPU_METHOD -3.40282346639e+038 3.40282346639e+038 READ_ONLY FORMAT "%.15" /end CHARACTERISTIC
/begin CHARACTERISTIC Cal.raise_slow_full_pres_2 "" VALUE 0xD0039 __FLOAT32_IEEE_S 0 NO_COMPU_METHOD -3.40282346639e+038 3.40282346639e+038 READ_ONLY FORMAT "%.15" /end CHARACTERISTIC
/begin CHARACTERISTIC Cal.raise_slow_full_pres_3 "" VALUE 0xD003A __FLOAT32_IEEE_S 0 NO_COMPU_METHOD -3.40282346639e+038 3.40282346639e+038 READ_ONLY FORMAT "%.15" /end CHARACTERISTIC
/begin CHARACTERISTIC Cal.raise_slow_full_pres_4 "" VALUE 0xD003B __FLOAT32_IEEE_S 0 NO_COMPU_METHOD -3.40282346639e+038 3.40282346639e+038 READ_ONLY FORMAT "%.15" /end CHARACTERISTIC
/begin CHARACTERISTIC Cal.raise_slow_full_pres_5 "" VALUE 0xD003C __FLOAT32_IEEE_S 0 NO_COMPU_METHOD -3.40282346639e+038 3.40282346639e+038 READ_ONLY FORMAT "%.15" /end CHARACTERISTIC
/begin CHARACTERISTIC Cal.raise_slow_full_pres_6 "" VALUE 0xD003D __FLOAT32_IEEE_S 0 NO_COMPU_METHOD -3.40282346639e+038 3.40282346639e+038 READ_ONLY FORMAT "%.15" /end CHARACTERISTIC
/begin CHARACTERISTIC Cal.raise_slow_full_pres_7 "" VALUE 0xD003E __FLOAT32_IEEE_S 0 NO_COMPU_METHOD -3.40282346639e+038 3.40282346639e+038 READ_ONLY FORMAT "%.15" /end CHARACTERISTIC
/begin CHARACTERISTIC Cal.raise_slow_full_pres_8 "" VALUE 0xD003F __FLOAT32_IEEE_S 0 NO_COMPU_METHOD -3.40282346639e+038 3.40282346639e+038 READ_ONLY FORMAT "%.15" /end CHARACTERISTIC
/begin CHARACTERISTIC Cal.raise_slow_full_pres_9 "" VALUE 0xD0040 __FLOAT32_IEEE_S 0 NO_COMPU_METHOD -3.40282346639e+038 3.40282346639e+038 READ_ONLY FORMAT "%.15" /end CHARACTERISTIC
/begin CHARACTERISTIC Cal.raise_speed_empty_fast "" VALUE 0xD0059 __FLOAT32_IEEE_S 0 NO_COMPU_METHOD -3.40282346639e+038 3.40282346639e+038 READ_ONLY FORMAT "%.15" /end CHARACTERISTIC
/begin CHARACTERISTIC Cal.raise_speed_empty_slow "" VALUE 0xD0058 __FLOAT32_IEEE_S 0 NO_COMPU_METHOD -3.40282346639e+038 3.40282346639e+038 READ_ONLY FORMAT "%.15" /end CHARACTERISTIC
/begin CHARACTERISTIC Cal.raise_speed_full_fast "" VALUE 0xD005C __FLOAT32_IEEE_S 0 NO_COMPU_METHOD -3.40282346639e+038 3.40282346639e+038 READ_ONLY FORMAT "%.15" /end CHARACTERISTIC
/begin CHARACTERISTIC Cal.raise_speed_full_slow "" VALUE 0xD005B __FLOAT32_IEEE_S 0 NO_COMPU_METHOD -3.40282346639e+038 3.40282346639e+038 READ_ONLY FORMAT "%.15" /end CHARACTERISTIC
/begin CHARACTERISTIC Cal.temp_slope "" VALUE 0xD0066 __FLOAT32_IEEE_S 0 NO_COMPU_METHOD -3.40282346639e+038 3.40282346639e+038 READ_ONLY FORMAT "%.15" /end CHARACTERISTIC
/begin CHARACTERISTIC Cal.tilt_full_dump_DC_inf.val "" VALUE 0xD0060 __SLONG_S 0 NO_COMPU_METHOD -2147483648 2147483647 READ_ONLY FORMAT "%.15" /end CHARACTERISTIC
/begin CHARACTERISTIC Cal.tilt_full_rack_DC_inf.val "" VALUE 0xD0061 __SLONG_S 0 NO_COMPU_METHOD -2147483648 2147483647 READ_ONLY FORMAT "%.15" /end CHARACTERISTIC
/begin CHARACTERISTIC Cal.zero_weight "" VALUE 0xD0064 __FLOAT32_IEEE_S 0 NO_COMPU_METHOD -3.40282346639e+038 3.40282346639e+038 READ_ONLY FORMAT "%.15" /end CHARACTERISTIC
/begin MEASUREMENT CalOTF.Curve.EmptySlowImuOffsetFinal "" FLOAT32_IEEE NO_COMPU_METHOD 0 0 -3.40282346639e+038 3.40282346639e+038 ECU_ADDRESS 0xE0030 FORMAT "%.15" /end MEASUREMENT
/begin MEASUREMENT CalOTF.Curve.EmptySlowImuOffsetTemp1 "" FLOAT32_IEEE NO_COMPU_METHOD 0 0 -3.40282346639e+038 3.40282346639e+038 ECU_ADDRESS 0xE001B FORMAT "%.15" /end MEASUREMENT
/begin MEASUREMENT CalOTF.Curve.EmptySlowImuOffsetTemp2 "" FLOAT32_IEEE NO_COMPU_METHOD 0 0 -3.40282346639e+038 3.40282346639e+038 ECU_ADDRESS 0xE001C FORMAT "%.15" /end MEASUREMENT
/begin MEASUREMENT CalOTF.Curve.EmptySlowImuOffsetTemp3 "" FLOAT32_IEEE NO_COMPU_METHOD 0 0 -3.40282346639e+038 3.40282346639e+038 ECU_ADDRESS 0xE001D FORMAT "%.15" /end MEASUREMENT
/begin MEASUREMENT CalOTF.Curve.EmptySlowLumpedWeightFinal "" FLOAT32_IEEE NO_COMPU_METHOD 0 0 -3.40282346639e+038 3.40282346639e+038 ECU_ADDRESS 0xE0032 FORMAT "%.15" /end MEASUREMENT
/begin MEASUREMENT CalOTF.Curve.EmptySlowLumpedWeightTemp1 "" FLOAT32_IEEE NO_COMPU_METHOD 0 0 -3.40282346639e+038 3.40282346639e+038 ECU_ADDRESS 0xE002D FORMAT "%.15" /end MEASUREMENT
/begin MEASUREMENT CalOTF.Curve.EmptySlowLumpedWeightTemp2 "" FLOAT32_IEEE NO_COMPU_METHOD 0 0 -3.40282346639e+038 3.40282346639e+038 ECU_ADDRESS 0xE002E FORMAT "%.15" /end MEASUREMENT
/begin MEASUREMENT CalOTF.Curve.EmptySlowLumpedWeightTemp3 "" FLOAT32_IEEE NO_COMPU_METHOD 0 0 -3.40282346639e+038 3.40282346639e+038 ECU_ADDRESS 0xE002F FORMAT "%.15" /end MEASUREMENT
/begin MEASUREMENT CalOTF.Curve.EnforceLowerDetent "" ULONG NO_COMPU_METHOD 0 0 0 4294967295 ECU_ADDRESS 0xE0006 FORMAT "%.15" /end MEASUREMENT
/begin MEASUREMENT CalOTF.Curve.EnforceRaiseDetent "" ULONG NO_COMPU_METHOD 0 0 0 4294967295 ECU_ADDRESS 0xE0005 FORMAT "%.15" /end MEASUREMENT
/begin MEASUREMENT CalOTF.Curve.FullSlowImuOffsetFinal "" FLOAT32_IEEE NO_COMPU_METHOD 0 0 -3.40282346639e+038 3.40282346639e+038 ECU_ADDRESS 0xE0017 FORMAT "%.15" /end MEASUREMENT
/begin MEASUREMENT CalOTF.Curve.FullSlowImuOffsetTemp1 "" FLOAT32_IEEE NO_COMPU_METHOD 0 0 -3.40282346639e+038 3.40282346639e+038 ECU_ADDRESS 0xE0018 FORMAT "%.15" /end MEASUREMENT
/begin MEASUREMENT CalOTF.Curve.FullSlowImuOffsetTemp2 "" FLOAT32_IEEE NO_COMPU_METHOD 0 0 -3.40282346639e+038 3.40282346639e+038 ECU_ADDRESS 0xE0019 FORMAT "%.15" /end MEASUREMENT
/begin MEASUREMENT CalOTF.Curve.FullSlowImuOffsetTemp3 "" FLOAT32_IEEE NO_COMPU_METHOD 0 0 -3.40282346639e+038 3.40282346639e+038 ECU_ADDRESS 0xE001A FORMAT "%.15" /end MEASUREMENT
/begin MEASUREMENT CalOTF.Curve.FullSlowLumpedWeightFinal "" FLOAT32_IEEE NO_COMPU_METHOD 0 0 -3.40282346639e+038 3.40282346639e+038 ECU_ADDRESS 0xE0031 FORMAT "%.15" /end MEASUREMENT
/begin MEASUREMENT CalOTF.Curve.FullSlowLumpedWeightTemp1 "" FLOAT32_IEEE NO_COMPU_METHOD 0 0 -3.40282346639e+038 3.40282346639e+038 ECU_ADDRESS 0xE002A FORMAT "%.15" /end MEASUREMENT
/begin MEASUREMENT CalOTF.Curve.FullSlowLumpedWeightTemp2 "" FLOAT32_IEEE NO_COMPU_METHOD 0 0 -3.40282346639e+038 3.40282346639e+038 ECU_ADDRESS 0xE002B FORMAT "%.15" /end MEASUREMENT
/begin MEASUREMENT CalOTF.Curve.FullSlowLumpedWeightTemp3 "" FLOAT32_IEEE NO_COMPU_METHOD 0 0 -3.40282346639e+038 3.40282346639e+038 ECU_ADDRESS 0xE002C FORMAT "%.15" /end MEASUREMENT
/begin MEASUREMENT CalOTF.Curve.HydOilTempMet "" ULONG NO_COMPU_METHOD 0 0 0 4294967295 ECU_ADDRESS 0xE0004 FORMAT "%.15" /end MEASUREMENT
/begin MEASUREMENT CalOTF.Curve.InternalStep "" ULONG NO_COMPU_METHOD 0 0 0 4294967295 ECU_ADDRESS 0xE000B FORMAT "%.15" /end MEASUREMENT
/begin MEASUREMENT CalOTF.Curve.LowerNumPoints "" UWORD NO_COMPU_METHOD 0 0 0 65535 ECU_ADDRESS 0xE0016 FORMAT "%.15" /end MEASUREMENT
/begin MEASUREMENT CalOTF.Curve.LowerSlowFitDone "" ULONG NO_COMPU_METHOD 0 0 0 4294967295 ECU_ADDRESS 0xE000A FORMAT "%.15" /end MEASUREMENT
/begin MEASUREMENT CalOTF.Curve.RaiseFastFitDone "" ULONG NO_COMPU_METHOD 0 0 0 4294967295 ECU_ADDRESS 0xE0009 FORMAT "%.15" /end MEASUREMENT
/begin MEASUREMENT CalOTF.Curve.RaiseFastVelDone "" ULONG NO_COMPU_METHOD 0 0 0 4294967295 ECU_ADDRESS 0xE0007 FORMAT "%.15" /end MEASUREMENT
/begin MEASUREMENT CalOTF.Curve.RaiseNumPoints "" UWORD NO_COMPU_METHOD 0 0 0 65535 ECU_ADDRESS 0xE0015 FORMAT "%.15" /end MEASUREMENT
/begin MEASUREMENT CalOTF.Curve.RaiseSlowFitDone "" ULONG NO_COMPU_METHOD 0 0 0 4294967295 ECU_ADDRESS 0xE0008 FORMAT "%.15" /end MEASUREMENT
/begin MEASUREMENT CalOTF.Flags.CalInProgress "" ULONG NO_COMPU_METHOD 0 0 0 4294967295 ECU_ADDRESS 0xE0000 FORMAT "%.15" /end MEASUREMENT
/begin MEASUREMENT CalOTF.Flags.EmptyBktCalDone "" ULONG NO_COMPU_METHOD 0 0 0 4294967295 ECU_ADDRESS 0xE0002 FORMAT "%.15" /end MEASUREMENT
/begin MEASUREMENT CalOTF.Flags.FullBktCalDone "" ULONG NO_COMPU_METHOD 0 0 0 4294967295 ECU_ADDRESS 0xE0003 FORMAT "%.15" /end MEASUREMENT
/begin MEASUREMENT CalOTF.Flags.PayloadCalFlag "" ULONG NO_COMPU_METHOD 0 0 0 4294967295 ECU_ADDRESS 0xE0001 FORMAT "%.15" /end MEASUREMENT
/begin MEASUREMENT CalOTF.Stat.BktAngle_Stat "" ULONG NO_COMPU_METHOD 0 0 0 4294967295 ECU_ADDRESS 0xE0012 FORMAT "%.15" /end MEASUREMENT
/begin MEASUREMENT CalOTF.Stat.HydOilTemp_Stat "" ULONG NO_COMPU_METHOD 0 0 0 4294967295 ECU_ADDRESS 0xE000F FORMAT "%.15" /end MEASUREMENT
/begin MEASUREMENT CalOTF.Stat.LeverInfoAvailable "" ULONG NO_COMPU_METHOD 0 0 0 4294967295 ECU_ADDRESS 0xE0013 FORMAT "%.15" /end MEASUREMENT
/begin MEASUREMENT CalOTF.Stat.LeverInfoFaulted "" ULONG NO_COMPU_METHOD 0 0 0 4294967295 ECU_ADDRESS 0xE0014 FORMAT "%.15" /end MEASUREMENT
/begin MEASUREMENT CalOTF.Stat.LiftCylExt_Stat "" ULONG NO_COMPU_METHOD 0 0 0 4294967295 ECU_ADDRESS 0xE000E FORMAT "%.15" /end MEASUREMENT
/begin MEASUREMENT CalOTF.Stat.LiftCylVel_Stat "" ULONG NO_COMPU_METHOD 0 0 0 4294967295 ECU_ADDRESS 0xE0010 FORMAT "%.15" /end MEASUREMENT
/begin MEASUREMENT CalOTF.Stat.LiftHePres_Stat "" ULONG NO_COMPU_METHOD 0 0 0 4294967295 ECU_ADDRESS 0xE000C FORMAT "%.15" /end MEASUREMENT
/begin MEASUREMENT CalOTF.Stat.LiftRePres_Stat "" ULONG NO_COMPU_METHOD 0 0 0 4294967295 ECU_ADDRESS 0xE000D FORMAT "%.15" /end MEASUREMENT
/begin MEASUREMENT CalOTF.Stat.TiltCylExt_Stat "" ULONG NO_COMPU_METHOD 0 0 0 4294967295 ECU_ADDRESS 0xE0011 FORMAT "%.15" /end MEASUREMENT
/begin MEASUREMENT CalOTF.TiltOverrides.CalTiltOverrideComplete "" UBYTE NO_COMPU_METHOD 0 0 0 255 ECU_ADDRESS 0xE0033 FORMAT "%.15" /end MEASUREMENT
/begin MEASUREMENT CalOTF.TiltOverrides.CalTiltOverrideFail "" UBYTE NO_COMPU_METHOD 0 0 0 255 ECU_ADDRESS 0xE0034 FORMAT "%.15" /end MEASUREMENT
/begin MEASUREMENT CalOTF.TiltOverrides.CountOfSamples "" UBYTE NO_COMPU_METHOD 0 0 0 255 ECU_ADDRESS 0xE0035 FORMAT "%.15" /end MEASUREMENT
/begin MEASUREMENT CalOTF.TiltOverrides.DesiredTiltExtmm "" FLOAT32_IEEE NO_COMPU_METHOD 0 0 -3.40282346639e+038 3.40282346639e+038 ECU_ADDRESS 0xE0036 FORMAT "%.15" /end MEASUREMENT
/begin MEASUREMENT CalOTF.TiltOverrides.LpsCalTiltOvrStartRequest "" UBYTE NO_COMPU_METHOD 0 0 0 255 ECU_ADDRESS 0xE0037 FORMAT "%.15" /end MEASUREMENT
/begin MEASUREMENT CalOTF.TiltOverrides.LpsCalTiltOvrState "" UBYTE NO_COMPU_METHOD 0 0 0 255 ECU_ADDRESS 0xE0038 FORMAT "%.15" /end MEASUREMENT
/begin MEASUREMENT CalOTF.TiltOverrides.TiltDumpCmdOvr "" FLOAT32_IEEE NO_COMPU_METHOD 0 0 -3.40282346639e+038 3.40282346639e+038 ECU_ADDRESS 0xE0039 FORMAT "%.15" /end MEASUREMENT
/begin MEASUREMENT CalOTF.TiltOverrides.TiltNoiseMax "" FLOAT32_IEEE NO_COMPU_METHOD 0 0 -3.40282346639e+038 3.40282346639e+038 ECU_ADDRESS 0xE003A FORMAT "%.15" /end MEASUREMENT
/begin MEASUREMENT CalOTF.TiltOverrides.TiltNoiseMin "" FLOAT32_IEEE NO_COMPU_METHOD 0 0 -3.40282346639e+038 3.40282346639e+038 ECU_ADDRESS 0xE003B FORMAT "%.15" /end MEASUREMENT
/begin MEASUREMENT CalOTF.calOverrides.CalOvrAcknowledge "" SBYTE NO_COMPU_METHOD 0 0 -128 127 ECU_ADDRESS 0xE0029 FORMAT "%.15" /end MEASUREMENT
/begin MEASUREMENT CalOTF.calOverrides.LeverInfo.Faulted "" SBYTE NO_COMPU_METHOD 0 0 -128 127 ECU_ADDRESS 0xE0024 FORMAT "%.15" /end MEASUREMENT
/begin MEASUREMENT CalOTF.calOverrides.LeverInfo.InCenter "" SBYTE NO_COMPU_METHOD 0 0 -128 127 ECU_ADDRESS 0xE0025 FORMAT "%.15" /end MEASUREMENT
/begin MEASUREMENT CalOTF.calOverrides.LeverInfo.InLowerDetent "" SBYTE NO_COMPU_METHOD 0 0 -128 127 ECU_ADDRESS 0xE0026 FORMAT "%.15" /end MEASUREMENT
/begin MEASUREMENT CalOTF.calOverrides.LeverInfo.InRaiseDetent "" SBYTE NO_COMPU_METHOD 0 0 -128 127 ECU_ADDRESS 0xE0027 FORMAT "%.15" /end MEASUREMENT
/begin MEASUREMENT CalOTF.calOverrides.LeverInfo.ValveCmdPercent "" FLOAT32_IEEE NO_COMPU_METHOD 0 0 -3.40282346639e+038 3.40282346639e+038 ECU_ADDRESS 0xE0028 FORMAT "%.15" /end MEASUREMENT
/begin MEASUREMENT CalOTF.calOverrides.LiftBottomFlag "" SBYTE NO_COMPU_METHOD 0 0 -128 127 ECU_ADDRESS 0xE001F FORMAT "%.15" /end MEASUREMENT
/begin MEASUREMENT CalOTF.calOverrides.LiftTopFlag "" SBYTE NO_COMPU_METHOD 0 0 -128 127 ECU_ADDRESS 0xE0020 FORMAT "%.15" /end MEASUREMENT
/begin MEASUREMENT CalOTF.calOverrides.LpsCalAppInfCalOvrActive "" SBYTE NO_COMPU_METHOD 0 0 -128 127 ECU_ADDRESS 0xE0021 FORMAT "%.15" /end MEASUREMENT
/begin MEASUREMENT CalOTF.calOverrides.LpsCalAppInfLowerCmdLmt "" SBYTE NO_COMPU_METHOD 0 0 -128 127 ECU_ADDRESS 0xE0022 FORMAT "%.15" /end MEASUREMENT
/begin MEASUREMENT CalOTF.calOverrides.LpsCalAppInfRaiseCmdLmt "" SBYTE NO_COMPU_METHOD 0 0 -128 127 ECU_ADDRESS 0xE0023 FORMAT "%.15" /end MEASUREMENT
/begin MEASUREMENT CalOTF.calOverrides.LpsCalOvrState "" SBYTE NO_COMPU_METHOD 0 0 -128 127 ECU_ADDRESS 0xE001E FORMAT "%.15" /end MEASUREMENT
/begin MEASUREMENT CycleSeg.ActiveSegmentId "" UBYTE NO_COMPU_METHOD 0 0 0 255 ECU_ADDRESS 0x80000 FORMAT "%.15" /end MEASUREMENT
/begin MEASUREMENT CycleSeg.DigState "0 = Inactive, 1 = Tentative, 2 = Active" UBYTE NO_COMPU_METHOD 0 0 0 255 ECU_ADDRESS 0x80001 FORMAT "%.15" /end MEASUREMENT
/begin MEASUREMENT CycleSeg.SegLastCompletedId "" UBYTE NO_COMPU_METHOD 0 0 0 255 ECU_ADDRESS 0x80002 FORMAT "%.15" /end MEASUREMENT
/begin MEASUREMENT CycleSeg.SegSecondsSinceLastEnd "" FLOAT32_IEEE NO_COMPU_METHOD 0 0 -3.40282346639e+038 3.40282346639e+038 ECU_ADDRESS 0x80003 FORMAT "%.15" PHYS_UNIT "s" /end MEASUREMENT
/begin MEASUREMENT CycleSeg.SegSequenceNumber "" UBYTE NO_COMPU_METHOD 0 0 0 255 ECU_ADDRESS 0x80004 FORMAT "%.15" /end MEASUREMENT
/begin MEASUREMENT CycleSeg.cycleSegIn.ARD_fuel_rate "" UWORD NO_COMPU_METHOD 0 0 0 65535 ECU_ADDRESS 0x8001A FORMAT "%.15" /end MEASUREMENT
/begin MEASUREMENT CycleSeg.cycleSegIn.Engine_Load_Factor "" SWORD NO_COMPU_METHOD 0 0 -32768 32767 ECU_ADDRESS 0x80024 FORMAT "%.15" /end MEASUREMENT
/begin MEASUREMENT CycleSeg.cycleSegIn.GPS_latitude "" ULONG NO_COMPU_METHOD 0 0 0 4294967295 ECU_ADDRESS 0x8001B FORMAT "%.15" /end MEASUREMENT
/begin MEASUREMENT CycleSeg.cycleSegIn.GPS_longitude "" ULONG NO_COMPU_METHOD 0 0 0 4294967295 ECU_ADDRESS 0x8001C FORMAT "%.15" /end MEASUREMENT
/begin MEASUREMENT CycleSeg.cycleSegIn.GPS_status "" UBYTE NO_COMPU_METHOD 0 0 0 255 ECU_ADDRESS 0x8001D FORMAT "%.15" /end MEASUREMENT
/begin MEASUREMENT CycleSeg.cycleSegIn.bucket_angle "" SWORD NO_COMPU_METHOD 0 0 -32768 32767 ECU_ADDRESS 0x8000C FORMAT "%.15" /end MEASUREMENT
/begin MEASUREMENT CycleSeg.cycleSegIn.desired_gear "" SWORD NO_COMPU_METHOD 0 0 -32768 32767 ECU_ADDRESS 0x8000E FORMAT "%.15" /end MEASUREMENT
/begin MEASUREMENT CycleSeg.cycleSegIn.engine_spd_rpm "" SWORD NO_COMPU_METHOD 0 0 -32768 32767 ECU_ADDRESS 0x8000F FORMAT "%.15" /end MEASUREMENT
/begin MEASUREMENT CycleSeg.cycleSegIn.extForceNormalized "" SWORD NO_COMPU_METHOD 0 0 -32768 32767 ECU_ADDRESS 0x80022 FORMAT "%.15" /end MEASUREMENT
/begin MEASUREMENT CycleSeg.cycleSegIn.fuel_rate "" UWORD NO_COMPU_METHOD 0 0 0 65535 ECU_ADDRESS 0x80019 FORMAT "%.15" /end MEASUREMENT
/begin MEASUREMENT CycleSeg.cycleSegIn.ground_spd_kph "" SWORD NO_COMPU_METHOD 0 0 -32768 32767 ECU_ADDRESS 0x80005 FORMAT "%.15" /end MEASUREMENT
/begin MEASUREMENT CycleSeg.cycleSegIn.impl_operation_status "" UWORD NO_COMPU_METHOD 0 0 0 65535 ECU_ADDRESS 0x80023 FORMAT "%.15" /end MEASUREMENT
/begin MEASUREMENT CycleSeg.cycleSegIn.keyswitch_state "" UWORD NO_COMPU_METHOD 0 0 0 65535 ECU_ADDRESS 0x80013 FORMAT "%.15" /end MEASUREMENT
/begin MEASUREMENT CycleSeg.cycleSegIn.lift_angle "" SWORD NO_COMPU_METHOD 0 0 -32768 32767 ECU_ADDRESS 0x8000D FORMAT "%.15" /end MEASUREMENT
/begin MEASUREMENT CycleSeg.cycleSegIn.lift_valve_cmd "" SWORD NO_COMPU_METHOD 0 0 -32768 32767 ECU_ADDRESS 0x8000A FORMAT "%.15" /end MEASUREMENT
/begin MEASUREMENT CycleSeg.cycleSegIn.machine_idle_status "" UWORD NO_COMPU_METHOD 0 0 0 65535 ECU_ADDRESS 0x80012 FORMAT "%.15" /end MEASUREMENT
/begin MEASUREMENT CycleSeg.cycleSegIn.payload_calc_method "" UWORD NO_COMPU_METHOD 0 0 0 65535 ECU_ADDRESS 0x80021 FORMAT "%.15" /end MEASUREMENT
/begin MEASUREMENT CycleSeg.cycleSegIn.payload_ratio "" FLOAT32_IEEE NO_COMPU_METHOD 0 0 -3.40282346639e+038 3.40282346639e+038 ECU_ADDRESS 0x80006 FORMAT "%.15" /end MEASUREMENT
/begin MEASUREMENT CycleSeg.cycleSegIn.payload_ratio_raw "" FLOAT32_IEEE NO_COMPU_METHOD 0 0 -3.40282346639e+038 3.40282346639e+038 ECU_ADDRESS 0x80008 FORMAT "%.15" /end MEASUREMENT
/begin MEASUREMENT CycleSeg.cycleSegIn.payload_ratio_raw_status "" UWORD NO_COMPU_METHOD 0 0 0 65535 ECU_ADDRESS 0x80009 FORMAT "%.15" /end MEASUREMENT
/begin MEASUREMENT CycleSeg.cycleSegIn.payload_ratio_status "" UWORD NO_COMPU_METHOD 0 0 0 65535 ECU_ADDRESS 0x80007 FORMAT "%.15" /end MEASUREMENT
/begin MEASUREMENT CycleSeg.cycleSegIn.payload_weight "" FLOAT32_IEEE NO_COMPU_METHOD 0 0 -3.40282346639e+038 3.40282346639e+038 ECU_ADDRESS 0x8001F FORMAT "%.15" /end MEASUREMENT
/begin MEASUREMENT CycleSeg.cycleSegIn.payload_weight_status "" UWORD NO_COMPU_METHOD 0 0 0 65535 ECU_ADDRESS 0x80020 FORMAT "%.15" /end MEASUREMENT
/begin MEASUREMENT CycleSeg.cycleSegIn.realTime_status "" UBYTE NO_COMPU_METHOD 0 0 0 255 ECU_ADDRESS 0x80015 FORMAT "%.15" /end MEASUREMENT
/begin MEASUREMENT CycleSeg.cycleSegIn.real_time "" ULONG NO_COMPU_METHOD 0 0 0 4294967295 ECU_ADDRESS 0x80014 FORMAT "%.15" /end MEASUREMENT
/begin MEASUREMENT CycleSeg.cycleSegIn.service_hour_meter "" ULONG NO_COMPU_METHOD 0 0 0 4294967295 ECU_ADDRESS 0x8001E FORMAT "%.15" /end MEASUREMENT
/begin MEASUREMENT CycleSeg.cycleSegIn.tilt_cyl_pos "" UWORD NO_COMPU_METHOD 0 0 0 65535 ECU_ADDRESS 0x80011 FORMAT "%.15" /end MEASUREMENT
/begin MEASUREMENT CycleSeg.cycleSegIn.tilt_lever_cmd "" SWORD NO_COMPU_METHOD 0 0 -32768 32767 ECU_ADDRESS 0x80010 FORMAT "%.15" /end MEASUREMENT
/begin MEASUREMENT CycleSeg.cycleSegIn.tilt_valve_cmd "" SWORD NO_COMPU_METHOD 0 0 -32768 32767 ECU_ADDRESS 0x8000B FORMAT "%.15" /end MEASUREMENT
/begin MEASUREMENT CycleSeg.cycleSegIn.timezone_offset "" SWORD NO_COMPU_METHOD 0 0 -32768 32767 ECU_ADDRESS 0x80016 FORMAT "%.15" /end MEASUREMENT
/begin MEASUREMENT CycleSeg.cycleSegIn.total_fuel_high_res "" ULONG NO_COMPU_METHOD 0 0 0 4294967295 ECU_ADDRESS 0x80017 FORMAT "%.15" /end MEASUREMENT
/begin MEASUREMENT CycleSeg.cycleSegIn.total_fuel_low_res "" ULONG NO_COMPU_METHOD 0 0 0 4294967295 ECU_ADDRESS 0x80018 FORMAT "%.15" /end MEASUREMENT
/begin MEASUREMENT CycleSeg.cycleSegOut.commit_rec_gps "" UBYTE NO_COMPU_METHOD 0 0 0 255 ECU_ADDRESS 0x80032 FORMAT "%.15" /end MEASUREMENT
/begin MEASUREMENT CycleSeg.cycleSegOut.commit_segment_record "" UBYTE NO_COMPU_METHOD 0 0 0 255 ECU_ADDRESS 0x80025 FORMAT "%.15" /end MEASUREMENT
/begin MEASUREMENT CycleSeg.cycleSegOut.keyswitch_override_flag "" UBYTE NO_COMPU_METHOD 0 0 0 255 ECU_ADDRESS 0x80037 FORMAT "%.15" /end MEASUREMENT
/begin MEASUREMENT CycleSeg.cycleSegOut.segment_active_segment_id "" UBYTE NO_COMPU_METHOD 0 0 0 255 ECU_ADDRESS 0x80038 FORMAT "%.15" /end MEASUREMENT
/begin MEASUREMENT CycleSeg.cycleSegOut.segment_dig_state "" UBYTE NO_COMPU_METHOD 0 0 0 255 ECU_ADDRESS 0x80033 FORMAT "%.15" /end MEASUREMENT
/begin MEASUREMENT CycleSeg.cycleSegOut.segment_last_completed_id "" UBYTE NO_COMPU_METHOD 0 0 0 255 ECU_ADDRESS 0x80034 FORMAT "%.15" /end MEASUREMENT
/begin MEASUREMENT CycleSeg.cycleSegOut.segment_rec_distance "" FLOAT32_IEEE NO_COMPU_METHOD 0 0 -3.40282346639e+038 3.40282346639e+038 ECU_ADDRESS 0x80029 FORMAT "%.15" /end MEASUREMENT
/begin MEASUREMENT CycleSeg.cycleSegOut.segment_rec_duration "" ULONG NO_COMPU_METHOD 0 0 0 4294967295 ECU_ADDRESS 0x80028 FORMAT "%.15" /end MEASUREMENT
/begin MEASUREMENT CycleSeg.cycleSegOut.segment_rec_fuel_used "" FLOAT32_IEEE NO_COMPU_METHOD 0 0 -3.40282346639e+038 3.40282346639e+038 ECU_ADDRESS 0x8002B FORMAT "%.15" /end MEASUREMENT
/begin MEASUREMENT CycleSeg.cycleSegOut.segment_rec_hour_meter "" ULONG NO_COMPU_METHOD 0 0 0 4294967295 ECU_ADDRESS 0x8002F FORMAT "%.15" /end MEASUREMENT
/begin MEASUREMENT CycleSeg.cycleSegOut.segment_rec_idle_time "" ULONG NO_COMPU_METHOD 0 0 0 4294967295 ECU_ADDRESS 0x8002E FORMAT "%.15" /end MEASUREMENT
/begin MEASUREMENT CycleSeg.cycleSegOut.segment_rec_latitude "" ULONG NO_COMPU_METHOD 0 0 0 4294967295 ECU_ADDRESS 0x8002C FORMAT "%.15" /end MEASUREMENT
/begin MEASUREMENT CycleSeg.cycleSegOut.segment_rec_longitude "" ULONG NO_COMPU_METHOD 0 0 0 4294967295 ECU_ADDRESS 0x8002D FORMAT "%.15" /end MEASUREMENT
/begin MEASUREMENT CycleSeg.cycleSegOut.segment_rec_payload "" FLOAT32_IEEE NO_COMPU_METHOD 0 0 -3.40282346639e+038 3.40282346639e+038 ECU_ADDRESS 0x80030 FORMAT "%.15" /end MEASUREMENT
/begin MEASUREMENT CycleSeg.cycleSegOut.segment_rec_payload_calc_method "" UWORD NO_COMPU_METHOD 0 0 0 65535 ECU_ADDRESS 0x80031 FORMAT "%.15" /end MEASUREMENT
/begin MEASUREMENT CycleSeg.cycleSegOut.segment_rec_start_real_time "" ULONG NO_COMPU_METHOD 0 0 0 4294967295 ECU_ADDRESS 0x8002A FORMAT "%.15" /end MEASUREMENT
/begin MEASUREMENT CycleSeg.cycleSegOut.segment_rec_start_simTime "" ULONG NO_COMPU_METHOD 0 0 0 4294967295 ECU_ADDRESS 0x80027 FORMAT "%.15" /end MEASUREMENT
/begin MEASUREMENT CycleSeg.cycleSegOut.segment_record_id "" UBYTE NO_COMPU_METHOD 0 0 0 255 ECU_ADDRESS 0x80026 FORMAT "%.15" /end MEASUREMENT
/begin MEASUREMENT CycleSeg.cycleSegOut.segment_sequence_number "" UBYTE NO_COMPU_METHOD 0 0 0 255 ECU_ADDRESS 0x80036 FORMAT "%.15" /end MEASUREMENT
/begin MEASUREMENT CycleSeg.cycleSegOut.segment_time_since_last_end "" ULONG NO_COMPU_METHOD 0 0 0 4294967295 ECU_ADDRESS 0x80035 FORMAT "%.15" /end MEASUREMENT
/begin MEASUREMENT Display.Counter "" SLONG NO_COMPU_METHOD 0 0 -2147483648 2147483647 ECU_ADDRESS 0x1100FF FORMAT "%.15" /end MEASUREMENT
/begin MEASUREMENT Display.DocumentId "" UWORD NO_COMPU_METHOD 0 0 0 65535 ECU_ADDRESS 0x110003 FORMAT "%.15" /end MEASUREMENT
/begin MEASUREMENT Display.HeartbeatCount "" ULONG NO_COMPU_METHOD 0 0 0 4294967295 ECU_ADDRESS 0x110000 FORMAT "%.15" /end MEASUREMENT
/begin MEASUREMENT Display.InServiceMode "" SBYTE NO_COMPU_METHOD 0 0 -128 127 ECU_ADDRESS 0x110002 FORMAT "%.15" /end MEASUREMENT
/begin MEASUREMENT Display.ServiceModeCodeEntered "" SBYTE NO_COMPU_METHOD 0 0 -128 127 ECU_ADDRESS 0x110001 FORMAT "%.15" /end MEASUREMENT
/begin MEASUREMENT Health.availableDisk0Memory_kb "" ULONG NO_COMPU_METHOD 0 0 0 4294967295 ECU_ADDRESS 0xF FORMAT "%.15" /end MEASUREMENT
/begin MEASUREMENT Health.availableSystemMemory_kb "" ULONG NO_COMPU_METHOD 0 0 0 4294967295 ECU_ADDRESS 0x1 FORMAT "%.15" /end MEASUREMENT
/begin MEASUREMENT Health.battery_voltage "" FLOAT32_IEEE NO_COMPU_METHOD 0 0 -3.40282346639e+038 3.40282346639e+038 ECU_ADDRESS 0xD FORMAT "%.15" /end MEASUREMENT
/begin MEASUREMENT Health.disk0Usage_percent "" FLOAT32_IEEE NO_COMPU_METHOD 0 0 -3.40282346639e+038 3.40282346639e+038 ECU_ADDRESS 0x10 FORMAT "%.15" /end MEASUREMENT
/begin MEASUREMENT Health.eth0_rx_kbs "" FLOAT32_IEEE NO_COMPU_METHOD 0 0 -3.40282346639e+038 3.40282346639e+038 ECU_ADDRESS 0x7 FORMAT "%.15" /end MEASUREMENT
/begin MEASUREMENT Health.eth0_tx_kbs "" FLOAT32_IEEE NO_COMPU_METHOD 0 0 -3.40282346639e+038 3.40282346639e+038 ECU_ADDRESS 0x6 FORMAT "%.15" /end MEASUREMENT
/begin MEASUREMENT Health.eth1_rx_kbs "" FLOAT32_IEEE NO_COMPU_METHOD 0 0 -3.40282346639e+038 3.40282346639e+038 ECU_ADDRESS 0x9 FORMAT "%.15" /end MEASUREMENT
/begin MEASUREMENT Health.eth1_tx_kbs "" FLOAT32_IEEE NO_COMPU_METHOD 0 0 -3.40282346639e+038 3.40282346639e+038 ECU_ADDRESS 0x8 FORMAT "%.15" /end MEASUREMENT
/begin MEASUREMENT Health.loadAvg15min "" FLOAT32_IEEE NO_COMPU_METHOD 0 0 -3.40282346639e+038 3.40282346639e+038 ECU_ADDRESS 0x5 FORMAT "%.15" /end MEASUREMENT
/begin MEASUREMENT Health.loadAvg1min "" FLOAT32_IEEE NO_COMPU_METHOD 0 0 -3.40282346639e+038 3.40282346639e+038 ECU_ADDRESS 0x3 FORMAT "%.15" /end MEASUREMENT
/begin MEASUREMENT Health.loadAvg5min "" FLOAT32_IEEE NO_COMPU_METHOD 0 0 -3.40282346639e+038 3.40282346639e+038 ECU_ADDRESS 0x4 FORMAT "%.15" /end MEASUREMENT
/begin MEASUREMENT Health.systemCpuIOWait_percent "" FLOAT32_IEEE NO_COMPU_METHOD 0 0 -3.40282346639e+038 3.40282346639e+038 ECU_ADDRESS 0xB FORMAT "%.15" /end MEASUREMENT
/begin MEASUREMENT Health.systemCpuIrq_percent "" FLOAT32_IEEE NO_COMPU_METHOD 0 0 -3.40282346639e+038 3.40282346639e+038 ECU_ADDRESS 0xC FORMAT "%.15" /end MEASUREMENT
/begin MEASUREMENT Health.systemCpuUsage_percent "" FLOAT32_IEEE NO_COMPU_METHOD 0 0 -3.40282346639e+038 3.40282346639e+038 ECU_ADDRESS 0xA FORMAT "%.15" /end MEASUREMENT
/begin MEASUREMENT Health.systemUpTime_sec "" FLOAT32_IEEE NO_COMPU_METHOD 0 0 -3.40282346639e+038 3.40282346639e+038 ECU_ADDRESS 0x2 FORMAT "%.15" /end MEASUREMENT
/begin MEASUREMENT Health.totalSystemMemory_kb "" ULONG NO_COMPU_METHOD 0 0 0 4294967295 ECU_ADDRESS 0xE FORMAT "%.15" /end MEASUREMENT
/begin MEASUREMENT JobMgrDebug.Counter "" SLONG NO_COMPU_METHOD 0 0 -2147483648 2147483647 ECU_ADDRESS 0xB00FF FORMAT "%.15" /end MEASUREMENT
/begin MEASUREMENT JobMgrDebug.CurrentState "" SLONG NO_COMPU_METHOD 0 0 -2147483648 2147483647 ECU_ADDRESS 0xB0000 FORMAT "%.15" /end MEASUREMENT
/begin MEASUREMENT JobMgrReq.ClearReqst "" SBYTE NO_COMPU_METHOD 0 0 -128 127 ECU_ADDRESS 0x90002 FORMAT "%.15" /end MEASUREMENT
/begin MEASUREMENT JobMgrReq.Counter "" SLONG NO_COMPU_METHOD 0 0 -2147483648 2147483647 ECU_ADDRESS 0x900FF FORMAT "%.15" /end MEASUREMENT
/begin MEASUREMENT JobMgrReq.ManualTipOffActReqst "" SBYTE NO_COMPU_METHOD 0 0 -128 127 ECU_ADDRESS 0x90007 FORMAT "%.15" /end MEASUREMENT
/begin MEASUREMENT JobMgrReq.ManualTipOffDeactReqst "" SBYTE NO_COMPU_METHOD 0 0 -128 127 ECU_ADDRESS 0x90008 FORMAT "%.15" /end MEASUREMENT
/begin MEASUREMENT JobMgrReq.MinusOneReqst "" SBYTE NO_COMPU_METHOD 0 0 -128 127 ECU_ADDRESS 0x90001 FORMAT "%.15" /end MEASUREMENT
/begin MEASUREMENT JobMgrReq.ReWeighReqst "" SBYTE NO_COMPU_METHOD 0 0 -128 127 ECU_ADDRESS 0x9000D FORMAT "%.15" /end MEASUREMENT
/begin MEASUREMENT JobMgrReq.StandByActReqst "" SBYTE NO_COMPU_METHOD 0 0 -128 127 ECU_ADDRESS 0x90004 FORMAT "%.15" /end MEASUREMENT
/begin MEASUREMENT JobMgrReq.StandByDeactReqst "" SBYTE NO_COMPU_METHOD 0 0 -128 127 ECU_ADDRESS 0x90005 FORMAT "%.15" /end MEASUREMENT
/begin MEASUREMENT JobMgrReq.StoreReqst "" SBYTE NO_COMPU_METHOD 0 0 -128 127 ECU_ADDRESS 0x90003 FORMAT "%.15" /end MEASUREMENT
/begin MEASUREMENT JobMgrReq.TargetWeightReqst "" SBYTE NO_COMPU_METHOD 0 0 -128 127 ECU_ADDRESS 0x9000E FORMAT "%.15" /end MEASUREMENT
/begin MEASUREMENT JobMgrReq.TargetWeightReqstVal "" FLOAT32_IEEE NO_COMPU_METHOD 0 0 -3.40282346639e+038 3.40282346639e+038 ECU_ADDRESS 0x9000F FORMAT "%.15" PHYS_UNIT "tonnes" /end MEASUREMENT
/begin MEASUREMENT JobMgrReq.TipOffStateReqst "" SBYTE NO_COMPU_METHOD 0 0 -128 127 ECU_ADDRESS 0x9000B FORMAT "%.15" /end MEASUREMENT
/begin MEASUREMENT JobMgrReq.TipOffStateReqstVal "" SLONG NO_COMPU_METHOD 0 0 -2147483648 2147483647 ECU_ADDRESS 0x9000C FORMAT "%.15" /end MEASUREMENT
/begin MEASUREMENT JobMgrReq.TipOffToggleReqst "" SBYTE NO_COMPU_METHOD 0 0 -128 127 ECU_ADDRESS 0x90006 FORMAT "%.15" /end MEASUREMENT
/begin MEASUREMENT JobMgrReq.TipOffTriggerReqst "" SBYTE NO_COMPU_METHOD 0 0 -128 127 ECU_ADDRESS 0x90009 FORMAT "%.15" /end MEASUREMENT
/begin MEASUREMENT JobMgrReq.TipOffTriggerReqstVal "" SLONG NO_COMPU_METHOD 0 0 -2147483648 2147483647 ECU_ADDRESS 0x9000A FORMAT "%.15" /end MEASUREMENT
/begin MEASUREMENT JobMgrReq.ZeroReqst "" SBYTE NO_COMPU_METHOD 0 0 -128 127 ECU_ADDRESS 0x90000 FORMAT "%.15" /end MEASUREMENT
/begin MEASUREMENT JobMgrResp.ClearResp "" SLONG NO_COMPU_METHOD 0 0 -2147483648 2147483647 ECU_ADDRESS 0xA0002 FORMAT "%.15" /end MEASUREMENT
/begin MEASUREMENT JobMgrResp.Counter "" SLONG NO_COMPU_METHOD 0 0 -2147483648 2147483647 ECU_ADDRESS 0xA00FF FORMAT "%.15" /end MEASUREMENT
/begin MEASUREMENT JobMgrResp.MinusOneResp "" SLONG NO_COMPU_METHOD 0 0 -2147483648 2147483647 ECU_ADDRESS 0xA0001 FORMAT "%.15" /end MEASUREMENT
/begin MEASUREMENT JobMgrResp.ReWeighResp "" SLONG NO_COMPU_METHOD 0 0 -2147483648 2147483647 ECU_ADDRESS 0xA0009 FORMAT "%.15" /end MEASUREMENT
/begin MEASUREMENT JobMgrResp.StandByActResp "" SLONG NO_COMPU_METHOD 0 0 -2147483648 2147483647 ECU_ADDRESS 0xA0004 FORMAT "%.15" /end MEASUREMENT
/begin MEASUREMENT JobMgrResp.StandByDeactResp "" SLONG NO_COMPU_METHOD 0 0 -2147483648 2147483647 ECU_ADDRESS 0xA0005 FORMAT "%.15" /end MEASUREMENT
/begin MEASUREMENT JobMgrResp.StoreResp "" SLONG NO_COMPU_METHOD 0 0 -2147483648 2147483647 ECU_ADDRESS 0xA0003 FORMAT "%.15" /end MEASUREMENT
/begin MEASUREMENT JobMgrResp.TargetWeightResp "" SLONG NO_COMPU_METHOD 0 0 -2147483648 2147483647 ECU_ADDRESS 0xA000A FORMAT "%.15" /end MEASUREMENT
/begin MEASUREMENT JobMgrResp.TipOffActResp "" SLONG NO_COMPU_METHOD 0 0 -2147483648 2147483647 ECU_ADDRESS 0xA0007 FORMAT "%.15" /end MEASUREMENT
/begin MEASUREMENT JobMgrResp.TipOffDeactResp "" SLONG NO_COMPU_METHOD 0 0 -2147483648 2147483647 ECU_ADDRESS 0xA0008 FORMAT "%.15" /end MEASUREMENT
/begin MEASUREMENT JobMgrResp.TipOffStateResp "" SLONG NO_COMPU_METHOD 0 0 -2147483648 2147483647 ECU_ADDRESS 0xA000C FORMAT "%.15" /end MEASUREMENT
/begin MEASUREMENT JobMgrResp.TipOffToggleResp "" SLONG NO_COMPU_METHOD 0 0 -2147483648 2147483647 ECU_ADDRESS 0xA0006 FORMAT "%.15" /end MEASUREMENT
/begin MEASUREMENT JobMgrResp.TipOffTriggerResp "" SLONG NO_COMPU_METHOD 0 0 -2147483648 2147483647 ECU_ADDRESS 0xA000B FORMAT "%.15" /end MEASUREMENT
/begin MEASUREMENT JobMgrResp.ZeroResp "" SLONG NO_COMPU_METHOD 0 0 -2147483648 2147483647 ECU_ADDRESS 0xA0000 FORMAT "%.15" /end MEASUREMENT
/begin MEASUREMENT JobMgrTx.ClearMinusOneEnableStat "" SLONG NO_COMPU_METHOD 0 0 -2147483648 2147483647 ECU_ADDRESS 0x60009 FORMAT "%.15" /end MEASUREMENT
/begin MEASUREMENT JobMgrTx.Counter "" SLONG NO_COMPU_METHOD 0 0 -2147483648 2147483647 ECU_ADDRESS 0x600FF FORMAT "%.15" /end MEASUREMENT
/begin MEASUREMENT JobMgrTx.DispBestBktWt.IsOk "boolean" SLONG NO_COMPU_METHOD 0 0 -2147483648 2147483647 ECU_ADDRESS 0x6000B FORMAT "%.15" /end MEASUREMENT
/begin MEASUREMENT JobMgrTx.DispBestBktWt.Val "" FLOAT32_IEEE NO_COMPU_METHOD 0 0 -3.40282346639e+038 3.40282346639e+038 ECU_ADDRESS 0x6000A FORMAT "%.15" PHYS_UNIT "tonnes" /end MEASUREMENT
/begin MEASUREMENT JobMgrTx.ManualTipOffState "" SLONG NO_COMPU_METHOD 0 0 -2147483648 2147483647 ECU_ADDRESS 0x60004 FORMAT "%.15" /end MEASUREMENT
/begin MEASUREMENT JobMgrTx.MaterialId "" SLONG NO_COMPU_METHOD 0 0 -2147483648 2147483647 ECU_ADDRESS 0x60003 FORMAT "%.15" /end MEASUREMENT
/begin MEASUREMENT JobMgrTx.OperationMode "" SLONG NO_COMPU_METHOD 0 0 -2147483648 2147483647 ECU_ADDRESS 0x60007 FORMAT "%.15" /end MEASUREMENT
/begin MEASUREMENT JobMgrTx.PassCount "" SWORD NO_COMPU_METHOD 0 0 -32768 32767 ECU_ADDRESS 0x60000 FORMAT "%.15" /end MEASUREMENT
/begin MEASUREMENT JobMgrTx.StandbyState "" SLONG NO_COMPU_METHOD 0 0 -2147483648 2147483647 ECU_ADDRESS 0x60008 FORMAT "%.15" /end MEASUREMENT
/begin MEASUREMENT JobMgrTx.TipOffState "" SLONG NO_COMPU_METHOD 0 0 -2147483648 2147483647 ECU_ADDRESS 0x60006 FORMAT "%.15" /end MEASUREMENT
/begin MEASUREMENT JobMgrTx.TipOffStateCfg "" SLONG NO_COMPU_METHOD 0 0 -2147483648 2147483647 ECU_ADDRESS 0x6000C FORMAT "%.15" /end MEASUREMENT
/begin MEASUREMENT JobMgrTx.TipOffTriggerType "" SLONG NO_COMPU_METHOD 0 0 -2147483648 2147483647 ECU_ADDRESS 0x60005 FORMAT "%.15" /end MEASUREMENT
/begin MEASUREMENT JobMgrTx.TruckTargetWeight "" FLOAT32_IEEE NO_COMPU_METHOD 0 0 -3.40282346639e+038 3.40282346639e+038 ECU_ADDRESS 0x60001 FORMAT "%.15" PHYS_UNIT "tonnes" /end MEASUREMENT
/begin MEASUREMENT JobMgrTx.TruckWeight "" FLOAT32_IEEE NO_COMPU_METHOD 0 0 -3.40282346639e+038 3.40282346639e+038 ECU_ADDRESS 0x60002 FORMAT "%.15" PHYS_UNIT "tonnes" /end MEASUREMENT
/begin MEASUREMENT Pwm.ActualTimeUs "" SLONG NO_COMPU_METHOD 0 0 -2147483648 2147483647 ECU_ADDRESS 0x70000 FORMAT "%.15" /end MEASUREMENT
/begin MEASUREMENT Pwm.Counter "" SLONG NO_COMPU_METHOD 0 0 -2147483648 2147483647 ECU_ADDRESS 0x700FF FORMAT "%.15" /end MEASUREMENT
/begin MEASUREMENT Pwm.DiffTime "" SLONG NO_COMPU_METHOD 0 0 -2147483648 2147483647 ECU_ADDRESS 0x70002 FORMAT "%.15" /end MEASUREMENT
/begin MEASUREMENT Pwm.ExecTime "" SLONG NO_COMPU_METHOD 0 0 -2147483648 2147483647 ECU_ADDRESS 0x70001 FORMAT "%.15" /end MEASUREMENT
/begin MEASUREMENT Pwm.Exp "" ULONG NO_COMPU_METHOD 0 0 0 4294967295 ECU_ADDRESS 0x70003 FORMAT "%.15" /end MEASUREMENT
/begin MEASUREMENT Pwm.Period._0_ "" SLONG NO_COMPU_METHOD 0 0 -2147483648 2147483647 ECU_ADDRESS 0x70008 FORMAT "%.15" /end MEASUREMENT
/begin MEASUREMENT Pwm.Period._1_ "" SLONG NO_COMPU_METHOD 0 0 -2147483648 2147483647 ECU_ADDRESS 0x70009 FORMAT "%.15" /end MEASUREMENT
/begin MEASUREMENT Pwm.Period._2_ "" SLONG NO_COMPU_METHOD 0 0 -2147483648 2147483647 ECU_ADDRESS 0x7000A FORMAT "%.15" /end MEASUREMENT
/begin MEASUREMENT Pwm.Period._3_ "" SLONG NO_COMPU_METHOD 0 0 -2147483648 2147483647 ECU_ADDRESS 0x7000B FORMAT "%.15" /end MEASUREMENT
/begin MEASUREMENT Pwm.Width._0_ "" SLONG NO_COMPU_METHOD 0 0 -2147483648 2147483647 ECU_ADDRESS 0x70004 FORMAT "%.15" /end MEASUREMENT
/begin MEASUREMENT Pwm.Width._1_ "" SLONG NO_COMPU_METHOD 0 0 -2147483648 2147483647 ECU_ADDRESS 0x70005 FORMAT "%.15" /end MEASUREMENT
/begin MEASUREMENT Pwm.Width._2_ "" SLONG NO_COMPU_METHOD 0 0 -2147483648 2147483647 ECU_ADDRESS 0x70006 FORMAT "%.15" /end MEASUREMENT
/begin MEASUREMENT Pwm.Width._3_ "" SLONG NO_COMPU_METHOD 0 0 -2147483648 2147483647 ECU_ADDRESS 0x70007 FORMAT "%.15" /end MEASUREMENT
/begin MEASUREMENT Switch.Counter "" SLONG NO_COMPU_METHOD 0 0 -2147483648 2147483647 ECU_ADDRESS 0xC00FF FORMAT "%.15" /end MEASUREMENT
/begin MEASUREMENT Switch.STG3 "" SLONG NO_COMPU_METHOD 0 0 -2147483648 2147483647 ECU_ADDRESS 0xC0000 FORMAT "%.15" /end MEASUREMENT
/begin MEASUREMENT TOAtestPts.Counter "" ULONG NO_COMPU_METHOD 0 0 0 4294967295 ECU_ADDRESS 0x1200FF FORMAT "%.15" /end MEASUREMENT
/begin MEASUREMENT TOAtestPts.toa_appNumber "" ULONG NO_COMPU_METHOD 0 0 0 4294967295 ECU_ADDRESS 0x12000E FORMAT "%.15" DISPLAY_IDENTIFIER toa_appNumber DISCRETE /end MEASUREMENT
/begin MEASUREMENT TOAtestPts.toa_imuNeefGravX "" FLOAT32_IEEE NO_COMPU_METHOD 0 0 -3.40282346639e+038 3.40282346639e+038 ECU_ADDRESS 0x120042 FORMAT "%.15" DISPLAY_IDENTIFIER toa_imuNeefGravX PHYS_UNIT "m/s^2" /end MEASUREMENT
/begin MEASUREMENT TOAtestPts.toa_imuNeefGravY "" FLOAT32_IEEE NO_COMPU_METHOD 0 0 -3.40282346639e+038 3.40282346639e+038 ECU_ADDRESS 0x120043 FORMAT "%.15" DISPLAY_IDENTIFIER toa_imuNeefGravY PHYS_UNIT "m/s^2" /end MEASUREMENT
/begin MEASUREMENT TOAtestPts.toa_imuNeefGravZ "" FLOAT32_IEEE NO_COMPU_METHOD 0 0 -3.40282346639e+038 3.40282346639e+038 ECU_ADDRESS 0x120044 FORMAT "%.15" DISPLAY_IDENTIFIER toa_imuNeefGravZ PHYS_UNIT "m/s^2" /end MEASUREMENT
/begin MEASUREMENT TOAtestPts.toa_imuNeefPitch "" FLOAT32_IEEE NO_COMPU_METHOD 0 0 -3.40282346639e+038 3.40282346639e+038 ECU_ADDRESS 0x120045 FORMAT "%.15" DISPLAY_IDENTIFIER toa_imuNeefPitch PHYS_UNIT "degrees" /end MEASUREMENT
/begin MEASUREMENT TOAtestPts.toa_imuRawEefAcclX "" FLOAT32_IEEE NO_COMPU_METHOD 0 0 -3.40282346639e+038 3.40282346639e+038 ECU_ADDRESS 0x12003F FORMAT "%.15" DISPLAY_IDENTIFIER toa_imuRawEefAcclX PHYS_UNIT "m/s^2" /end MEASUREMENT
/begin MEASUREMENT TOAtestPts.toa_imuRawEefAcclY "" FLOAT32_IEEE NO_COMPU_METHOD 0 0 -3.40282346639e+038 3.40282346639e+038 ECU_ADDRESS 0x120040 FORMAT "%.15" DISPLAY_IDENTIFIER toa_imuRawEefAcclY PHYS_UNIT "m/s^2" /end MEASUREMENT
/begin MEASUREMENT TOAtestPts.toa_imuRawEefAcclZ "" FLOAT32_IEEE NO_COMPU_METHOD 0 0 -3.40282346639e+038 3.40282346639e+038 ECU_ADDRESS 0x120041 FORMAT "%.15" DISPLAY_IDENTIFIER toa_imuRawEefAcclZ PHYS_UNIT "m/s^2" /end MEASUREMENT
/begin MEASUREMENT TOAtestPts.toa_imu_cal_pitch_angle "" FLOAT32_IEEE NO_COMPU_METHOD 0 0 -3.40282346639e+038 3.40282346639e+038 ECU_ADDRESS 0x12000D FORMAT "%.15" DISPLAY_IDENTIFIER toa_imu_cal_pitch_angle PHYS_UNIT "degrees" /end MEASUREMENT
/begin MEASUREMENT TOAtestPts.toa_liftBoreDia "" FLOAT32_IEEE NO_COMPU_METHOD 0 0 -3.40282346639e+038 3.40282346639e+038 ECU_ADDRESS 0x120012 FORMAT "%.15" DISPLAY_IDENTIFIER toa_liftBoreDia PHYS_UNIT "mm" /end MEASUREMENT
/begin MEASUREMENT TOAtestPts.toa_liftRodDia "" FLOAT32_IEEE NO_COMPU_METHOD 0 0 -3.40282346639e+038 3.40282346639e+038 ECU_ADDRESS 0x120013 FORMAT "%.15" DISPLAY_IDENTIFIER toa_liftRodDia PHYS_UNIT "mm" /end MEASUREMENT
/begin MEASUREMENT TOAtestPts.toa_lwLpfPost "" FLOAT32_IEEE NO_COMPU_METHOD 0 0 -3.40282346639e+038 3.40282346639e+038 ECU_ADDRESS 0x120009 FORMAT "%.15" DISPLAY_IDENTIFIER toa_lwLpfPost PHYS_UNIT "tonne" /end MEASUREMENT
/begin MEASUREMENT TOAtestPts.toa_lwSpillRate "" FLOAT32_IEEE NO_COMPU_METHOD 0 0 -3.40282346639e+038 3.40282346639e+038 ECU_ADDRESS 0x12001F FORMAT "%.15" DISPLAY_IDENTIFIER toa_lwSpillRate PHYS_UNIT "tonne/sec" /end MEASUREMENT
/begin MEASUREMENT TOAtestPts.toa_lwStatus "" UBYTE TOAtestPts.toa_lwStatus.CONVERSION 0 0 0 255 ECU_ADDRESS 0x120020 FORMAT "%.15" DISPLAY_IDENTIFIER toa_lwStatus DISCRETE /end MEASUREMENT
/begin MEASUREMENT TOAtestPts.toa_payloadAdjusted "" FLOAT32_IEEE NO_COMPU_METHOD 0 0 -3.40282346639e+038 3.40282346639e+038 ECU_ADDRESS 0x120001 FORMAT "%.15" DISPLAY_IDENTIFIER toa_payloadAdjusted PHYS_UNIT "tonne" /end MEASUREMENT
/begin MEASUREMENT TOAtestPts.toa_payloadAncAdjusted "" FLOAT32_IEEE NO_COMPU_METHOD 0 0 -3.40282346639e+038 3.40282346639e+038 ECU_ADDRESS 0x120017 FORMAT "%.15" DISPLAY_IDENTIFIER toa_payloadAncAdjusted PHYS_UNIT "tonne" /end MEASUREMENT
/begin MEASUREMENT TOAtestPts.toa_payloadAncZeroed "" FLOAT32_IEEE NO_COMPU_METHOD 0 0 -3.40282346639e+038 3.40282346639e+038 ECU_ADDRESS 0x120016 FORMAT "%.15" DISPLAY_IDENTIFIER toa_payloadAncZeroed PHYS_UNIT "tonne" /end MEASUREMENT
/begin MEASUREMENT TOAtestPts.toa_payloadZeroed "" FLOAT32_IEEE NO_COMPU_METHOD 0 0 -3.40282346639e+038 3.40282346639e+038 ECU_ADDRESS 0x120023 FORMAT "%.15" DISPLAY_IDENTIFIER toa_payloadZeroed PHYS_UNIT "tonne" /end MEASUREMENT
/begin MEASUREMENT TOAtestPts.toa_pfwIsWarm "" UBYTE TOAtestPts.toa_pfwIsWarm.CONVERSION 0 0 0 255 ECU_ADDRESS 0x120024 FORMAT "%.15" DISPLAY_IDENTIFIER toa_pfwIsWarm DISCRETE /end MEASUREMENT
/begin MEASUREMENT TOAtestPts.toa_pfwLatchInvalidate "" UBYTE TOAtestPts.toa_pfwLatchInvalidate.CONVERSION 0 0 0 255 ECU_ADDRESS 0x12003E FORMAT "%.15" DISPLAY_IDENTIFIER toa_pfwLatchInvalidate DISCRETE /end MEASUREMENT
/begin MEASUREMENT TOAtestPts.toa_pfwMcMaybeGrounded "" UBYTE TOAtestPts.toa_pfwMcMaybeGrounded.CONVERSION 0 0 0 255 ECU_ADDRESS 0x12002D FORMAT "%.15" DISPLAY_IDENTIFIER toa_pfwMcMaybeGrounded DISCRETE /end MEASUREMENT
/begin MEASUREMENT TOAtestPts.toa_pfwMcMaybeRackStall "" UBYTE TOAtestPts.toa_pfwMcMaybeRackStall.CONVERSION 0 0 0 255 ECU_ADDRESS 0x12002C FORMAT "%.15" DISPLAY_IDENTIFIER toa_pfwMcMaybeRackStall DISCRETE /end MEASUREMENT
/begin MEASUREMENT TOAtestPts.toa_pfwMcMaybeStalled "" UBYTE TOAtestPts.toa_pfwMcMaybeStalled.CONVERSION 0 0 0 255 ECU_ADDRESS 0x12002B FORMAT "%.15" DISPLAY_IDENTIFIER toa_pfwMcMaybeStalled DISCRETE /end MEASUREMENT
/begin MEASUREMENT TOAtestPts.toa_pfwMcOk "" UBYTE TOAtestPts.toa_pfwMcOk.CONVERSION 0 0 0 255 ECU_ADDRESS 0x12002A FORMAT "%.15" DISPLAY_IDENTIFIER toa_pfwMcOk DISCRETE /end MEASUREMENT
/begin MEASUREMENT TOAtestPts.toa_pfwNlMeanEst "" FLOAT32_IEEE NO_COMPU_METHOD 0 0 -3.40282346639e+038 3.40282346639e+038 ECU_ADDRESS 0x12003A FORMAT "%.15" DISPLAY_IDENTIFIER toa_pfwNlMeanEst PHYS_UNIT "tonne" /end MEASUREMENT
/begin MEASUREMENT TOAtestPts.toa_pfwNlNotchMeanEst "" FLOAT32_IEEE NO_COMPU_METHOD 0 0 -3.40282346639e+038 3.40282346639e+038 ECU_ADDRESS 0x120007 FORMAT "%.15" DISPLAY_IDENTIFIER toa_pfwNlNotchMeanEst PHYS_UNIT "tonne" /end MEASUREMENT
/begin MEASUREMENT TOAtestPts.toa_pfwNlNotchStDevEst "" FLOAT32_IEEE NO_COMPU_METHOD 0 0 -3.40282346639e+038 3.40282346639e+038 ECU_ADDRESS 0x120006 FORMAT "%.15" DISPLAY_IDENTIFIER toa_pfwNlNotchStDevEst PHYS_UNIT "tonne" /end MEASUREMENT
/begin MEASUREMENT TOAtestPts.toa_pfwNlStDevEst "" FLOAT32_IEEE NO_COMPU_METHOD 0 0 -3.40282346639e+038 3.40282346639e+038 ECU_ADDRESS 0x12001B FORMAT "%.15" DISPLAY_IDENTIFIER toa_pfwNlStDevEst PHYS_UNIT "tonne" /end MEASUREMENT
/begin MEASUREMENT TOAtestPts.toa_pfwPayloadFiltFinal "" FLOAT32_IEEE NO_COMPU_METHOD 0 0 -3.40282346639e+038 3.40282346639e+038 ECU_ADDRESS 0x12003B FORMAT "%.15" DISPLAY_IDENTIFIER toa_pfwPayloadFiltFinal PHYS_UNIT "tonne" /end MEASUREMENT
/begin MEASUREMENT TOAtestPts.toa_pfwPayloadNotchFiltFinal "" FLOAT32_IEEE NO_COMPU_METHOD 0 0 -3.40282346639e+038 3.40282346639e+038 ECU_ADDRESS 0x12003C FORMAT "%.15" DISPLAY_IDENTIFIER toa_pfwPayloadNotchFiltFinal PHYS_UNIT "tonne" /end MEASUREMENT
/begin MEASUREMENT TOAtestPts.toa_pfwPayloadNotchPost "" FLOAT32_IEEE NO_COMPU_METHOD 0 0 -3.40282346639e+038 3.40282346639e+038 ECU_ADDRESS 0x12003D FORMAT "%.15" DISPLAY_IDENTIFIER toa_pfwPayloadNotchPost PHYS_UNIT "tonne" /end MEASUREMENT
/begin MEASUREMENT TOAtestPts.toa_pfwSecIsNoCollapsing "" UBYTE TOAtestPts.toa_pfwSecIsNoCollapsing.CONVERSION 0 0 0 255 ECU_ADDRESS 0x120027 FORMAT "%.15" DISPLAY_IDENTIFIER toa_pfwSecIsNoCollapsing DISCRETE /end MEASUREMENT
/begin MEASUREMENT TOAtestPts.toa_pfwSecIsNoSliding "" UBYTE TOAtestPts.toa_pfwSecIsNoSliding.CONVERSION 0 0 0 255 ECU_ADDRESS 0x120026 FORMAT "%.15" DISPLAY_IDENTIFIER toa_pfwSecIsNoSliding DISCRETE /end MEASUREMENT
/begin MEASUREMENT TOAtestPts.toa_pfwSecIsRacked "" UBYTE TOAtestPts.toa_pfwSecIsRacked.CONVERSION 0 0 0 255 ECU_ADDRESS 0x120028 FORMAT "%.15" DISPLAY_IDENTIFIER toa_pfwSecIsRacked DISCRETE /end MEASUREMENT
/begin MEASUREMENT TOAtestPts.toa_pfwSecIsSecure "" UBYTE TOAtestPts.toa_pfwSecIsSecure.CONVERSION 0 0 0 255 ECU_ADDRESS 0x120025 FORMAT "%.15" DISPLAY_IDENTIFIER toa_pfwSecIsSecure DISCRETE /end MEASUREMENT
/begin MEASUREMENT TOAtestPts.toa_pfwSecLatch "" UBYTE TOAtestPts.toa_pfwSecLatch.CONVERSION 0 0 0 255 ECU_ADDRESS 0x120008 FORMAT "%.15" DISPLAY_IDENTIFIER toa_pfwSecLatch DISCRETE /end MEASUREMENT
/begin MEASUREMENT TOAtestPts.toa_pfwSecMinBucketAng "" FLOAT32_IEEE NO_COMPU_METHOD 0 0 -3.40282346639e+038 3.40282346639e+038 ECU_ADDRESS 0x120029 FORMAT "%.15" DISPLAY_IDENTIFIER toa_pfwSecMinBucketAng PHYS_UNIT "degree" /end MEASUREMENT
/begin MEASUREMENT TOAtestPts.toa_pfwSecPayload "" FLOAT32_IEEE NO_COMPU_METHOD 0 0 -3.40282346639e+038 3.40282346639e+038 ECU_ADDRESS 0x120018 FORMAT "%.15" DISPLAY_IDENTIFIER toa_pfwSecPayload PHYS_UNIT "tonne" /end MEASUREMENT
/begin MEASUREMENT TOAtestPts.toa_pfwSecStDev "" FLOAT32_IEEE NO_COMPU_METHOD 0 0 -3.40282346639e+038 3.40282346639e+038 ECU_ADDRESS 0x12001A FORMAT "%.15" DISPLAY_IDENTIFIER toa_pfwSecStDev PHYS_UNIT "tonne" /end MEASUREMENT
/begin MEASUREMENT TOAtestPts.toa_pfwSecStatus "" UBYTE TOAtestPts.toa_pfwSecStatus.CONVERSION 0 0 0 255 ECU_ADDRESS 0x120019 FORMAT "%.15" DISPLAY_IDENTIFIER toa_pfwSecStatus DISCRETE /end MEASUREMENT
/begin MEASUREMENT TOAtestPts.toa_pfwUnsecBoundLower "" FLOAT32_IEEE NO_COMPU_METHOD 0 0 -3.40282346639e+038 3.40282346639e+038 ECU_ADDRESS 0x12001D FORMAT "%.15" DISPLAY_IDENTIFIER toa_pfwUnsecBoundLower PHYS_UNIT "tonne" /end MEASUREMENT
/begin MEASUREMENT TOAtestPts.toa_pfwUnsecBoundUpper "" FLOAT32_IEEE NO_COMPU_METHOD 0 0 -3.40282346639e+038 3.40282346639e+038 ECU_ADDRESS 0x12001E FORMAT "%.15" DISPLAY_IDENTIFIER toa_pfwUnsecBoundUpper PHYS_UNIT "tonne" /end MEASUREMENT
/begin MEASUREMENT TOAtestPts.toa_pfwUnsecStatus "" UBYTE TOAtestPts.toa_pfwUnsecStatus.CONVERSION 0 0 0 255 ECU_ADDRESS 0x12001C FORMAT "%.15" DISPLAY_IDENTIFIER toa_pfwUnsecStatus DISCRETE /end MEASUREMENT
/begin MEASUREMENT TOAtestPts.toa_ratedPayload "" FLOAT32_IEEE NO_COMPU_METHOD 0 0 -3.40282346639e+038 3.40282346639e+038 ECU_ADDRESS 0x120014 FORMAT "%.15" DISPLAY_IDENTIFIER toa_ratedPayload PHYS_UNIT "tonne" /end MEASUREMENT
/begin MEASUREMENT TOAtestPts.toa_rawDist "" FLOAT32_IEEE NO_COMPU_METHOD 0 0 -3.40282346639e+038 3.40282346639e+038 ECU_ADDRESS 0x120021 FORMAT "%.15" DISPLAY_IDENTIFIER toa_rawDist PHYS_UNIT "mm" /end MEASUREMENT
/begin MEASUREMENT TOAtestPts.toa_rawPayload "" FLOAT32_IEEE NO_COMPU_METHOD 0 0 -3.40282346639e+038 3.40282346639e+038 ECU_ADDRESS 0x120022 FORMAT "%.15" DISPLAY_IDENTIFIER toa_rawPayload PHYS_UNIT "tonne" /end MEASUREMENT
/begin MEASUREMENT TOAtestPts.toa_sendCpmLivePayload "" FLOAT32_IEEE NO_COMPU_METHOD 0 0 -3.40282346639e+038 3.40282346639e+038 ECU_ADDRESS 0x12004F FORMAT "%.15" DISPLAY_IDENTIFIER toa_sendCpmLivePayload PHYS_UNIT "tonne" /end MEASUREMENT
/begin MEASUREMENT TOAtestPts.toa_sendPayloadArb "" FLOAT32_IEEE NO_COMPU_METHOD 0 0 -3.40282346639e+038 3.40282346639e+038 ECU_ADDRESS 0x12000C FORMAT "%.15" DISPLAY_IDENTIFIER toa_sendPayloadArb PHYS_UNIT "tonne" /end MEASUREMENT
/begin MEASUREMENT TOAtestPts.toa_sfuncInGravX "" FLOAT32_IEEE NO_COMPU_METHOD 0 0 -3.40282346639e+038 3.40282346639e+038 ECU_ADDRESS 0x120004 FORMAT "%.15" DISPLAY_IDENTIFIER toa_sfuncInGravX PHYS_UNIT "m/s^2" /end MEASUREMENT
/begin MEASUREMENT TOAtestPts.toa_sfuncInGravY "" FLOAT32_IEEE NO_COMPU_METHOD 0 0 -3.40282346639e+038 3.40282346639e+038 ECU_ADDRESS 0x120005 FORMAT "%.15" DISPLAY_IDENTIFIER toa_sfuncInGravY PHYS_UNIT "m/s^2" /end MEASUREMENT
/begin MEASUREMENT TOAtestPts.toa_sfuncInLiftForce "" FLOAT32_IEEE NO_COMPU_METHOD 0 0 -3.40282346639e+038 3.40282346639e+038 ECU_ADDRESS 0x120003 FORMAT "%.15" DISPLAY_IDENTIFIER toa_sfuncInLiftForce PHYS_UNIT "millinewtons" /end MEASUREMENT
/begin MEASUREMENT TOAtestPts.toa_sfuncInTiltForce "" FLOAT32_IEEE NO_COMPU_METHOD 0 0 -3.40282346639e+038 3.40282346639e+038 ECU_ADDRESS 0x120002 FORMAT "%.15" DISPLAY_IDENTIFIER toa_sfuncInTiltForce PHYS_UNIT "millinewtons" /end MEASUREMENT
/begin MEASUREMENT TOAtestPts.toa_sfuncOutRawMassTonne "" FLOAT32_IEEE NO_COMPU_METHOD 0 0 -3.40282346639e+038 3.40282346639e+038 ECU_ADDRESS 0x120000 FORMAT "%.15" DISPLAY_IDENTIFIER toa_sfuncOutRawMassTonne PHYS_UNIT "tonne" /end MEASUREMENT
/begin MEASUREMENT TOAtestPts.toa_statPayloadNlNotchOneLow "" FLOAT32_IEEE NO_COMPU_METHOD 0 0 -3.40282346639e+038 3.40282346639e+038 ECU_ADDRESS 0x12002F FORMAT "%.15" DISPLAY_IDENTIFIER toa_statPayloadNlNotchOneLow PHYS_UNIT "tonne" /end MEASUREMENT
/begin MEASUREMENT TOAtestPts.toa_statPayloadNlNotchOneSize "" FLOAT32_IEEE NO_COMPU_METHOD 0 0 -3.40282346639e+038 3.40282346639e+038 ECU_ADDRESS 0x120030 FORMAT "%.15" DISPLAY_IDENTIFIER toa_statPayloadNlNotchOneSize PHYS_UNIT "tonne" /end MEASUREMENT
/begin MEASUREMENT TOAtestPts.toa_statPayloadNlNotchOneUp "" FLOAT32_IEEE NO_COMPU_METHOD 0 0 -3.40282346639e+038 3.40282346639e+038 ECU_ADDRESS 0x12002E FORMAT "%.15" DISPLAY_IDENTIFIER toa_statPayloadNlNotchOneUp PHYS_UNIT "tonne" /end MEASUREMENT
/begin MEASUREMENT TOAtestPts.toa_statPayloadNlNotchTwoLow "" FLOAT32_IEEE NO_COMPU_METHOD 0 0 -3.40282346639e+038 3.40282346639e+038 ECU_ADDRESS 0x120032 FORMAT "%.15" DISPLAY_IDENTIFIER toa_statPayloadNlNotchTwoLow PHYS_UNIT "tonne" /end MEASUREMENT
/begin MEASUREMENT TOAtestPts.toa_statPayloadNlNotchTwoSize "" FLOAT32_IEEE NO_COMPU_METHOD 0 0 -3.40282346639e+038 3.40282346639e+038 ECU_ADDRESS 0x120033 FORMAT "%.15" DISPLAY_IDENTIFIER toa_statPayloadNlNotchTwoSize PHYS_UNIT "tonne" /end MEASUREMENT
/begin MEASUREMENT TOAtestPts.toa_statPayloadNlNotchTwoUp "" FLOAT32_IEEE NO_COMPU_METHOD 0 0 -3.40282346639e+038 3.40282346639e+038 ECU_ADDRESS 0x120031 FORMAT "%.15" DISPLAY_IDENTIFIER toa_statPayloadNlNotchTwoUp PHYS_UNIT "tonne" /end MEASUREMENT
/begin MEASUREMENT TOAtestPts.toa_statPayloadNlOneLow "" FLOAT32_IEEE NO_COMPU_METHOD 0 0 -3.40282346639e+038 3.40282346639e+038 ECU_ADDRESS 0x120035 FORMAT "%.15" DISPLAY_IDENTIFIER toa_statPayloadNlOneLow PHYS_UNIT "tonne" /end MEASUREMENT
/begin MEASUREMENT TOAtestPts.toa_statPayloadNlOneSize "" FLOAT32_IEEE NO_COMPU_METHOD 0 0 -3.40282346639e+038 3.40282346639e+038 ECU_ADDRESS 0x120036 FORMAT "%.15" DISPLAY_IDENTIFIER toa_statPayloadNlOneSize PHYS_UNIT "tonne" /end MEASUREMENT
/begin MEASUREMENT TOAtestPts.toa_statPayloadNlOneUp "" FLOAT32_IEEE NO_COMPU_METHOD 0 0 -3.40282346639e+038 3.40282346639e+038 ECU_ADDRESS 0x120034 FORMAT "%.15" DISPLAY_IDENTIFIER toa_statPayloadNlOneUp PHYS_UNIT "tonne" /end MEASUREMENT
/begin MEASUREMENT TOAtestPts.toa_statPayloadNlTwoLow "" FLOAT32_IEEE NO_COMPU_METHOD 0 0 -3.40282346639e+038 3.40282346639e+038 ECU_ADDRESS 0x120038 FORMAT "%.15" DISPLAY_IDENTIFIER toa_statPayloadNlTwoLow PHYS_UNIT "tonne" /end MEASUREMENT
/begin MEASUREMENT TOAtestPts.toa_statPayloadNlTwoSize "" FLOAT32_IEEE NO_COMPU_METHOD 0 0 -3.40282346639e+038 3.40282346639e+038 ECU_ADDRESS 0x120039 FORMAT "%.15" DISPLAY_IDENTIFIER toa_statPayloadNlTwoSize PHYS_UNIT "tonne" /end MEASUREMENT
/begin MEASUREMENT TOAtestPts.toa_statPayloadNlTwoUp "" FLOAT32_IEEE NO_COMPU_METHOD 0 0 -3.40282346639e+038 3.40282346639e+038 ECU_ADDRESS 0x120037 FORMAT "%.15" DISPLAY_IDENTIFIER toa_statPayloadNlTwoUp PHYS_UNIT "tonne" /end MEASUREMENT
/begin MEASUREMENT TOAtestPts.toa_statPayloadSecureOneLower "" FLOAT32_IEEE NO_COMPU_METHOD 0 0 -3.40282346639e+038 3.40282346639e+038 ECU_ADDRESS 0x12004B FORMAT "%.15" DISPLAY_IDENTIFIER toa_targetPayloadPostComp PHYS_UNIT "tonne" /end MEASUREMENT
/begin MEASUREMENT TOAtestPts.toa_statPayloadSecureOneSize "" FLOAT32_IEEE NO_COMPU_METHOD 0 0 -3.40282346639e+038 3.40282346639e+038 ECU_ADDRESS 0x12004C FORMAT "%.15" DISPLAY_IDENTIFIER toa_targetPayloadPostComp PHYS_UNIT "tonne" /end MEASUREMENT
/begin MEASUREMENT TOAtestPts.toa_statPayloadSecureOneUpper "" FLOAT32_IEEE NO_COMPU_METHOD 0 0 -3.40282346639e+038 3.40282346639e+038 ECU_ADDRESS 0x12004A FORMAT "%.15" DISPLAY_IDENTIFIER toa_targetPayloadPostComp PHYS_UNIT "tonne" /end MEASUREMENT
/begin MEASUREMENT TOAtestPts.toa_statPayloadSecureTwoLower "" FLOAT32_IEEE NO_COMPU_METHOD 0 0 -3.40282346639e+038 3.40282346639e+038 ECU_ADDRESS 0x12004E FORMAT "%.15" DISPLAY_IDENTIFIER toa_targetPayloadPostComp PHYS_UNIT "tonne" /end MEASUREMENT
/begin MEASUREMENT TOAtestPts.toa_statPayloadSecureTwoSize "" FLOAT32_IEEE NO_COMPU_METHOD 0 0 -3.40282346639e+038 3.40282346639e+038 ECU_ADDRESS 0x120049 FORMAT "%.15" DISPLAY_IDENTIFIER toa_targetPayloadPostComp PHYS_UNIT "tonne" /end MEASUREMENT
/begin MEASUREMENT TOAtestPts.toa_statPayloadSecureTwoUpper "" FLOAT32_IEEE NO_COMPU_METHOD 0 0 -3.40282346639e+038 3.40282346639e+038 ECU_ADDRESS 0x12004D FORMAT "%.15" DISPLAY_IDENTIFIER toa_targetPayloadPostComp PHYS_UNIT "tonne" /end MEASUREMENT
/begin MEASUREMENT TOAtestPts.toa_targetCompMargin "" FLOAT32_IEEE NO_COMPU_METHOD 0 0 -3.40282346639e+038 3.40282346639e+038 ECU_ADDRESS 0x120046 FORMAT "%.15" DISPLAY_IDENTIFIER toa_targetCompMargin PHYS_UNIT "tonne" /end MEASUREMENT
/begin MEASUREMENT TOAtestPts.toa_targetPayloadFinal "" FLOAT32_IEEE NO_COMPU_METHOD 0 0 -3.40282346639e+038 3.40282346639e+038 ECU_ADDRESS 0x12000A FORMAT "%.15" DISPLAY_IDENTIFIER toa_targetPayloadFinal PHYS_UNIT "tonne" /end MEASUREMENT
/begin MEASUREMENT TOAtestPts.toa_targetPayloadPostComp "" FLOAT32_IEEE NO_COMPU_METHOD 0 0 -3.40282346639e+038 3.40282346639e+038 ECU_ADDRESS 0x120047 FORMAT "%.15" DISPLAY_IDENTIFIER toa_targetPayloadPostComp PHYS_UNIT "tonne" /end MEASUREMENT
/begin MEASUREMENT TOAtestPts.toa_targetPayloadPreComp "" FLOAT32_IEEE NO_COMPU_METHOD 0 0 -3.40282346639e+038 3.40282346639e+038 ECU_ADDRESS 0x120048 FORMAT "%.15" DISPLAY_IDENTIFIER toa_targetPayloadPreComp PHYS_UNIT "tonne" /end MEASUREMENT
/begin MEASUREMENT TOAtestPts.toa_targetPayloadStatus "" UBYTE TOAtestPts.toa_targetPayloadStatus.CONVERSION 0 0 0 255 ECU_ADDRESS 0x12000B FORMAT "%.15" DISPLAY_IDENTIFIER toa_targetPayloadStatus DISCRETE /end MEASUREMENT
/begin MEASUREMENT TOAtestPts.toa_tiltBoreDia "" FLOAT32_IEEE NO_COMPU_METHOD 0 0 -3.40282346639e+038 3.40282346639e+038 ECU_ADDRESS 0x12000F FORMAT "%.15" DISPLAY_IDENTIFIER toa_tiltBoreDia PHYS_UNIT "mm" /end MEASUREMENT
/begin MEASUREMENT TOAtestPts.toa_tiltNumCyl "" UBYTE NO_COMPU_METHOD 0 0 0 255 ECU_ADDRESS 0x120010 FORMAT "%.15" DISPLAY_IDENTIFIER toa_tiltNumCyl PHYS_UNIT "count" DISCRETE /end MEASUREMENT
/begin MEASUREMENT TOAtestPts.toa_tiltRodDia "" FLOAT32_IEEE NO_COMPU_METHOD 0 0 -3.40282346639e+038 3.40282346639e+038 ECU_ADDRESS 0x120011 FORMAT "%.15" DISPLAY_IDENTIFIER toa_tiltRodDia PHYS_UNIT "mm" /end MEASUREMENT
/begin MEASUREMENT TOAtestPts.toa_toolBcLength "" FLOAT32_IEEE NO_COMPU_METHOD 0 0 -3.40282346639e+038 3.40282346639e+038 ECU_ADDRESS 0x120015 FORMAT "%.15" DISPLAY_IDENTIFIER toa_toolBcLength PHYS_UNIT "mm" /end MEASUREMENT
/begin MEASUREMENT WOA.ActiveJobId "" SLONG NO_COMPU_METHOD 0 0 -2147483648 2147483647 ECU_ADDRESS 0xF0002 FORMAT "%.15" /end MEASUREMENT
/begin MEASUREMENT WOA.ActiveSiteId "" SLONG NO_COMPU_METHOD 0 0 -2147483648 2147483647 ECU_ADDRESS 0xF0001 FORMAT "%.15" /end MEASUREMENT
/begin MEASUREMENT WOA.ActivityDetected "" SBYTE NO_COMPU_METHOD 0 0 -128 127 ECU_ADDRESS 0xF0000 FORMAT "%.15" /end MEASUREMENT
/begin MEASUREMENT WOA.Counter "" SLONG NO_COMPU_METHOD 0 0 -2147483648 2147483647 ECU_ADDRESS 0xF00FF FORMAT "%.15" /end MEASUREMENT
/begin MEASUREMENT WOA.HubServiceCommsActive "" SBYTE NO_COMPU_METHOD 0 0 -128 127 ECU_ADDRESS 0xF0006 FORMAT "%.15" /end MEASUREMENT
/begin MEASUREMENT WOA.HubServiceRxCount "" UWORD NO_COMPU_METHOD 0 0 0 65535 ECU_ADDRESS 0xF0005 FORMAT "%.15" /end MEASUREMENT
/begin MEASUREMENT WOA.HubServiceTxErrorCount "" UWORD NO_COMPU_METHOD 0 0 0 65535 ECU_ADDRESS 0xF0003 FORMAT "%.15" /end MEASUREMENT
/begin MEASUREMENT WOA.HubServiceTxSuccessCount "" UWORD NO_COMPU_METHOD 0 0 0 65535 ECU_ADDRESS 0xF0004 FORMAT "%.15" /end MEASUREMENT
/begin MEASUREMENT WOA.NumberOfJobs "" UWORD NO_COMPU_METHOD 0 0 0 65535 ECU_ADDRESS 0xF0007 FORMAT "%.15" /end MEASUREMENT
/begin MEASUREMENT WeighDebug.BeenBelowRange "" SBYTE NO_COMPU_METHOD 0 0 -128 127 ECU_ADDRESS 0x30025 FORMAT "%.15" /end MEASUREMENT
/begin MEASUREMENT WeighDebug.BestBktWt.CalcMeth "" UWORD NO_COMPU_METHOD 0 0 0 65535 ECU_ADDRESS 0x30029 FORMAT "%.15" /end MEASUREMENT
/begin MEASUREMENT WeighDebug.BestBktWt.Wt "" FLOAT32_IEEE NO_COMPU_METHOD 0 0 -3.40282346639e+038 3.40282346639e+038 ECU_ADDRESS 0x30028 FORMAT "%.15" PHYS_UNIT "tonnes" /end MEASUREMENT
/begin MEASUREMENT WeighDebug.BktAngle.Stat "" SLONG NO_COMPU_METHOD 0 0 -2147483648 2147483647 ECU_ADDRESS 0x30011 FORMAT "%.15" /end MEASUREMENT
/begin MEASUREMENT WeighDebug.BktAngle.Val "" FLOAT32_IEEE NO_COMPU_METHOD 0 0 -3.40282346639e+038 3.40282346639e+038 ECU_ADDRESS 0x30012 FORMAT "%.15" PHYS_UNIT "degrees" /end MEASUREMENT
/begin MEASUREMENT WeighDebug.BucketLoadFactor "" FLOAT32_IEEE NO_COMPU_METHOD 0 0 -3.40282346639e+038 3.40282346639e+038 ECU_ADDRESS 0x30057 FORMAT "%.15" /end MEASUREMENT
/begin MEASUREMENT WeighDebug.ChassisImuAngVelX "" FLOAT32_IEEE NO_COMPU_METHOD 0 0 -3.40282346639e+038 3.40282346639e+038 ECU_ADDRESS 0x300AB FORMAT "%.15" /end MEASUREMENT
/begin MEASUREMENT WeighDebug.ChassisImuAngVelY "" FLOAT32_IEEE NO_COMPU_METHOD 0 0 -3.40282346639e+038 3.40282346639e+038 ECU_ADDRESS 0x300AC FORMAT "%.15" /end MEASUREMENT
/begin MEASUREMENT WeighDebug.ChassisImuAngVelZ "" FLOAT32_IEEE NO_COMPU_METHOD 0 0 -3.40282346639e+038 3.40282346639e+038 ECU_ADDRESS 0x300AD FORMAT "%.15" /end MEASUREMENT
/begin MEASUREMENT WeighDebug.ChassisImuBiasAngVelX "" FLOAT32_IEEE NO_COMPU_METHOD 0 0 -3.40282346639e+038 3.40282346639e+038 ECU_ADDRESS 0x3009E FORMAT "%.15" /end MEASUREMENT
/begin MEASUREMENT WeighDebug.ChassisImuBiasAngVelY "" FLOAT32_IEEE NO_COMPU_METHOD 0 0 -3.40282346639e+038 3.40282346639e+038 ECU_ADDRESS 0x3009F FORMAT "%.15" /end MEASUREMENT
/begin MEASUREMENT WeighDebug.ChassisImuBiasAngVelZ "" FLOAT32_IEEE NO_COMPU_METHOD 0 0 -3.40282346639e+038 3.40282346639e+038 ECU_ADDRESS 0x300A0 FORMAT "%.15" /end MEASUREMENT
/begin MEASUREMENT WeighDebug.ChassisImuBiasMagAngAccel "" FLOAT32_IEEE NO_COMPU_METHOD 0 0 -3.40282346639e+038 3.40282346639e+038 ECU_ADDRESS 0x300A6 FORMAT "%.15" /end MEASUREMENT
/begin MEASUREMENT WeighDebug.ChassisImuBiasMagJerk "" FLOAT32_IEEE NO_COMPU_METHOD 0 0 -3.40282346639e+038 3.40282346639e+038 ECU_ADDRESS 0x300A5 FORMAT "%.15" /end MEASUREMENT
/begin MEASUREMENT WeighDebug.ChassisImuBiasMaxAngVel "" FLOAT32_IEEE NO_COMPU_METHOD 0 0 -3.40282346639e+038 3.40282346639e+038 ECU_ADDRESS 0x300A7 FORMAT "%.15" /end MEASUREMENT
/begin MEASUREMENT WeighDebug.ChassisImuGravityX "" FLOAT32_IEEE NO_COMPU_METHOD 0 0 -3.40282346639e+038 3.40282346639e+038 ECU_ADDRESS 0x30098 FORMAT "%.15" /end MEASUREMENT
/begin MEASUREMENT WeighDebug.ChassisImuGravityY "" FLOAT32_IEEE NO_COMPU_METHOD 0 0 -3.40282346639e+038 3.40282346639e+038 ECU_ADDRESS 0x30099 FORMAT "%.15" /end MEASUREMENT
/begin MEASUREMENT WeighDebug.ChassisImuGravityZ "" FLOAT32_IEEE NO_COMPU_METHOD 0 0 -3.40282346639e+038 3.40282346639e+038 ECU_ADDRESS 0x3009A FORMAT "%.15" /end MEASUREMENT
/begin MEASUREMENT WeighDebug.ChassisImuLinAccX "" FLOAT32_IEEE NO_COMPU_METHOD 0 0 -3.40282346639e+038 3.40282346639e+038 ECU_ADDRESS 0x300A8 FORMAT "%.15" /end MEASUREMENT
/begin MEASUREMENT WeighDebug.ChassisImuLinAccY "" FLOAT32_IEEE NO_COMPU_METHOD 0 0 -3.40282346639e+038 3.40282346639e+038 ECU_ADDRESS 0x300A9 FORMAT "%.15" /end MEASUREMENT
/begin MEASUREMENT WeighDebug.ChassisImuLinAccZ "" FLOAT32_IEEE NO_COMPU_METHOD 0 0 -3.40282346639e+038 3.40282346639e+038 ECU_ADDRESS 0x300AA FORMAT "%.15" /end MEASUREMENT
/begin MEASUREMENT WeighDebug.ChassisImuPitch "" FLOAT32_IEEE NO_COMPU_METHOD 0 0 -3.40282346639e+038 3.40282346639e+038 ECU_ADDRESS 0x300A1 FORMAT "%.15" /end MEASUREMENT
/begin MEASUREMENT WeighDebug.ChassisImuRoll "" FLOAT32_IEEE NO_COMPU_METHOD 0 0 -3.40282346639e+038 3.40282346639e+038 ECU_ADDRESS 0x300A2 FORMAT "%.15" /end MEASUREMENT
/begin MEASUREMENT WeighDebug.ChassisImuSensorAngVelStatus "" UBYTE NO_COMPU_METHOD 0 0 0 255 ECU_ADDRESS 0x300A4 FORMAT "%.15" /end MEASUREMENT
/begin MEASUREMENT WeighDebug.ChassisImuSensorLinAccStatus "" UBYTE NO_COMPU_METHOD 0 0 0 255 ECU_ADDRESS 0x300A3 FORMAT "%.15" /end MEASUREMENT
/begin MEASUREMENT WeighDebug.ChassisImuVelocityX "" FLOAT32_IEEE NO_COMPU_METHOD 0 0 -3.40282346639e+038 3.40282346639e+038 ECU_ADDRESS 0x3009B FORMAT "%.15" /end MEASUREMENT
/begin MEASUREMENT WeighDebug.ChassisImuVelocityY "" FLOAT32_IEEE NO_COMPU_METHOD 0 0 -3.40282346639e+038 3.40282346639e+038 ECU_ADDRESS 0x3009C FORMAT "%.15" /end MEASUREMENT
/begin MEASUREMENT WeighDebug.ChassisImuVelocityZ "" FLOAT32_IEEE NO_COMPU_METHOD 0 0 -3.40282346639e+038 3.40282346639e+038 ECU_ADDRESS 0x3009D FORMAT "%.15" /end MEASUREMENT
/begin MEASUREMENT WeighDebug.ClockKeyonSec "" ULONG NO_COMPU_METHOD 0 0 0 4294967295 ECU_ADDRESS 0x3000A FORMAT "%.15" /end MEASUREMENT
/begin MEASUREMENT WeighDebug.Counter "" FLOAT32_IEEE NO_COMPU_METHOD 0 0 -3.40282346639e+038 3.40282346639e+038 ECU_ADDRESS 0x300FF FORMAT "%.15" /end MEASUREMENT
/begin MEASUREMENT WeighDebug.DigDetected "" SBYTE NO_COMPU_METHOD 0 0 -128 127 ECU_ADDRESS 0x30039 FORMAT "%.15" /end MEASUREMENT
/begin MEASUREMENT WeighDebug.DigDuration "" ULONG NO_COMPU_METHOD 0 0 0 4294967295 ECU_ADDRESS 0x3003C FORMAT "%.15" /end MEASUREMENT
/begin MEASUREMENT WeighDebug.DigReverseFlag "" UBYTE NO_COMPU_METHOD 0 0 0 255 ECU_ADDRESS 0x30058 FORMAT "%.15" /end MEASUREMENT
/begin MEASUREMENT WeighDebug.DigStarted "" SBYTE NO_COMPU_METHOD 0 0 -128 127 ECU_ADDRESS 0x30038 FORMAT "%.15" /end MEASUREMENT
/begin MEASUREMENT WeighDebug.DigState "UNKNOWN = 0,\\nNOT_DIGGING = 1,\\nTENTATIVE_DIGGING = 2,\\nDIGGING = 3" ULONG NO_COMPU_METHOD 0 0 0 4294967295 ECU_ADDRESS 0x3003A FORMAT "%.15" /end MEASUREMENT
/begin MEASUREMENT WeighDebug.DumpCumWtChange "" FLOAT32_IEEE NO_COMPU_METHOD 0 0 -3.40282346639e+038 3.40282346639e+038 ECU_ADDRESS 0x30037 FORMAT "%.15" /end MEASUREMENT
/begin MEASUREMENT WeighDebug.DumpStateStatus "UNKNOWN = 0, \\nFULLY_RACKED = 1, \\nNOT_RACKED_AND_NOT_DUMPED = 2, \\nPARTIALLY_DUMPED = 3, \\nFULLY_DUMPED = 4" SLONG NO_COMPU_METHOD 0 0 -2147483648 2147483647 ECU_ADDRESS 0x30027 FORMAT "%.15" /end MEASUREMENT
/begin MEASUREMENT WeighDebug.HydOilTemp.Stat "" SLONG NO_COMPU_METHOD 0 0 -2147483648 2147483647 ECU_ADDRESS 0x30008 FORMAT "%.15" /end MEASUREMENT
/begin MEASUREMENT WeighDebug.HydOilTemp.Val "" FLOAT32_IEEE NO_COMPU_METHOD 0 0 -3.40282346639e+038 3.40282346639e+038 ECU_ADDRESS 0x30009 FORMAT "%.15" PHYS_UNIT "C" /end MEASUREMENT
/begin MEASUREMENT WeighDebug.InOverloadRange "" UBYTE NO_COMPU_METHOD 0 0 0 255 ECU_ADDRESS 0x30059 FORMAT "%.15" /end MEASUREMENT
/begin MEASUREMENT WeighDebug.InWaitForLatch "" UBYTE NO_COMPU_METHOD 0 0 0 255 ECU_ADDRESS 0x3005A FORMAT "%.15" /end MEASUREMENT
/begin MEASUREMENT WeighDebug.InstWtDer "" FLOAT32_IEEE NO_COMPU_METHOD 0 0 -3.40282346639e+038 3.40282346639e+038 ECU_ADDRESS 0x30019 FORMAT "%.15" /end MEASUREMENT
/begin MEASUREMENT WeighDebug.InstWtFilt "Filtered IWT" FLOAT32_IEEE NO_COMPU_METHOD 0 0 -3.40282346639e+038 3.40282346639e+038 ECU_ADDRESS 0x3001C FORMAT "%.15" PHYS_UNIT "tonnes" /end MEASUREMENT
/begin MEASUREMENT WeighDebug.InstWtLlwFilt "" FLOAT32_IEEE NO_COMPU_METHOD 0 0 -3.40282346639e+038 3.40282346639e+038 ECU_ADDRESS 0x30018 FORMAT "%.15" PHYS_UNIT "tonnes" /end MEASUREMENT
/begin MEASUREMENT WeighDebug.InstWtRaw.Stat "" SLONG NO_COMPU_METHOD 0 0 -2147483648 2147483647 ECU_ADDRESS 0x3001B FORMAT "%.15" /end MEASUREMENT
/begin MEASUREMENT WeighDebug.InstWtRaw.Val "IWT" FLOAT32_IEEE NO_COMPU_METHOD 0 0 -3.40282346639e+038 3.40282346639e+038 ECU_ADDRESS 0x3001A FORMAT "%.15" PHYS_UNIT "tonnes" /end MEASUREMENT
/begin MEASUREMENT WeighDebug.LiftAngVel "" FLOAT32_IEEE NO_COMPU_METHOD 0 0 -3.40282346639e+038 3.40282346639e+038 ECU_ADDRESS 0x300B0 FORMAT "%.15" /end MEASUREMENT
/begin MEASUREMENT WeighDebug.LiftAngVelFilt "" FLOAT32_IEEE NO_COMPU_METHOD 0 0 -3.40282346639e+038 3.40282346639e+038 ECU_ADDRESS 0x300B1 FORMAT "%.15" /end MEASUREMENT
/begin MEASUREMENT WeighDebug.LiftAngle "" FLOAT32_IEEE NO_COMPU_METHOD 0 0 -3.40282346639e+038 3.40282346639e+038 ECU_ADDRESS 0x3004F FORMAT "%.15" DISPLAY_IDENTIFIER LiftAngle PHYS_UNIT "degrees" /end MEASUREMENT
/begin MEASUREMENT WeighDebug.LiftCylFiltLen "" FLOAT32_IEEE NO_COMPU_METHOD 0 0 -3.40282346639e+038 3.40282346639e+038 ECU_ADDRESS 0x3004C FORMAT "%.15" PHYS_UNIT "mm" /end MEASUREMENT
/begin MEASUREMENT WeighDebug.LiftCylHeDc "" FLOAT32_IEEE NO_COMPU_METHOD 0 0 -3.40282346639e+038 3.40282346639e+038 ECU_ADDRESS 0x30042 FORMAT "%.15" /end MEASUREMENT
/begin MEASUREMENT WeighDebug.LiftCylHePeriod "" SLONG NO_COMPU_METHOD 0 0 -2147483648 2147483647 ECU_ADDRESS 0x30040 FORMAT "%.15" /end MEASUREMENT
/begin MEASUREMENT WeighDebug.LiftCylHePres.Stat "" SLONG NO_COMPU_METHOD 0 0 -2147483648 2147483647 ECU_ADDRESS 0x30000 FORMAT "%.15" /end MEASUREMENT
/begin MEASUREMENT WeighDebug.LiftCylHePres.Val "" FLOAT32_IEEE NO_COMPU_METHOD 0 0 -3.40282346639e+038 3.40282346639e+038 ECU_ADDRESS 0x30001 FORMAT "%.15" PHYS_UNIT "kPa" /end MEASUREMENT
/begin MEASUREMENT WeighDebug.LiftCylHePress "" FLOAT32_IEEE NO_COMPU_METHOD 0 0 -3.40282346639e+038 3.40282346639e+038 ECU_ADDRESS 0x30043 FORMAT "%.15" DISPLAY_IDENTIFIER LiftCylHePress PHYS_UNIT "kPa" /end MEASUREMENT
/begin MEASUREMENT WeighDebug.LiftCylHePw "" SLONG NO_COMPU_METHOD 0 0 -2147483648 2147483647 ECU_ADDRESS 0x30041 FORMAT "%.15" /end MEASUREMENT
/begin MEASUREMENT WeighDebug.LiftCylLenghtNorm.Stat "" SLONG NO_COMPU_METHOD 0 0 -2147483648 2147483647 ECU_ADDRESS 0x30004 FORMAT "%.15" /end MEASUREMENT
/begin MEASUREMENT WeighDebug.LiftCylLenghtNorm.Val "" FLOAT32_IEEE NO_COMPU_METHOD 0 0 -3.40282346639e+038 3.40282346639e+038 ECU_ADDRESS 0x30005 FORMAT "%.15" PHYS_UNIT "%" /end MEASUREMENT
/begin MEASUREMENT WeighDebug.LiftCylNormLen "" FLOAT32_IEEE NO_COMPU_METHOD 0 0 -3.40282346639e+038 3.40282346639e+038 ECU_ADDRESS 0x3004D FORMAT "%.15" PHYS_UNIT "%" /end MEASUREMENT
/begin MEASUREMENT WeighDebug.LiftCylPres "diff_press" FLOAT32_IEEE NO_COMPU_METHOD 0 0 -3.40282346639e+038 3.40282346639e+038 ECU_ADDRESS 0x30017 FORMAT "%.15" DISPLAY_IDENTIFIER LiftCylPres PHYS_UNIT "kPa" /end MEASUREMENT
/begin MEASUREMENT WeighDebug.LiftCylRawLen "Actually same as filtered." FLOAT32_IEEE NO_COMPU_METHOD 0 0 -3.40282346639e+038 3.40282346639e+038 ECU_ADDRESS 0x3004B FORMAT "%.15" PHYS_UNIT "mm" /end MEASUREMENT
/begin MEASUREMENT WeighDebug.LiftCylReDc "" FLOAT32_IEEE NO_COMPU_METHOD 0 0 -3.40282346639e+038 3.40282346639e+038 ECU_ADDRESS 0x30046 FORMAT "%.15" /end MEASUREMENT
/begin MEASUREMENT WeighDebug.LiftCylRePeriod "" SLONG NO_COMPU_METHOD 0 0 -2147483648 2147483647 ECU_ADDRESS 0x30044 FORMAT "%.15" /end MEASUREMENT
/begin MEASUREMENT WeighDebug.LiftCylRePres.Stat "" SLONG NO_COMPU_METHOD 0 0 -2147483648 2147483647 ECU_ADDRESS 0x30002 FORMAT "%.15" /end MEASUREMENT
/begin MEASUREMENT WeighDebug.LiftCylRePres.Val "" FLOAT32_IEEE NO_COMPU_METHOD 0 0 -3.40282346639e+038 3.40282346639e+038 ECU_ADDRESS 0x30003 FORMAT "%.15" PHYS_UNIT "kPa" /end MEASUREMENT
/begin MEASUREMENT WeighDebug.LiftCylRePress "" FLOAT32_IEEE NO_COMPU_METHOD 0 0 -3.40282346639e+038 3.40282346639e+038 ECU_ADDRESS 0x30047 FORMAT "%.15" DISPLAY_IDENTIFIER LiftCylRePress PHYS_UNIT "kPa" /end MEASUREMENT
/begin MEASUREMENT WeighDebug.LiftCylRePw "" SLONG NO_COMPU_METHOD 0 0 -2147483648 2147483647 ECU_ADDRESS 0x30045 FORMAT "%.15" /end MEASUREMENT
/begin MEASUREMENT WeighDebug.LiftCylVel "" FLOAT32_IEEE NO_COMPU_METHOD 0 0 -3.40282346639e+038 3.40282346639e+038 ECU_ADDRESS 0x3004E FORMAT "%.15" PHYS_UNIT "mm/sec" /end MEASUREMENT
/begin MEASUREMENT WeighDebug.LiftCylVel.Stat "" SLONG NO_COMPU_METHOD 0 0 -2147483648 2147483647 ECU_ADDRESS 0x30006 FORMAT "%.15" /end MEASUREMENT
/begin MEASUREMENT WeighDebug.LiftCylVel.Val "" FLOAT32_IEEE NO_COMPU_METHOD 0 0 -3.40282346639e+038 3.40282346639e+038 ECU_ADDRESS 0x30007 FORMAT "%.15" PHYS_UNIT "mm/sec" /end MEASUREMENT
/begin MEASUREMENT WeighDebug.LiftHeFlowConst "" FLOAT32_IEEE NO_COMPU_METHOD 0 0 -3.40282346639e+038 3.40282346639e+038 ECU_ADDRESS 0x3001D FORMAT "%.15" /end MEASUREMENT
/begin MEASUREMENT WeighDebug.LiftReToHeFlowRatio "" FLOAT32_IEEE NO_COMPU_METHOD 0 0 -3.40282346639e+038 3.40282346639e+038 ECU_ADDRESS 0x3001E FORMAT "%.15" /end MEASUREMENT
/begin MEASUREMENT WeighDebug.LiftSensorDc "" FLOAT32_IEEE NO_COMPU_METHOD 0 0 -3.40282346639e+038 3.40282346639e+038 ECU_ADDRESS 0x3004A FORMAT "%.15" /end MEASUREMENT
/begin MEASUREMENT WeighDebug.LiftSensorPeriod "" SLONG NO_COMPU_METHOD 0 0 -2147483648 2147483647 ECU_ADDRESS 0x30048 FORMAT "%.15" /end MEASUREMENT
/begin MEASUREMENT WeighDebug.LiftSensorPw "" SLONG NO_COMPU_METHOD 0 0 -2147483648 2147483647 ECU_ADDRESS 0x30049 FORMAT "%.15" /end MEASUREMENT
/begin MEASUREMENT WeighDebug.LiftStalled "boolean" SLONG NO_COMPU_METHOD 0 0 -2147483648 2147483647 ECU_ADDRESS 0x30026 FORMAT "%.15" /end MEASUREMENT
/begin MEASUREMENT WeighDebug.LinkageMovement.Lift "" ULONG NO_COMPU_METHOD 0 0 0 4294967295 ECU_ADDRESS 0x3001F FORMAT "%.15" /end MEASUREMENT
/begin MEASUREMENT WeighDebug.LinkageMovement.Tilt "" ULONG NO_COMPU_METHOD 0 0 0 4294967295 ECU_ADDRESS 0x30020 FORMAT "%.15" /end MEASUREMENT
/begin MEASUREMENT WeighDebug.Live.Stat "" SLONG NO_COMPU_METHOD 0 0 -2147483648 2147483647 ECU_ADDRESS 0x3003E FORMAT "%.15" /end MEASUREMENT
/begin MEASUREMENT WeighDebug.Live.Wt "" FLOAT32_IEEE NO_COMPU_METHOD 0 0 -3.40282346639e+038 3.40282346639e+038 ECU_ADDRESS 0x3003D FORMAT "%.15" PHYS_UNIT "tonnes" /end MEASUREMENT
/begin MEASUREMENT WeighDebug.Llw.Confidence "" FLOAT32_IEEE NO_COMPU_METHOD 0 0 -3.40282346639e+038 3.40282346639e+038 ECU_ADDRESS 0x3002F FORMAT "%.15" /end MEASUREMENT
/begin MEASUREMENT WeighDebug.Llw.ConfidenceEst "" FLOAT32_IEEE NO_COMPU_METHOD 0 0 -3.40282346639e+038 3.40282346639e+038 ECU_ADDRESS 0x30030 FORMAT "%.15" /end MEASUREMENT
/begin MEASUREMENT WeighDebug.Llw.ConfidenceTimer "" FLOAT32_IEEE NO_COMPU_METHOD 0 0 -3.40282346639e+038 3.40282346639e+038 ECU_ADDRESS 0x30031 FORMAT "%.15" /end MEASUREMENT
/begin MEASUREMENT WeighDebug.Llw.LastInput "" FLOAT32_IEEE NO_COMPU_METHOD 0 0 -3.40282346639e+038 3.40282346639e+038 ECU_ADDRESS 0x3002A FORMAT "%.15" PHYS_UNIT "tonnes" /end MEASUREMENT
/begin MEASUREMENT WeighDebug.Llw.MeanEst "" FLOAT32_IEEE NO_COMPU_METHOD 0 0 -3.40282346639e+038 3.40282346639e+038 ECU_ADDRESS 0x3002B FORMAT "%.15" PHYS_UNIT "tonnes" /end MEASUREMENT
/begin MEASUREMENT WeighDebug.Llw.MeanEstComp "" FLOAT32_IEEE NO_COMPU_METHOD 0 0 -3.40282346639e+038 3.40282346639e+038 ECU_ADDRESS 0x3002C FORMAT "%.15" PHYS_UNIT "tonnes" /end MEASUREMENT
/begin MEASUREMENT WeighDebug.Llw.Stat "" SLONG NO_COMPU_METHOD 0 0 -2147483648 2147483647 ECU_ADDRESS 0x30033 FORMAT "%.15" /end MEASUREMENT
/begin MEASUREMENT WeighDebug.Llw.StdevEst "" FLOAT32_IEEE NO_COMPU_METHOD 0 0 -3.40282346639e+038 3.40282346639e+038 ECU_ADDRESS 0x3002E FORMAT "%.15" PHYS_UNIT "tonnes" /end MEASUREMENT
/begin MEASUREMENT WeighDebug.Llw.VarianceEst "" FLOAT32_IEEE NO_COMPU_METHOD 0 0 -3.40282346639e+038 3.40282346639e+038 ECU_ADDRESS 0x3002D FORMAT "%.15" PHYS_UNIT "tonnes^2" /end MEASUREMENT
/begin MEASUREMENT WeighDebug.Llw.Wt "" FLOAT32_IEEE NO_COMPU_METHOD 0 0 -3.40282346639e+038 3.40282346639e+038 ECU_ADDRESS 0x30032 FORMAT "%.15" PHYS_UNIT "tonnes" /end MEASUREMENT
/begin MEASUREMENT WeighDebug.LoaderBktPayldTrgtWt "" FLOAT32_IEEE NO_COMPU_METHOD 0 0 -3.40282346639e+038 3.40282346639e+038 ECU_ADDRESS 0x30016 FORMAT "%.15" PHYS_UNIT "tonnes" /end MEASUREMENT
/begin MEASUREMENT WeighDebug.OverloadActive "" UBYTE NO_COMPU_METHOD 0 0 0 255 ECU_ADDRESS 0x3005B FORMAT "%.15" /end MEASUREMENT
/begin MEASUREMENT WeighDebug.PassCount "" ULONG NO_COMPU_METHOD 0 0 0 4294967295 ECU_ADDRESS 0x3000B FORMAT "%.15" /end MEASUREMENT
/begin MEASUREMENT WeighDebug.PrevDigState "" UBYTE NO_COMPU_METHOD 0 0 0 255 ECU_ADDRESS 0x3005C FORMAT "%.15" /end MEASUREMENT
/begin MEASUREMENT WeighDebug.RequestedGear.Stat "" SLONG NO_COMPU_METHOD 0 0 -2147483648 2147483647 ECU_ADDRESS 0x30013 FORMAT "%.15" /end MEASUREMENT
/begin MEASUREMENT WeighDebug.RequestedGear.Val "" UWORD NO_COMPU_METHOD 0 0 0 65535 ECU_ADDRESS 0x30014 FORMAT "%.15" /end MEASUREMENT
/begin MEASUREMENT WeighDebug.ReweighWarn "" UWORD NO_COMPU_METHOD 0 0 0 65535 ECU_ADDRESS 0x3003F FORMAT "%.15" /end MEASUREMENT
/begin MEASUREMENT WeighDebug.TOATipoffLiveWeightInUse "" UBYTE NO_COMPU_METHOD 0 0 0 255 ECU_ADDRESS 0x3005D FORMAT "%.15" /end MEASUREMENT
/begin MEASUREMENT WeighDebug.TOAanchor_factor "" FLOAT32_IEEE NO_COMPU_METHOD 0 0 -3.40282346639e+038 3.40282346639e+038 ECU_ADDRESS 0x3008B FORMAT "%.15" DISPLAY_IDENTIFIER TOAanchor_factor /end MEASUREMENT
/begin MEASUREMENT WeighDebug.TOAanchor_zero_offset "" FLOAT32_IEEE NO_COMPU_METHOD 0 0 -3.40282346639e+038 3.40282346639e+038 ECU_ADDRESS 0x3008A FORMAT "%.15" DISPLAY_IDENTIFIER TOAanchor_zero_offset PHYS_UNIT "tonne" /end MEASUREMENT
/begin MEASUREMENT WeighDebug.TOAarbitrated_payload_norm_error_out "" FLOAT32_IEEE NO_COMPU_METHOD 0 0 -3.40282346639e+038 3.40282346639e+038 ECU_ADDRESS 0x30073 FORMAT "%.15" DISPLAY_IDENTIFIER TOAarbitrated_payload_norm_error_out PHYS_UNIT "% rated payload" /end MEASUREMENT
/begin MEASUREMENT WeighDebug.TOAbucket_angle "" FLOAT32_IEEE NO_COMPU_METHOD 0 0 -3.40282346639e+038 3.40282346639e+038 ECU_ADDRESS 0x30080 FORMAT "%.15" DISPLAY_IDENTIFIER TOAbucket_angle PHYS_UNIT "degree" /end MEASUREMENT
/begin MEASUREMENT WeighDebug.TOAbucket_current_weight "" FLOAT32_IEEE NO_COMPU_METHOD 0 0 -3.40282346639e+038 3.40282346639e+038 ECU_ADDRESS 0x3005F FORMAT "%.15" DISPLAY_IDENTIFIER TOAbucket_current_weight PHYS_UNIT "tonne" /end MEASUREMENT
/begin MEASUREMENT WeighDebug.TOAbucket_current_weight_accuracy "" UBYTE NO_COMPU_METHOD 0 0 0 255 ECU_ADDRESS 0x30060 FORMAT "%.15" DISPLAY_IDENTIFIER TOAbucket_current_weight_accuracy DISCRETE /end MEASUREMENT
/begin MEASUREMENT WeighDebug.TOAbucket_payload_target "" FLOAT32_IEEE NO_COMPU_METHOD 0 0 -3.40282346639e+038 3.40282346639e+038 ECU_ADDRESS 0x3008C FORMAT "%.15" DISPLAY_IDENTIFIER TOAbucket_payload_target PHYS_UNIT "tonne" /end MEASUREMENT
/begin MEASUREMENT WeighDebug.TOAcurrent_weight_norm_error_out "" FLOAT32_IEEE NO_COMPU_METHOD 0 0 -3.40282346639e+038 3.40282346639e+038 ECU_ADDRESS 0x30074 FORMAT "%.15" DISPLAY_IDENTIFIER TOAcurrent_weight_norm_error_out PHYS_UNIT "% rated payload" /end MEASUREMENT
/begin MEASUREMENT WeighDebug.TOAeef_imu_accelX "" FLOAT32_IEEE NO_COMPU_METHOD 0 0 -3.40282346639e+038 3.40282346639e+038 ECU_ADDRESS 0x30061 FORMAT "%.15" DISPLAY_IDENTIFIER TOAeef_imu_accelX /end MEASUREMENT
/begin MEASUREMENT WeighDebug.TOAeef_imu_accelY "" FLOAT32_IEEE NO_COMPU_METHOD 0 0 -3.40282346639e+038 3.40282346639e+038 ECU_ADDRESS 0x30062 FORMAT "%.15" DISPLAY_IDENTIFIER TOAeef_imu_accelY /end MEASUREMENT
/begin MEASUREMENT WeighDebug.TOAeef_imu_accelZ "" FLOAT32_IEEE NO_COMPU_METHOD 0 0 -3.40282346639e+038 3.40282346639e+038 ECU_ADDRESS 0x30063 FORMAT "%.15" DISPLAY_IDENTIFIER TOAeef_imu_accelZ /end MEASUREMENT
/begin MEASUREMENT WeighDebug.TOAerror_code_out "" UBYTE WeighDebug.TOAerror_code_out.CONVERSION 0 0 0 255 ECU_ADDRESS 0x30075 FORMAT "%.15" DISPLAY_IDENTIFIER TOAerror_code_out DISCRETE /end MEASUREMENT
/begin MEASUREMENT WeighDebug.TOAfriction_mu "" FLOAT32_IEEE NO_COMPU_METHOD 0 0 -3.40282346639e+038 3.40282346639e+038 ECU_ADDRESS 0x30096 FORMAT "%.15" DISPLAY_IDENTIFIER TOAfriction_mu PHYS_UNIT "kPa/kPa" /end MEASUREMENT
/begin MEASUREMENT WeighDebug.TOAfriction_offset "" FLOAT32_IEEE NO_COMPU_METHOD 0 0 -3.40282346639e+038 3.40282346639e+038 ECU_ADDRESS 0x30097 FORMAT "%.15" DISPLAY_IDENTIFIER TOAfriction_offset PHYS_UNIT "kPa" /end MEASUREMENT
/begin MEASUREMENT WeighDebug.TOAinput_status "" UWORD WeighDebug.TOAinput_status.CONVERSION 0 0 0 65535 ECU_ADDRESS 0x30064 FORMAT "%.15" DISPLAY_IDENTIFIER TOAinput_status DISCRETE /end MEASUREMENT
/begin MEASUREMENT WeighDebug.TOAinvalidate_outputs "" UBYTE WeighDebug.TOAinvalidate_outputs.CONVERSION 0 0 0 255 ECU_ADDRESS 0x30065 FORMAT "%.15" DISPLAY_IDENTIFIER TOAinvalidate_outputs DISCRETE /end MEASUREMENT
/begin MEASUREMENT WeighDebug.TOAlift_angle "" FLOAT32_IEEE NO_COMPU_METHOD 0 0 -3.40282346639e+038 3.40282346639e+038 ECU_ADDRESS 0x30066 FORMAT "%.15" DISPLAY_IDENTIFIER TOAlift_angle PHYS_UNIT "degree" /end MEASUREMENT
/begin MEASUREMENT WeighDebug.TOAlift_he_pressure "" FLOAT32_IEEE NO_COMPU_METHOD 0 0 -3.40282346639e+038 3.40282346639e+038 ECU_ADDRESS 0x30067 FORMAT "%.15" DISPLAY_IDENTIFIER TOAlift_he_pressure PHYS_UNIT "kPa" /end MEASUREMENT
/begin MEASUREMENT WeighDebug.TOAlift_norm_angle "" FLOAT32_IEEE NO_COMPU_METHOD 0 0 -3.40282346639e+038 3.40282346639e+038 ECU_ADDRESS 0x3008E FORMAT "%.15" DISPLAY_IDENTIFIER TOAlift_norm_angle PHYS_UNIT "decimal %" /end MEASUREMENT
/begin MEASUREMENT WeighDebug.TOAlift_norm_length "" FLOAT32_IEEE NO_COMPU_METHOD 0 0 -3.40282346639e+038 3.40282346639e+038 ECU_ADDRESS 0x3008F FORMAT "%.15" DISPLAY_IDENTIFIER TOAlift_norm_length PHYS_UNIT "decimal %" /end MEASUREMENT
/begin MEASUREMENT WeighDebug.TOAlift_re_pressure "" FLOAT32_IEEE NO_COMPU_METHOD 0 0 -3.40282346639e+038 3.40282346639e+038 ECU_ADDRESS 0x30068 FORMAT "%.15" DISPLAY_IDENTIFIER TOAlift_re_pressure PHYS_UNIT "kPa" /end MEASUREMENT
/begin MEASUREMENT WeighDebug.TOAlift_valve_cmd "" FLOAT32_IEEE NO_COMPU_METHOD 0 0 -3.40282346639e+038 3.40282346639e+038 ECU_ADDRESS 0x30069 FORMAT "%.15" DISPLAY_IDENTIFIER TOAlift_valve_cmd PHYS_UNIT "%" /end MEASUREMENT
/begin MEASUREMENT WeighDebug.TOAmin_secure_bucket_angle "" FLOAT32_IEEE NO_COMPU_METHOD 0 0 -3.40282346639e+038 3.40282346639e+038 ECU_ADDRESS 0x30092 FORMAT "%.15" DISPLAY_IDENTIFIER TOAmin_secure_bucket_angle PHYS_UNIT "degree" /end MEASUREMENT
/begin MEASUREMENT WeighDebug.TOApass_count "" UWORD NO_COMPU_METHOD 0 0 0 65535 ECU_ADDRESS 0x3008D FORMAT "%.15" DISPLAY_IDENTIFIER TOApass_count PHYS_UNIT "count" /end MEASUREMENT
/begin MEASUREMENT WeighDebug.TOApayload_norm_stdev_out "" FLOAT32_IEEE NO_COMPU_METHOD 0 0 -3.40282346639e+038 3.40282346639e+038 ECU_ADDRESS 0x30076 FORMAT "%.15" DISPLAY_IDENTIFIER TOApayload_norm_stdev_out PHYS_UNIT "% rated payload" /end MEASUREMENT
/begin MEASUREMENT WeighDebug.TOApayload_send_to_CPM "" FLOAT32_IEEE NO_COMPU_METHOD 0 0 -3.40282346639e+038 3.40282346639e+038 ECU_ADDRESS 0x30077 FORMAT "%.15" DISPLAY_IDENTIFIER TOApayload_send_to_CPM PHYS_UNIT "tonne" /end MEASUREMENT
/begin MEASUREMENT WeighDebug.TOApayload_status_send_to_CPM "" UBYTE WeighDebug.TOApayload_status_send_to_CPM.CONVERSION 0 0 0 255 ECU_ADDRESS 0x30078 FORMAT "%.15" DISPLAY_IDENTIFIER TOApayload_status_send_to_CPM DISCRETE /end MEASUREMENT
/begin MEASUREMENT WeighDebug.TOApcs_weight_accuracy_out "" UBYTE NO_COMPU_METHOD 0 0 0 255 ECU_ADDRESS 0x30079 FORMAT "%.15" DISPLAY_IDENTIFIER TOApcs_weight_accuracy_out DISCRETE /end MEASUREMENT
/begin MEASUREMENT WeighDebug.TOAsimple_cal_factor "" FLOAT32_IEEE NO_COMPU_METHOD 0 0 -3.40282346639e+038 3.40282346639e+038 ECU_ADDRESS 0x3007F FORMAT "%.15" DISPLAY_IDENTIFIER TOAsimple_cal_factor /end MEASUREMENT
/begin MEASUREMENT WeighDebug.TOAspill_rate_out "" FLOAT32_IEEE NO_COMPU_METHOD 0 0 -3.40282346639e+038 3.40282346639e+038 ECU_ADDRESS 0x3007A FORMAT "%.15" DISPLAY_IDENTIFIER TOAspill_rate_out PHYS_UNIT "% rated payload / s" /end MEASUREMENT
/begin MEASUREMENT WeighDebug.TOAsteering_angle "" FLOAT32_IEEE NO_COMPU_METHOD 0 0 -3.40282346639e+038 3.40282346639e+038 ECU_ADDRESS 0x3006A FORMAT "%.15" DISPLAY_IDENTIFIER TOAsteering_angle PHYS_UNIT "degree" /end MEASUREMENT
/begin MEASUREMENT WeighDebug.TOAtilt_extension "" FLOAT32_IEEE NO_COMPU_METHOD 0 0 -3.40282346639e+038 3.40282346639e+038 ECU_ADDRESS 0x3006B FORMAT "%.15" DISPLAY_IDENTIFIER TOAtilt_extension PHYS_UNIT "mm" /end MEASUREMENT
/begin MEASUREMENT WeighDebug.TOAtilt_he_pressure "" FLOAT32_IEEE NO_COMPU_METHOD 0 0 -3.40282346639e+038 3.40282346639e+038 ECU_ADDRESS 0x3006C FORMAT "%.15" DISPLAY_IDENTIFIER TOAtilt_he_pressure PHYS_UNIT "kPa" /end MEASUREMENT
/begin MEASUREMENT WeighDebug.TOAtilt_norm_angle "" FLOAT32_IEEE NO_COMPU_METHOD 0 0 -3.40282346639e+038 3.40282346639e+038 ECU_ADDRESS 0x30090 FORMAT "%.15" DISPLAY_IDENTIFIER TOAtilt_norm_angle PHYS_UNIT "decmial %" /end MEASUREMENT
/begin MEASUREMENT WeighDebug.TOAtilt_norm_length "" FLOAT32_IEEE NO_COMPU_METHOD 0 0 -3.40282346639e+038 3.40282346639e+038 ECU_ADDRESS 0x30091 FORMAT "%.15" DISPLAY_IDENTIFIER TOAtilt_norm_lengt PHYS_UNIT "decmial %" /end MEASUREMENT
/begin MEASUREMENT WeighDebug.TOAtilt_pressure_out "" FLOAT32_IEEE NO_COMPU_METHOD 0 0 -3.40282346639e+038 3.40282346639e+038 ECU_ADDRESS 0x3007B FORMAT "%.15" DISPLAY_IDENTIFIER TOAtilt_pressure_out PHYS_UNIT "kPa" /end MEASUREMENT
/begin MEASUREMENT WeighDebug.TOAtilt_re_pressure "" FLOAT32_IEEE NO_COMPU_METHOD 0 0 -3.40282346639e+038 3.40282346639e+038 ECU_ADDRESS 0x3006D FORMAT "%.15" DISPLAY_IDENTIFIER TOAtilt_re_pressure PHYS_UNIT "kPa" /end MEASUREMENT
/begin MEASUREMENT WeighDebug.TOAtilt_sensitivity_out "" FLOAT32_IEEE NO_COMPU_METHOD 0 0 -3.40282346639e+038 3.40282346639e+038 ECU_ADDRESS 0x3007C FORMAT "%.15" DISPLAY_IDENTIFIER TOAtilt_sensitivity_out PHYS_UNIT "mm / rad" /end MEASUREMENT
/begin MEASUREMENT WeighDebug.TOAtilt_valve_cmd "" FLOAT32_IEEE NO_COMPU_METHOD 0 0 -3.40282346639e+038 3.40282346639e+038 ECU_ADDRESS 0x3006E FORMAT "%.15" DISPLAY_IDENTIFIER TOAtilt_valve_cmd PHYS_UNIT "%" /end MEASUREMENT
/begin MEASUREMENT WeighDebug.TOAtipoff_mode "" UBYTE WeighDebug.TOAtipoff_mode.CONVERSION 0 0 0 255 ECU_ADDRESS 0x3006F FORMAT "%.15" DISPLAY_IDENTIFIER TOAtipoff_mode DISCRETE /end MEASUREMENT
/begin MEASUREMENT WeighDebug.TOAtool_mass "" FLOAT32_IEEE NO_COMPU_METHOD 0 0 -3.40282346639e+038 3.40282346639e+038 ECU_ADDRESS 0x30070 FORMAT "%.15" DISPLAY_IDENTIFIER TOAtool_mass PHYS_UNIT "tonne" /end MEASUREMENT
/begin MEASUREMENT WeighDebug.TOAtruck_start_weight "" FLOAT32_IEEE NO_COMPU_METHOD 0 0 -3.40282346639e+038 3.40282346639e+038 ECU_ADDRESS 0x30071 FORMAT "%.15" DISPLAY_IDENTIFIER TOAtruck_start_weight PHYS_UNIT "tonne" /end MEASUREMENT
/begin MEASUREMENT WeighDebug.TOAtruck_target_wt "" FLOAT32_IEEE NO_COMPU_METHOD 0 0 -3.40282346639e+038 3.40282346639e+038 ECU_ADDRESS 0x30072 FORMAT "%.15" DISPLAY_IDENTIFIER TOAtruck_target_wt PHYS_UNIT "tonne" /end MEASUREMENT
/begin MEASUREMENT WeighDebug.TOAunlatch_trigger "" UBYTE NO_COMPU_METHOD 0 0 0 255 ECU_ADDRESS 0x30081 FORMAT "%.15" DISPLAY_IDENTIFIER TOAunlatch_trigger DISCRETE /end MEASUREMENT
/begin MEASUREMENT WeighDebug.TOAunsecured_PFW_status "" UBYTE WeighDebug.TOAunsecured_PFW_status.CONVERSION 0 0 0 255 ECU_ADDRESS 0x30093 FORMAT "%.15" DISPLAY_IDENTIFIER TOAunsecured_PFW_status DISCRETE /end MEASUREMENT
/begin MEASUREMENT WeighDebug.TOAunsecured_payload_lower_bound_norm "" FLOAT32_IEEE NO_COMPU_METHOD 0 0 -3.40282346639e+038 3.40282346639e+038 ECU_ADDRESS 0x30094 FORMAT "%.15" DISPLAY_IDENTIFIER TOAunsecured_payload_lower_bound_norm PHYS_UNIT "% of rated payload" /end MEASUREMENT
/begin MEASUREMENT WeighDebug.TOAunsecured_payload_upper_bound_norm "" FLOAT32_IEEE NO_COMPU_METHOD 0 0 -3.40282346639e+038 3.40282346639e+038 ECU_ADDRESS 0x30095 FORMAT "%.15" DISPLAY_IDENTIFIER TOAunsecured_payload_upper_bound_norm PHYS_UNIT "% of rated payload" /end MEASUREMENT
/begin MEASUREMENT WeighDebug.TOAweigh_status_out "" UBYTE WeighDebug.TOAweigh_status_out.CONVERSION 0 0 0 255 ECU_ADDRESS 0x3007D FORMAT "%.15" DISPLAY_IDENTIFIER TOAweigh_status_out DISCRETE /end MEASUREMENT
/begin MEASUREMENT WeighDebug.TOAzero_offset "" FLOAT32_IEEE NO_COMPU_METHOD 0 0 -3.40282346639e+038 3.40282346639e+038 ECU_ADDRESS 0x3007E FORMAT "%.15" DISPLAY_IDENTIFIER TOAzero_offset PHYS_UNIT "tonne" /end MEASUREMENT
/begin MEASUREMENT WeighDebug.TiltAngle "" FLOAT32_IEEE NO_COMPU_METHOD 0 0 -3.40282346639e+038 3.40282346639e+038 ECU_ADDRESS 0x30055 FORMAT "%.15" PHYS_UNIT "degrees" /end MEASUREMENT
/begin MEASUREMENT WeighDebug.TiltAngleDc "" FLOAT32_IEEE NO_COMPU_METHOD 0 0 -3.40282346639e+038 3.40282346639e+038 ECU_ADDRESS 0x30052 FORMAT "%.15" /end MEASUREMENT
/begin MEASUREMENT WeighDebug.TiltAngleNorm "" FLOAT32_IEEE NO_COMPU_METHOD 0 0 -3.40282346639e+038 3.40282346639e+038 ECU_ADDRESS 0x30056 FORMAT "%.15" PHYS_UNIT "%" /end MEASUREMENT
/begin MEASUREMENT WeighDebug.TiltAnglePeriod "" SLONG NO_COMPU_METHOD 0 0 -2147483648 2147483647 ECU_ADDRESS 0x30050 FORMAT "%.15" /end MEASUREMENT
/begin MEASUREMENT WeighDebug.TiltAnglePw "" SLONG NO_COMPU_METHOD 0 0 -2147483648 2147483647 ECU_ADDRESS 0x30051 FORMAT "%.15" /end MEASUREMENT
/begin MEASUREMENT WeighDebug.TiltCylHeDc "" FLOAT32_IEEE NO_COMPU_METHOD 0 0 -3.40282346639e+038 3.40282346639e+038 ECU_ADDRESS 0x30084 FORMAT "%.15" /end MEASUREMENT
/begin MEASUREMENT WeighDebug.TiltCylHePeriod "" SLONG NO_COMPU_METHOD 0 0 -2147483648 2147483647 ECU_ADDRESS 0x30082 FORMAT "%.15" /end MEASUREMENT
/begin MEASUREMENT WeighDebug.TiltCylHePress "" FLOAT32_IEEE NO_COMPU_METHOD 0 0 -3.40282346639e+038 3.40282346639e+038 ECU_ADDRESS 0x30085 FORMAT "%.15" DISPLAY_IDENTIFIER TiltCylHePress PHYS_UNIT "kPa" /end MEASUREMENT
/begin MEASUREMENT WeighDebug.TiltCylHePw "" SLONG NO_COMPU_METHOD 0 0 -2147483648 2147483647 ECU_ADDRESS 0x30083 FORMAT "%.15" /end MEASUREMENT
/begin MEASUREMENT WeighDebug.TiltCylLengthNorm.Stat "" SLONG NO_COMPU_METHOD 0 0 -2147483648 2147483647 ECU_ADDRESS 0x3000D FORMAT "%.15" /end MEASUREMENT
/begin MEASUREMENT WeighDebug.TiltCylLengthNorm.Val "" FLOAT32_IEEE NO_COMPU_METHOD 0 0 -3.40282346639e+038 3.40282346639e+038 ECU_ADDRESS 0x3000E FORMAT "%.15" PHYS_UNIT "%" /end MEASUREMENT
/begin MEASUREMENT WeighDebug.TiltCylRawLen "Actually same as filtered." FLOAT32_IEEE NO_COMPU_METHOD 0 0 -3.40282346639e+038 3.40282346639e+038 ECU_ADDRESS 0x30053 FORMAT "%.15" PHYS_UNIT "mm" /end MEASUREMENT
/begin MEASUREMENT WeighDebug.TiltCylReDc "" FLOAT32_IEEE NO_COMPU_METHOD 0 0 -3.40282346639e+038 3.40282346639e+038 ECU_ADDRESS 0x30088 FORMAT "%.15" /end MEASUREMENT
/begin MEASUREMENT WeighDebug.TiltCylRePeriod "" SLONG NO_COMPU_METHOD 0 0 -2147483648 2147483647 ECU_ADDRESS 0x30086 FORMAT "%.15" /end MEASUREMENT
/begin MEASUREMENT WeighDebug.TiltCylRePress "" FLOAT32_IEEE NO_COMPU_METHOD 0 0 -3.40282346639e+038 3.40282346639e+038 ECU_ADDRESS 0x30089 FORMAT "%.15" DISPLAY_IDENTIFIER TiltCylRePress PHYS_UNIT "kPa" /end MEASUREMENT
/begin MEASUREMENT WeighDebug.TiltCylRePw "" SLONG NO_COMPU_METHOD 0 0 -2147483648 2147483647 ECU_ADDRESS 0x30087 FORMAT "%.15" /end MEASUREMENT
/begin MEASUREMENT WeighDebug.TiltCylVel "" FLOAT32_IEEE NO_COMPU_METHOD 0 0 -3.40282346639e+038 3.40282346639e+038 ECU_ADDRESS 0x30054 FORMAT "%.15" PHYS_UNIT "mm/sec" /end MEASUREMENT
/begin MEASUREMENT WeighDebug.TiltCylVel.Stat "" SLONG NO_COMPU_METHOD 0 0 -2147483648 2147483647 ECU_ADDRESS 0x3000F FORMAT "%.15" /end MEASUREMENT
/begin MEASUREMENT WeighDebug.TiltCylVel.Val "" FLOAT32_IEEE NO_COMPU_METHOD 0 0 -3.40282346639e+038 3.40282346639e+038 ECU_ADDRESS 0x30010 FORMAT "%.15" PHYS_UNIT "mm/sec" /end MEASUREMENT
/begin MEASUREMENT WeighDebug.TooHeavyToZero "" SBYTE NO_COMPU_METHOD 0 0 -128 127 ECU_ADDRESS 0x30035 FORMAT "%.15" /end MEASUREMENT
/begin MEASUREMENT WeighDebug.UseFastFilter "" SBYTE NO_COMPU_METHOD 0 0 -128 127 ECU_ADDRESS 0x30015 FORMAT "%.15" /end MEASUREMENT
/begin MEASUREMENT WeighDebug.Wrw.Indicator "" SLONG NO_COMPU_METHOD 0 0 -2147483648 2147483647 ECU_ADDRESS 0x30024 FORMAT "%.15" /end MEASUREMENT
/begin MEASUREMENT WeighDebug.Wrw.Status "" SLONG NO_COMPU_METHOD 0 0 -2147483648 2147483647 ECU_ADDRESS 0x30023 FORMAT "%.15" /end MEASUREMENT
/begin MEASUREMENT WeighDebug.Wrw.Warning "" SLONG NO_COMPU_METHOD 0 0 -2147483648 2147483647 ECU_ADDRESS 0x30022 FORMAT "%.15" /end MEASUREMENT
/begin MEASUREMENT WeighDebug.Wrw.Wt "" FLOAT32_IEEE NO_COMPU_METHOD 0 0 -3.40282346639e+038 3.40282346639e+038 ECU_ADDRESS 0x30021 FORMAT "%.15" PHYS_UNIT "tonnes" /end MEASUREMENT
/begin MEASUREMENT WeighDebug.WrwAccelComp "" FLOAT32_IEEE NO_COMPU_METHOD 0 0 -3.40282346639e+038 3.40282346639e+038 ECU_ADDRESS 0x300B3 FORMAT "%.15" /end MEASUREMENT
/begin MEASUREMENT WeighDebug.WrwRaw "" FLOAT32_IEEE NO_COMPU_METHOD 0 0 -3.40282346639e+038 3.40282346639e+038 ECU_ADDRESS 0x300B2 FORMAT "%.15" /end MEASUREMENT
/begin MEASUREMENT WeighDebug.WtStabilized "" SBYTE NO_COMPU_METHOD 0 0 -128 127 ECU_ADDRESS 0x3003B FORMAT "%.15" /end MEASUREMENT
/begin MEASUREMENT WeighDebug.ZeroAccepted "" SBYTE NO_COMPU_METHOD 0 0 -128 127 ECU_ADDRESS 0x30034 FORMAT "%.15" /end MEASUREMENT
/begin MEASUREMENT WeighDebug.ZeroAdjStatus "" SLONG NO_COMPU_METHOD 0 0 -2147483648 2147483647 ECU_ADDRESS 0x30036 FORMAT "%.15" /end MEASUREMENT
/begin MEASUREMENT WeighDebug.ZeroButtonPress "" SBYTE NO_COMPU_METHOD 0 0 -128 127 ECU_ADDRESS 0x3000C FORMAT "%.15" /end MEASUREMENT
/begin MEASUREMENT WeighInit.CalAdjust "" FLOAT32_IEEE NO_COMPU_METHOD 0 0 -3.40282346639e+038 3.40282346639e+038 ECU_ADDRESS 0x40003 FORMAT "%.15" /end MEASUREMENT
/begin MEASUREMENT WeighInit.CalStat "CatStat bitmap\\nCAL_EMPTY_BKT_CURVE_MASK     0x0004\\nCAL_FULL_BKT_CURVE_MASK      0x0008\\nCAL_BKT_WT_MASK              0x0010\\nCAL_LIFT_LINKAGE_MASK        0x0040\\nCAL_TILT_LINKAGE_MASK        0x0080\\n" SLONG NO_COMPU_METHOD 0 0 -2147483648 2147483647 ECU_ADDRESS 0x40001 FORMAT "%.15" /end MEASUREMENT
/begin MEASUREMENT WeighInit.CalWt "" FLOAT32_IEEE NO_COMPU_METHOD 0 0 -3.40282346639e+038 3.40282346639e+038 ECU_ADDRESS 0x40002 FORMAT "%.15" PHYS_UNIT "tonnes" /end MEASUREMENT
/begin MEASUREMENT WeighInit.Counter "" SLONG NO_COMPU_METHOD 0 0 -2147483648 2147483647 ECU_ADDRESS 0x400FF FORMAT "%.15" /end MEASUREMENT
/begin MEASUREMENT WeighInit.DigTargetWt "" FLOAT32_IEEE NO_COMPU_METHOD 0 0 -3.40282346639e+038 3.40282346639e+038 ECU_ADDRESS 0x40007 FORMAT "%.15" PHYS_UNIT "tonnes" /end MEASUREMENT
/begin MEASUREMENT WeighInit.StartOfWeigh "" FLOAT32_IEEE NO_COMPU_METHOD 0 0 -3.40282346639e+038 3.40282346639e+038 ECU_ADDRESS 0x40005 FORMAT "%.15" /end MEASUREMENT
/begin MEASUREMENT WeighInit.TiltCompGainScalar "" FLOAT32_IEEE NO_COMPU_METHOD 0 0 -3.40282346639e+038 3.40282346639e+038 ECU_ADDRESS 0x40006 FORMAT "%.15" /end MEASUREMENT
/begin MEASUREMENT WeighInit.ZeroWeight "" FLOAT32_IEEE NO_COMPU_METHOD 0 0 -3.40282346639e+038 3.40282346639e+038 ECU_ADDRESS 0x40004 FORMAT "%.15" PHYS_UNIT "tonnes" /end MEASUREMENT
/begin MEASUREMENT WeighReq.CaptureCylExtReqst "" SBYTE NO_COMPU_METHOD 0 0 -128 127 ECU_ADDRESS 0x10002 FORMAT "%.15" /end MEASUREMENT
/begin MEASUREMENT WeighReq.Counter "" SLONG NO_COMPU_METHOD 0 0 -2147483648 2147483647 ECU_ADDRESS 0x100FF FORMAT "%.15" /end MEASUREMENT
/begin MEASUREMENT WeighReq.ResetWeightReqst "" SBYTE NO_COMPU_METHOD 0 0 -128 127 ECU_ADDRESS 0x10001 FORMAT "%.15" /end MEASUREMENT
/begin MEASUREMENT WeighReq.WeighRangeBottom "" FLOAT32_IEEE NO_COMPU_METHOD 0 0 -3.40282346639e+038 3.40282346639e+038 ECU_ADDRESS 0x10004 FORMAT "%.15" PHYS_UNIT "%" /end MEASUREMENT
/begin MEASUREMENT WeighReq.WeighRangeReqst "" SBYTE NO_COMPU_METHOD 0 0 -128 127 ECU_ADDRESS 0x10003 FORMAT "%.15" /end MEASUREMENT
/begin MEASUREMENT WeighReq.WeighRangeSize "" FLOAT32_IEEE NO_COMPU_METHOD 0 0 -3.40282346639e+038 3.40282346639e+038 ECU_ADDRESS 0x10005 FORMAT "%.15" PHYS_UNIT "%" /end MEASUREMENT
/begin MEASUREMENT WeighReq.ZeroReqst "" SBYTE NO_COMPU_METHOD 0 0 -128 127 ECU_ADDRESS 0x10000 FORMAT "%.15" /end MEASUREMENT
/begin MEASUREMENT WeighResp.Counter "" SLONG NO_COMPU_METHOD 0 0 -2147483648 2147483647 ECU_ADDRESS 0x200FF FORMAT "%.15" /end MEASUREMENT
/begin MEASUREMENT WeighResp.ResetWeightResp "" SLONG NO_COMPU_METHOD 0 0 -2147483648 2147483647 ECU_ADDRESS 0x20001 FORMAT "%.15" /end MEASUREMENT
/begin MEASUREMENT WeighResp.WeighRangeResp "" SLONG NO_COMPU_METHOD 0 0 -2147483648 2147483647 ECU_ADDRESS 0x20002 FORMAT "%.15" /end MEASUREMENT
/begin MEASUREMENT WeighResp.ZeroResp "" SLONG NO_COMPU_METHOD 0 0 -2147483648 2147483647 ECU_ADDRESS 0x20000 FORMAT "%.15" /end MEASUREMENT
/begin MEASUREMENT WeighTx.BestBktWtInTonnes "" FLOAT32_IEEE NO_COMPU_METHOD 0 0 -3.40282346639e+038 3.40282346639e+038 ECU_ADDRESS 0x50003 FORMAT "%.15" PHYS_UNIT "tonnes" /end MEASUREMENT
/begin MEASUREMENT WeighTx.CalStat "0 = calibrated\\n1 = not calibrated" SLONG NO_COMPU_METHOD 0 0 -2147483648 2147483647 ECU_ADDRESS 0x50001 FORMAT "%.15" /end MEASUREMENT
/begin MEASUREMENT WeighTx.Counter "" SLONG NO_COMPU_METHOD 0 0 -2147483648 2147483647 ECU_ADDRESS 0x500FF FORMAT "%.15" /end MEASUREMENT
/begin MEASUREMENT WeighTx.DigStat "" SLONG NO_COMPU_METHOD 0 0 -2147483648 2147483647 ECU_ADDRESS 0x50000 FORMAT "%.15" /end MEASUREMENT
/begin MEASUREMENT WeighTx.DumpStat "" SLONG NO_COMPU_METHOD 0 0 -2147483648 2147483647 ECU_ADDRESS 0x50002 FORMAT "%.15" /end MEASUREMENT
/begin MEASUREMENT WeighTx.LiftCylNormLen "" FLOAT32_IEEE NO_COMPU_METHOD 0 0 -3.40282346639e+038 3.40282346639e+038 ECU_ADDRESS 0x5000B FORMAT "%.15" PHYS_UNIT "%" /end MEASUREMENT
/begin MEASUREMENT WeighTx.LiftCylVel.Stat "" SLONG NO_COMPU_METHOD 0 0 -2147483648 2147483647 ECU_ADDRESS 0x50006 FORMAT "%.15" /end MEASUREMENT
/begin MEASUREMENT WeighTx.LiftCylVel.Val "" FLOAT32_IEEE NO_COMPU_METHOD 0 0 -3.40282346639e+038 3.40282346639e+038 ECU_ADDRESS 0x50007 FORMAT "%.15" PHYS_UNIT "mm/sec" /end MEASUREMENT
/begin MEASUREMENT WeighTx.LiftPosition.Stat "" SLONG NO_COMPU_METHOD 0 0 -2147483648 2147483647 ECU_ADDRESS 0x5000A FORMAT "%.15" /end MEASUREMENT
/begin MEASUREMENT WeighTx.PayloadCalcMeth "" UWORD NO_COMPU_METHOD 0 0 0 65535 ECU_ADDRESS 0x50005 FORMAT "%.15" /end MEASUREMENT
/begin MEASUREMENT WeighTx.SimpleCalAdjust "" FLOAT32_IEEE NO_COMPU_METHOD 0 0 -3.40282346639e+038 3.40282346639e+038 ECU_ADDRESS 0x5000D FORMAT "%.15" PHYS_UNIT "%" /end MEASUREMENT
/begin MEASUREMENT WeighTx.WeighRangeBottom "" FLOAT32_IEEE NO_COMPU_METHOD 0 0 -3.40282346639e+038 3.40282346639e+038 ECU_ADDRESS 0x50008 FORMAT "%.15" PHYS_UNIT "%" /end MEASUREMENT
/begin MEASUREMENT WeighTx.WeighRangeSize "" FLOAT32_IEEE NO_COMPU_METHOD 0 0 -3.40282346639e+038 3.40282346639e+038 ECU_ADDRESS 0x50009 FORMAT "%.15" PHYS_UNIT "%" /end MEASUREMENT
/begin MEASUREMENT WeighTx.ZeroNotifyStat "" ULONG NO_COMPU_METHOD 0 0 0 4294967295 ECU_ADDRESS 0x50004 FORMAT "%.15" /end MEASUREMENT
/begin MEASUREMENT WeighTx.ZeroWeight "" FLOAT32_IEEE NO_COMPU_METHOD 0 0 -3.40282346639e+038 3.40282346639e+038 ECU_ADDRESS 0x5000E FORMAT "%.15" PHYS_UNIT "%" /end MEASUREMENT
/begin MEASUREMENT Widgets.DigState "" SLONG NO_COMPU_METHOD 0 0 -2147483648 2147483647 ECU_ADDRESS 0x100008 FORMAT "%.15" /end MEASUREMENT
/begin MEASUREMENT Widgets.DigTimeCurrent "0.01seconds/bit" UWORD NO_COMPU_METHOD 0 0 0 65535 ECU_ADDRESS 0x100006 FORMAT "%.15" /end MEASUREMENT
/begin MEASUREMENT Widgets.Gear "" UWORD NO_COMPU_METHOD 0 0 0 65535 ECU_ADDRESS 0x10000B FORMAT "%.15" /end MEASUREMENT
/begin MEASUREMENT Widgets.GearStat "0 - Good\\n1-  Bad" UWORD NO_COMPU_METHOD 0 0 0 65535 ECU_ADDRESS 0x10000C FORMAT "%.15" /end MEASUREMENT
/begin MEASUREMENT Widgets.GroundSpeed "" FLOAT32_IEEE NO_COMPU_METHOD 0 0 -3.40282346639e+038 3.40282346639e+038 ECU_ADDRESS 0x100009 FORMAT "%.15" /end MEASUREMENT
/begin MEASUREMENT Widgets.GroundSpeedStat "0 - Good\\n1 - Bad" UWORD NO_COMPU_METHOD 0 0 0 65535 ECU_ADDRESS 0x10000A FORMAT "%.15" /end MEASUREMENT
/begin MEASUREMENT Widgets.TireRev.DistStatus "0 - good\\n1- bad" UBYTE NO_COMPU_METHOD 0 0 0 255 ECU_ADDRESS 0x100002 FORMAT "%.15" /end MEASUREMENT
/begin MEASUREMENT Widgets.TireRev.FwdDistmm "" FLOAT32_IEEE NO_COMPU_METHOD 0 0 -3.40282346639e+038 3.40282346639e+038 ECU_ADDRESS 0x100000 FORMAT "%.15" /end MEASUREMENT
/begin MEASUREMENT Widgets.TireRev.FwdRotations "" FLOAT32_IEEE NO_COMPU_METHOD 0 0 -3.40282346639e+038 3.40282346639e+038 ECU_ADDRESS 0x100003 FORMAT "%.15" /end MEASUREMENT
/begin MEASUREMENT Widgets.TireRev.RevDistmm "" FLOAT32_IEEE NO_COMPU_METHOD 0 0 -3.40282346639e+038 3.40282346639e+038 ECU_ADDRESS 0x100001 FORMAT "%.15" /end MEASUREMENT
/begin MEASUREMENT Widgets.TireRev.RevRotations "" FLOAT32_IEEE NO_COMPU_METHOD 0 0 -3.40282346639e+038 3.40282346639e+038 ECU_ADDRESS 0x100004 FORMAT "%.15" /end MEASUREMENT
/begin MEASUREMENT Widgets.TireRev.RotationsStatus "0 - good\\n1- bad" UBYTE NO_COMPU_METHOD 0 0 0 255 ECU_ADDRESS 0x100005 FORMAT "%.15" /end MEASUREMENT
/begin MEASUREMENT Widgets.TireRevRotations "0.01Revs/bit" UWORD NO_COMPU_METHOD 0 0 0 65535 ECU_ADDRESS 0x100007 FORMAT "%.15" /end MEASUREMENT
/begin MEASUREMENT xcp_counter "" SLONG NO_COMPU_METHOD 0 0 -2147483648 2147483647 ECU_ADDRESS 0xFF FORMAT "%.15" /end MEASUREMENT
/begin GROUP CalMaps "Comment"
 /begin REF_CHARACTERISTIC Cal.lower_slow_empty_lift_ht Cal.lower_slow_empty_lift_ht_0 Cal.lower_slow_empty_lift_ht_1 Cal.lower_slow_empty_lift_ht_10 Cal.lower_slow_empty_lift_ht_2 Cal.lower_slow_empty_lift_ht_3 Cal.lower_slow_empty_lift_ht_4 Cal.lower_slow_empty_lift_ht_5 Cal.lower_slow_empty_lift_ht_6 Cal.lower_slow_empty_lift_ht_7 Cal.lower_slow_empty_lift_ht_8 Cal.lower_slow_empty_lift_ht_9 Cal.lower_slow_empty_pres Cal.lower_slow_empty_pres_0 Cal.lower_slow_empty_pres_1 Cal.lower_slow_empty_pres_10 Cal.lower_slow_empty_pres_2 Cal.lower_slow_empty_pres_3 Cal.lower_slow_empty_pres_4 Cal.lower_slow_empty_pres_5 Cal.lower_slow_empty_pres_6 Cal.lower_slow_empty_pres_7 Cal.lower_slow_empty_pres_8 Cal.lower_slow_empty_pres_9 Cal.lower_slow_full_lift_ht Cal.lower_slow_full_lift_ht_0 Cal.lower_slow_full_lift_ht_1 Cal.lower_slow_full_lift_ht_10 Cal.lower_slow_full_lift_ht_2 Cal.lower_slow_full_lift_ht_3 Cal.lower_slow_full_lift_ht_4 Cal.lower_slow_full_lift_ht_5 Cal.lower_slow_full_lift_ht_6 Cal.lower_slow_full_lift_ht_7 Cal.lower_slow_full_lift_ht_8 Cal.lower_slow_full_lift_ht_9 Cal.lower_slow_full_pres Cal.lower_slow_full_pres_0 Cal.lower_slow_full_pres_1 Cal.lower_slow_full_pres_10 Cal.lower_slow_full_pres_2 Cal.lower_slow_full_pres_3 Cal.lower_slow_full_pres_4 Cal.lower_slow_full_pres_5 Cal.lower_slow_full_pres_6 Cal.lower_slow_full_pres_7 Cal.lower_slow_full_pres_8 Cal.lower_slow_full_pres_9 Cal.raise_slow_empty_lift_ht Cal.raise_slow_empty_lift_ht_0 Cal.raise_slow_empty_lift_ht_1 Cal.raise_slow_empty_lift_ht_10 Cal.raise_slow_empty_lift_ht_2 Cal.raise_slow_empty_lift_ht_3 Cal.raise_slow_empty_lift_ht_4 Cal.raise_slow_empty_lift_ht_5 Cal.raise_slow_empty_lift_ht_6 Cal.raise_slow_empty_lift_ht_7 Cal.raise_slow_empty_lift_ht_8 Cal.raise_slow_empty_lift_ht_9 Cal.raise_slow_empty_pres Cal.raise_slow_empty_pres_0 Cal.raise_slow_empty_pres_1 Cal.raise_slow_empty_pres_10 Cal.raise_slow_empty_pres_2 Cal.raise_slow_empty_pres_3 Cal.raise_slow_empty_pres_4 Cal.raise_slow_empty_pres_5 Cal.raise_slow_empty_pres_6 Cal.raise_slow_empty_pres_7 Cal.raise_slow_empty_pres_8 Cal.raise_slow_empty_pres_9 Cal.raise_slow_full_lift_ht Cal.raise_slow_full_lift_ht_0 Cal.raise_slow_full_lift_ht_1 Cal.raise_slow_full_lift_ht_10 Cal.raise_slow_full_lift_ht_2 Cal.raise_slow_full_lift_ht_3 Cal.raise_slow_full_lift_ht_4 Cal.raise_slow_full_lift_ht_5 Cal.raise_slow_full_lift_ht_6 Cal.raise_slow_full_lift_ht_7 Cal.raise_slow_full_lift_ht_8 Cal.raise_slow_full_lift_ht_9 Cal.raise_slow_full_pres Cal.raise_slow_full_pres_0 Cal.raise_slow_full_pres_1 Cal.raise_slow_full_pres_10 Cal.raise_slow_full_pres_2 Cal.raise_slow_full_pres_3 Cal.raise_slow_full_pres_4 Cal.raise_slow_full_pres_5 Cal.raise_slow_full_pres_6 Cal.raise_slow_full_pres_7 Cal.raise_slow_full_pres_8 Cal.raise_slow_full_pres_9 /end REF_CHARACTERISTIC
/end GROUP
/begin GROUP CalParameters "Comment"
 /begin REF_CHARACTERISTIC Cal.PCS_Vel_Slope Cal.PCS_cal_weight Cal.cal_adjust Cal.cal_adjust_temp Cal.empty_bucket_weight_est Cal.empty_temp Cal.full_temp Cal.hyd_oil_type_index Cal.lift_full_lower_DC_inf.val Cal.lift_full_raise_DC_inf.val Cal.raise_fast_delta_p_empty Cal.raise_fast_delta_p_full Cal.raise_speed_empty_fast Cal.raise_speed_empty_slow Cal.raise_speed_full_fast Cal.raise_speed_full_slow Cal.temp_slope Cal.tilt_full_dump_DC_inf.val Cal.tilt_full_rack_DC_inf.val Cal.zero_weight /end REF_CHARACTERISTIC
 /begin REF_MEASUREMENT Cal.Curve.EmptySlowImuOffsetFinal Cal.Curve.EmptySlowLumpedWeightFinal Cal.Curve.FullSlowLumpedWeightFinal Cal.EmptySlowImuOffsetTemp1 Cal.EmptySlowImuOffsetTemp2 Cal.EmptySlowImuOffsetTemp3 Cal.EmptySlowLumpedWeightTemp1 Cal.EmptySlowLumpedWeightTemp2 Cal.EmptySlowLumpedWeightTemp3 Cal.FullSlowImuOffsetFinal Cal.FullSlowImuOffsetTemp1 Cal.FullSlowImuOffsetTemp2 Cal.FullSlowImuOffsetTemp3 Cal.FullSlowLumpedWeightTemp1 Cal.FullSlowLumpedWeightTemp2 Cal.FullSlowLumpedWeightTemp3 /end REF_MEASUREMENT
/end GROUP
/begin GROUP CalSignals "Comment"
 /begin REF_MEASUREMENT CalOTF.Curve.EmptySlowImuOffsetFinal CalOTF.Curve.EmptySlowImuOffsetTemp1 CalOTF.Curve.EmptySlowImuOffsetTemp2 CalOTF.Curve.EmptySlowImuOffsetTemp3 CalOTF.Curve.EmptySlowLumpedWeightFinal CalOTF.Curve.EmptySlowLumpedWeightTemp1 CalOTF.Curve.EmptySlowLumpedWeightTemp2 CalOTF.Curve.EmptySlowLumpedWeightTemp3 CalOTF.Curve.EnforceLowerDetent CalOTF.Curve.EnforceRaiseDetent CalOTF.Curve.FullSlowImuOffsetFinal CalOTF.Curve.FullSlowImuOffsetTemp1 CalOTF.Curve.FullSlowImuOffsetTemp2 CalOTF.Curve.FullSlowImuOffsetTemp3 CalOTF.Curve.FullSlowLumpedWeightFinal CalOTF.Curve.FullSlowLumpedWeightTemp1 CalOTF.Curve.FullSlowLumpedWeightTemp2 CalOTF.Curve.FullSlowLumpedWeightTemp3 CalOTF.Curve.HydOilTempMet CalOTF.Curve.InternalStep CalOTF.Curve.LowerNumPoints CalOTF.Curve.LowerSlowFitDone CalOTF.Curve.RaiseFastFitDone CalOTF.Curve.RaiseFastVelDone CalOTF.Curve.RaiseNumPoints CalOTF.Curve.RaiseSlowFitDone CalOTF.Flags.CalInProgress CalOTF.Flags.EmptyBktCalDone CalOTF.Flags.FullBktCalDone CalOTF.Flags.PayloadCalFlag CalOTF.Stat.BktAngle_Stat CalOTF.Stat.HydOilTemp_Stat CalOTF.Stat.LeverInfoAvailable CalOTF.Stat.LeverInfoFaulted CalOTF.Stat.LiftCylExt_Stat CalOTF.Stat.LiftCylVel_Stat CalOTF.Stat.LiftHePres_Stat CalOTF.Stat.LiftRePres_Stat CalOTF.Stat.TiltCylExt_Stat CalOTF.TiltOverrides.CalTiltOverrideComplete CalOTF.TiltOverrides.CalTiltOverrideFail CalOTF.TiltOverrides.CountOfSamples CalOTF.TiltOverrides.DesiredTiltExtmm CalOTF.TiltOverrides.LpsCalTiltOvrStartRequest CalOTF.TiltOverrides.LpsCalTiltOvrState CalOTF.TiltOverrides.TiltDumpCmdOvr CalOTF.TiltOverrides.TiltNoiseMax CalOTF.TiltOverrides.TiltNoiseMin CalOTF.calOverrides.CalOvrAcknowledge CalOTF.calOverrides.LeverInfo.Faulted CalOTF.calOverrides.LeverInfo.InCenter CalOTF.calOverrides.LeverInfo.InLowerDetent CalOTF.calOverrides.LeverInfo.InRaiseDetent CalOTF.calOverrides.LeverInfo.ValveCmdPercent CalOTF.calOverrides.LiftBottomFlag CalOTF.calOverrides.LiftTopFlag CalOTF.calOverrides.LpsCalAppInfCalOvrActive CalOTF.calOverrides.LpsCalAppInfLowerCmdLmt CalOTF.calOverrides.LpsCalAppInfRaiseCmdLmt CalOTF.calOverrides.LpsCalOvrState /end REF_MEASUREMENT
/end GROUP
/begin GROUP CPM "Comment" ROOT /begin SUB_GROUP CalMaps CalParameters CalSignals Signals /end SUB_GROUP /end GROUP
/begin GROUP Signals "Comment"
 /begin REF_MEASUREMENT ACD.TX.Counter ACD.TX.DisplayEthernetBad ACD.TX.ProductLinkEthernetBad CAN11MessageTimeoutFlag CycleSeg.ActiveSegmentId CycleSeg.DigState CycleSeg.SegLastCompletedId CycleSeg.SegSecondsSinceLastEnd CycleSeg.SegSequenceNumber CycleSeg.cycleSegIn.ARD_fuel_rate CycleSeg.cycleSegIn.Engine_Load_Factor CycleSeg.cycleSegIn.GPS_latitude CycleSeg.cycleSegIn.GPS_longitude CycleSeg.cycleSegIn.GPS_status CycleSeg.cycleSegIn.bucket_angle CycleSeg.cycleSegIn.desired_gear CycleSeg.cycleSegIn.engine_spd_rpm CycleSeg.cycleSegIn.extForceNormalized CycleSeg.cycleSegIn.fuel_rate CycleSeg.cycleSegIn.ground_spd_kph CycleSeg.cycleSegIn.impl_operation_status CycleSeg.cycleSegIn.keyswitch_state CycleSeg.cycleSegIn.lift_angle CycleSeg.cycleSegIn.lift_valve_cmd CycleSeg.cycleSegIn.machine_idle_status CycleSeg.cycleSegIn.payload_calc_method CycleSeg.cycleSegIn.payload_ratio CycleSeg.cycleSegIn.payload_ratio_raw CycleSeg.cycleSegIn.payload_ratio_raw_status CycleSeg.cycleSegIn.payload_ratio_status CycleSeg.cycleSegIn.payload_weight CycleSeg.cycleSegIn.payload_weight_status CycleSeg.cycleSegIn.realTime_status CycleSeg.cycleSegIn.real_time CycleSeg.cycleSegIn.service_hour_meter CycleSeg.cycleSegIn.tilt_cyl_pos CycleSeg.cycleSegIn.tilt_lever_cmd CycleSeg.cycleSegIn.tilt_valve_cmd CycleSeg.cycleSegIn.timezone_offset CycleSeg.cycleSegIn.total_fuel_high_res CycleSeg.cycleSegIn.total_fuel_low_res CycleSeg.cycleSegOut.commit_rec_gps CycleSeg.cycleSegOut.commit_segment_record CycleSeg.cycleSegOut.keyswitch_override_flag CycleSeg.cycleSegOut.segment_active_segment_id CycleSeg.cycleSegOut.segment_dig_state CycleSeg.cycleSegOut.segment_last_completed_id CycleSeg.cycleSegOut.segment_rec_distance CycleSeg.cycleSegOut.segment_rec_duration CycleSeg.cycleSegOut.segment_rec_fuel_used CycleSeg.cycleSegOut.segment_rec_hour_meter CycleSeg.cycleSegOut.segment_rec_idle_time CycleSeg.cycleSegOut.segment_rec_latitude CycleSeg.cycleSegOut.segment_rec_longitude CycleSeg.cycleSegOut.segment_rec_payload CycleSeg.cycleSegOut.segment_rec_payload_calc_method CycleSeg.cycleSegOut.segment_rec_start_real_time CycleSeg.cycleSegOut.segment_rec_start_simTime CycleSeg.cycleSegOut.segment_record_id CycleSeg.cycleSegOut.segment_sequence_number CycleSeg.cycleSegOut.segment_time_since_last_end Display.Counter Display.DocumentId Display.HeartbeatCount Display.InServiceMode Display.ServiceModeCodeEntered Health.availableDisk0Memory_kb Health.availableSystemMemory_kb Health.battery_voltage Health.disk0Usage_percent Health.eth0_rx_kbs Health.eth0_tx_kbs Health.eth1_rx_kbs Health.eth1_tx_kbs Health.loadAvg15min Health.loadAvg1min Health.loadAvg5min Health.systemCpuIOWait_percent Health.systemCpuIrq_percent Health.systemCpuUsage_percent Health.systemUpTime_sec Health.totalSystemMemory_kb JobMgrDebug.Counter JobMgrDebug.CurrentState JobMgrReq.ClearReqst JobMgrReq.Counter JobMgrReq.ManualTipOffActReqst JobMgrReq.ManualTipOffDeactReqst JobMgrReq.MinusOneReqst JobMgrReq.ReWeighReqst JobMgrReq.StandByActReqst JobMgrReq.StandByDeactReqst JobMgrReq.StoreReqst JobMgrReq.TargetWeightReqst JobMgrReq.TargetWeightReqstVal JobMgrReq.TipOffStateReqst JobMgrReq.TipOffStateReqstVal JobMgrReq.TipOffToggleReqst JobMgrReq.TipOffTriggerReqst JobMgrReq.TipOffTriggerReqstVal JobMgrReq.ZeroReqst JobMgrResp.ClearResp JobMgrResp.Counter JobMgrResp.MinusOneResp JobMgrResp.ReWeighResp JobMgrResp.StandByActResp JobMgrResp.StandByDeactResp JobMgrResp.StoreResp JobMgrResp.TargetWeightResp JobMgrResp.TipOffActResp JobMgrResp.TipOffDeactResp JobMgrResp.TipOffStateResp JobMgrResp.TipOffToggleResp JobMgrResp.TipOffTriggerResp JobMgrResp.ZeroResp JobMgrTx.ClearMinusOneEnableStat JobMgrTx.Counter JobMgrTx.DispBestBktWt.IsOk JobMgrTx.DispBestBktWt.Val JobMgrTx.ManualTipOffState JobMgrTx.MaterialId JobMgrTx.OperationMode JobMgrTx.PassCount JobMgrTx.StandbyState JobMgrTx.TipOffState JobMgrTx.TipOffStateCfg JobMgrTx.TipOffTriggerType JobMgrTx.TruckTargetWeight JobMgrTx.TruckWeight Pwm.ActualTimeUs Pwm.Counter Pwm.DiffTime Pwm.ExecTime Pwm.Exp Pwm.Period._0_ Pwm.Period._1_ Pwm.Period._2_ Pwm.Period._3_ Pwm.Width._0_ Pwm.Width._1_ Pwm.Width._2_ Pwm.Width._3_ Switch.Counter Switch.STG3 TOAtestPts.Counter TOAtestPts.toa_appNumber TOAtestPts.toa_imuNeefGravX TOAtestPts.toa_imuNeefGravY TOAtestPts.toa_imuNeefGravZ TOAtestPts.toa_imuNeefPitch TOAtestPts.toa_imuRawEefAcclX TOAtestPts.toa_imuRawEefAcclY TOAtestPts.toa_imuRawEefAcclZ TOAtestPts.toa_imu_cal_pitch_angle TOAtestPts.toa_liftBoreDia TOAtestPts.toa_liftRodDia TOAtestPts.toa_lwLpfPost TOAtestPts.toa_lwSpillRate TOAtestPts.toa_lwStatus TOAtestPts.toa_payloadAdjusted TOAtestPts.toa_payloadAncAdjusted TOAtestPts.toa_payloadAncZeroed TOAtestPts.toa_payloadZeroed TOAtestPts.toa_pfwIsWarm TOAtestPts.toa_pfwLatchInvalidate TOAtestPts.toa_pfwMcMaybeGrounded TOAtestPts.toa_pfwMcMaybeRackStall TOAtestPts.toa_pfwMcMaybeStalled TOAtestPts.toa_pfwMcOk TOAtestPts.toa_pfwNlMeanEst TOAtestPts.toa_pfwNlNotchMeanEst TOAtestPts.toa_pfwNlNotchStDevEst TOAtestPts.toa_pfwNlStDevEst TOAtestPts.toa_pfwPayloadFiltFinal TOAtestPts.toa_pfwPayloadNotchFiltFinal TOAtestPts.toa_pfwPayloadNotchPost TOAtestPts.toa_pfwSecIsNoCollapsing TOAtestPts.toa_pfwSecIsNoSliding TOAtestPts.toa_pfwSecIsRacked TOAtestPts.toa_pfwSecIsSecure TOAtestPts.toa_pfwSecLatch TOAtestPts.toa_pfwSecMinBucketAng TOAtestPts.toa_pfwSecPayload TOAtestPts.toa_pfwSecStDev TOAtestPts.toa_pfwSecStatus TOAtestPts.toa_pfwUnsecBoundLower TOAtestPts.toa_pfwUnsecBoundUpper TOAtestPts.toa_pfwUnsecStatus TOAtestPts.toa_ratedPayload TOAtestPts.toa_rawDist TOAtestPts.toa_rawPayload TOAtestPts.toa_sendCpmLivePayload TOAtestPts.toa_sendPayloadArb TOAtestPts.toa_sfuncInGravX TOAtestPts.toa_sfuncInGravY TOAtestPts.toa_sfuncInLiftForce TOAtestPts.toa_sfuncInTiltForce TOAtestPts.toa_sfuncOutRawMassTonne TOAtestPts.toa_statPayloadNlNotchOneLow TOAtestPts.toa_statPayloadNlNotchOneSize TOAtestPts.toa_statPayloadNlNotchOneUp TOAtestPts.toa_statPayloadNlNotchTwoLow TOAtestPts.toa_statPayloadNlNotchTwoSize TOAtestPts.toa_statPayloadNlNotchTwoUp TOAtestPts.toa_statPayloadNlOneLow TOAtestPts.toa_statPayloadNlOneSize TOAtestPts.toa_statPayloadNlOneUp TOAtestPts.toa_statPayloadNlTwoLow TOAtestPts.toa_statPayloadNlTwoSize TOAtestPts.toa_statPayloadNlTwoUp TOAtestPts.toa_statPayloadSecureOneLower TOAtestPts.toa_statPayloadSecureOneSize TOAtestPts.toa_statPayloadSecureOneUpper TOAtestPts.toa_statPayloadSecureTwoLower TOAtestPts.toa_statPayloadSecureTwoSize TOAtestPts.toa_statPayloadSecureTwoUpper TOAtestPts.toa_targetCompMargin TOAtestPts.toa_targetPayloadFinal TOAtestPts.toa_targetPayloadPostComp TOAtestPts.toa_targetPayloadPreComp TOAtestPts.toa_targetPayloadStatus TOAtestPts.toa_tiltBoreDia TOAtestPts.toa_tiltNumCyl TOAtestPts.toa_tiltRodDia TOAtestPts.toa_toolBcLength WOA.ActiveJobId WOA.ActiveSiteId WOA.ActivityDetected WOA.Counter WOA.HubServiceCommsActive WOA.HubServiceRxCount WOA.HubServiceTxErrorCount WOA.HubServiceTxSuccessCount WOA.NumberOfJobs WeighDebug.BeenBelowRange WeighDebug.BestBktWt.CalcMeth WeighDebug.BestBktWt.Wt WeighDebug.BktAngle.Stat WeighDebug.BktAngle.Val WeighDebug.BucketLoadFactor WeighDebug.ChassisImuAngVelX WeighDebug.ChassisImuAngVelY WeighDebug.ChassisImuAngVelZ WeighDebug.ChassisImuBiasAngVelX WeighDebug.ChassisImuBiasAngVelY WeighDebug.ChassisImuBiasAngVelZ WeighDebug.ChassisImuBiasMagAngAccel WeighDebug.ChassisImuBiasMagJerk WeighDebug.ChassisImuBiasMaxAngVel WeighDebug.ChassisImuGravityX WeighDebug.ChassisImuGravityY WeighDebug.ChassisImuGravityZ WeighDebug.ChassisImuLinAccX WeighDebug.ChassisImuLinAccY WeighDebug.ChassisImuLinAccZ WeighDebug.ChassisImuPitch WeighDebug.ChassisImuRoll WeighDebug.ChassisImuSensorAngVelStatus WeighDebug.ChassisImuSensorLinAccStatus WeighDebug.ChassisImuVelocityX WeighDebug.ChassisImuVelocityY WeighDebug.ChassisImuVelocityZ WeighDebug.ClockKeyonSec WeighDebug.Counter WeighDebug.DigDetected WeighDebug.DigDuration WeighDebug.DigReverseFlag WeighDebug.DigStarted WeighDebug.DigState WeighDebug.DumpCumWtChange WeighDebug.DumpStateStatus WeighDebug.HydOilTemp.Stat WeighDebug.HydOilTemp.Val WeighDebug.InOverloadRange WeighDebug.InWaitForLatch WeighDebug.InstWtDer WeighDebug.InstWtFilt WeighDebug.InstWtLlwFilt WeighDebug.InstWtRaw.Stat WeighDebug.InstWtRaw.Val WeighDebug.LiftAngVel WeighDebug.LiftAngVelFilt WeighDebug.LiftAngle WeighDebug.LiftCylFiltLen WeighDebug.LiftCylHeDc WeighDebug.LiftCylHePeriod WeighDebug.LiftCylHePres.Stat WeighDebug.LiftCylHePres.Val WeighDebug.LiftCylHePress WeighDebug.LiftCylHePw WeighDebug.LiftCylLenghtNorm.Stat WeighDebug.LiftCylLenghtNorm.Val WeighDebug.LiftCylNormLen WeighDebug.LiftCylPres WeighDebug.LiftCylRawLen WeighDebug.LiftCylReDc WeighDebug.LiftCylRePeriod WeighDebug.LiftCylRePres.Stat WeighDebug.LiftCylRePres.Val WeighDebug.LiftCylRePress WeighDebug.LiftCylRePw WeighDebug.LiftCylVel WeighDebug.LiftCylVel.Stat WeighDebug.LiftCylVel.Val WeighDebug.LiftHeFlowConst WeighDebug.LiftReToHeFlowRatio WeighDebug.LiftSensorDc WeighDebug.LiftSensorPeriod WeighDebug.LiftSensorPw WeighDebug.LiftStalled WeighDebug.LinkageMovement.Lift WeighDebug.LinkageMovement.Tilt WeighDebug.Live.Stat WeighDebug.Live.Wt WeighDebug.Llw.Confidence WeighDebug.Llw.ConfidenceEst WeighDebug.Llw.ConfidenceTimer WeighDebug.Llw.LastInput WeighDebug.Llw.MeanEst WeighDebug.Llw.MeanEstComp WeighDebug.Llw.Stat WeighDebug.Llw.StdevEst WeighDebug.Llw.VarianceEst WeighDebug.Llw.Wt WeighDebug.LoaderBktPayldTrgtWt WeighDebug.OverloadActive WeighDebug.PassCount WeighDebug.PrevDigState WeighDebug.RequestedGear.Stat WeighDebug.RequestedGear.Val WeighDebug.ReweighWarn WeighDebug.TOATipoffLiveWeightInUse WeighDebug.TOAanchor_factor WeighDebug.TOAanchor_zero_offset WeighDebug.TOAarbitrated_payload_norm_error_out WeighDebug.TOAbucket_angle WeighDebug.TOAbucket_current_weight WeighDebug.TOAbucket_current_weight_accuracy WeighDebug.TOAbucket_payload_target WeighDebug.TOAcurrent_weight_norm_error_out WeighDebug.TOAeef_imu_accelX WeighDebug.TOAeef_imu_accelY WeighDebug.TOAeef_imu_accelZ WeighDebug.TOAerror_code_out WeighDebug.TOAfriction_mu WeighDebug.TOAfriction_offset WeighDebug.TOAinput_status WeighDebug.TOAinvalidate_outputs WeighDebug.TOAlift_angle WeighDebug.TOAlift_he_pressure WeighDebug.TOAlift_norm_angle WeighDebug.TOAlift_norm_length WeighDebug.TOAlift_re_pressure WeighDebug.TOAlift_valve_cmd WeighDebug.TOAmin_secure_bucket_angle WeighDebug.TOApass_count WeighDebug.TOApayload_norm_stdev_out WeighDebug.TOApayload_send_to_CPM WeighDebug.TOApayload_status_send_to_CPM WeighDebug.TOApcs_weight_accuracy_out WeighDebug.TOAsimple_cal_factor WeighDebug.TOAspill_rate_out WeighDebug.TOAsteering_angle WeighDebug.TOAtilt_extension WeighDebug.TOAtilt_he_pressure WeighDebug.TOAtilt_norm_angle WeighDebug.TOAtilt_norm_length WeighDebug.TOAtilt_pressure_out WeighDebug.TOAtilt_re_pressure WeighDebug.TOAtilt_sensitivity_out WeighDebug.TOAtilt_valve_cmd WeighDebug.TOAtipoff_mode WeighDebug.TOAtool_mass WeighDebug.TOAtruck_start_weight WeighDebug.TOAtruck_target_wt WeighDebug.TOAunlatch_trigger WeighDebug.TOAunsecured_PFW_status WeighDebug.TOAunsecured_payload_lower_bound_norm WeighDebug.TOAunsecured_payload_upper_bound_norm WeighDebug.TOAweigh_status_out WeighDebug.TOAzero_offset WeighDebug.TiltAngle WeighDebug.TiltAngleDc WeighDebug.TiltAngleNorm WeighDebug.TiltAnglePeriod WeighDebug.TiltAnglePw WeighDebug.TiltCylHeDc WeighDebug.TiltCylHePeriod WeighDebug.TiltCylHePress WeighDebug.TiltCylHePw WeighDebug.TiltCylLengthNorm.Stat WeighDebug.TiltCylLengthNorm.Val WeighDebug.TiltCylRawLen WeighDebug.TiltCylReDc WeighDebug.TiltCylRePeriod WeighDebug.TiltCylRePress WeighDebug.TiltCylRePw WeighDebug.TiltCylVel WeighDebug.TiltCylVel.Stat WeighDebug.TiltCylVel.Val WeighDebug.TooHeavyToZero WeighDebug.UseFastFilter WeighDebug.Wrw.Indicator WeighDebug.Wrw.Status WeighDebug.Wrw.Warning WeighDebug.Wrw.Wt WeighDebug.WrwAccelComp WeighDebug.WrwRaw WeighDebug.WtStabilized WeighDebug.ZeroAccepted WeighDebug.ZeroAdjStatus WeighDebug.ZeroButtonPress WeighInit.CalAdjust WeighInit.CalStat WeighInit.CalWt WeighInit.Counter WeighInit.DigTargetWt WeighInit.StartOfWeigh WeighInit.TiltCompGainScalar WeighInit.ZeroWeight WeighReq.CaptureCylExtReqst WeighReq.Counter WeighReq.ResetWeightReqst WeighReq.WeighRangeBottom WeighReq.WeighRangeReqst WeighReq.WeighRangeSize WeighReq.ZeroReqst WeighResp.Counter WeighResp.ResetWeightResp WeighResp.WeighRangeResp WeighResp.ZeroResp WeighTx.BestBktWtInTonnes WeighTx.CalStat WeighTx.Counter WeighTx.DigStat WeighTx.DumpStat WeighTx.LiftCylNormLen WeighTx.LiftCylVel.Stat WeighTx.LiftCylVel.Val WeighTx.LiftPosition.Stat WeighTx.PayloadCalcMeth WeighTx.SimpleCalAdjust WeighTx.WeighRangeBottom WeighTx.WeighRangeSize WeighTx.ZeroNotifyStat WeighTx.ZeroWeight Widgets.DigState Widgets.DigTimeCurrent Widgets.Gear Widgets.GearStat Widgets.GroundSpeed Widgets.GroundSpeedStat Widgets.TireRev.DistStatus Widgets.TireRev.FwdDistmm Widgets.TireRev.FwdRotations Widgets.TireRev.RevDistmm Widgets.TireRev.RevRotations Widgets.TireRev.RotationsStatus Widgets.TireRevRotations xcp_counter /end REF_MEASUREMENT
/end GROUP
/begin RECORD_LAYOUT __UBYTE_Z FNC_VALUES 1 UBYTE ROW_DIR DIRECT /end RECORD_LAYOUT
/begin RECORD_LAYOUT __UWORD_Z FNC_VALUES 1 UWORD ROW_DIR DIRECT /end RECORD_LAYOUT
/begin RECORD_LAYOUT __ULONG_Z FNC_VALUES 1 ULONG ROW_DIR DIRECT /end RECORD_LAYOUT
/begin RECORD_LAYOUT __SBYTE_Z FNC_VALUES 1 SBYTE ROW_DIR DIRECT /end RECORD_LAYOUT
/begin RECORD_LAYOUT __SWORD_Z FNC_VALUES 1 SWORD ROW_DIR DIRECT /end RECORD_LAYOUT
/begin RECORD_LAYOUT __SLONG_Z FNC_VALUES 1 SLONG ROW_DIR DIRECT /end RECORD_LAYOUT
/begin RECORD_LAYOUT __FLOAT32_IEEE_Z FNC_VALUES 1 FLOAT32_IEEE ROW_DIR DIRECT /end RECORD_LAYOUT
/begin RECORD_LAYOUT __FLOAT64_IEEE_Z FNC_VALUES 1 FLOAT64_IEEE ROW_DIR DIRECT /end RECORD_LAYOUT
/begin RECORD_LAYOUT __UBYTE_S FNC_VALUES 1 UBYTE COLUMN_DIR DIRECT /end RECORD_LAYOUT
/begin RECORD_LAYOUT __UWORD_S FNC_VALUES 1 UWORD COLUMN_DIR DIRECT /end RECORD_LAYOUT
/begin RECORD_LAYOUT __ULONG_S FNC_VALUES 1 ULONG COLUMN_DIR DIRECT /end RECORD_LAYOUT
/begin RECORD_LAYOUT __SBYTE_S FNC_VALUES 1 SBYTE COLUMN_DIR DIRECT /end RECORD_LAYOUT
/begin RECORD_LAYOUT __SWORD_S FNC_VALUES 1 SWORD COLUMN_DIR DIRECT /end RECORD_LAYOUT
/begin RECORD_LAYOUT __SLONG_S FNC_VALUES 1 SLONG COLUMN_DIR DIRECT /end RECORD_LAYOUT
/begin RECORD_LAYOUT __FLOAT32_IEEE_S FNC_VALUES 1 FLOAT32_IEEE COLUMN_DIR DIRECT /end RECORD_LAYOUT
/begin RECORD_LAYOUT __FLOAT64_IEEE_S FNC_VALUES 1 FLOAT64_IEEE COLUMN_DIR DIRECT /end RECORD_LAYOUT
/begin RECORD_LAYOUT SSV__UBYTE_S AXIS_PTS_X 1 UBYTE INDEX_INCR DIRECT /end RECORD_LAYOUT
/begin RECORD_LAYOUT SSV__UWORD_S AXIS_PTS_X 1 UWORD INDEX_INCR DIRECT /end RECORD_LAYOUT
/begin RECORD_LAYOUT SSV__ULONG_S AXIS_PTS_X 1 ULONG INDEX_INCR DIRECT /end RECORD_LAYOUT
/begin RECORD_LAYOUT SSV__SBYTE_S AXIS_PTS_X 1 SBYTE INDEX_INCR DIRECT /end RECORD_LAYOUT
/begin RECORD_LAYOUT SSV__SWORD_S AXIS_PTS_X 1 SWORD INDEX_INCR DIRECT /end RECORD_LAYOUT
/begin RECORD_LAYOUT SSV__SLONG_S AXIS_PTS_X 1 SLONG INDEX_INCR DIRECT /end RECORD_LAYOUT
/begin RECORD_LAYOUT SSV__FLOAT32_IEEE_S AXIS_PTS_X 1 FLOAT32_IEEE INDEX_INCR DIRECT /end RECORD_LAYOUT
/begin RECORD_LAYOUT SSV__FLOAT64_IEEE_S AXIS_PTS_X 1 FLOAT64_IEEE INDEX_INCR DIRECT /end RECORD_LAYOUT
/begin RECORD_LAYOUT __A_UINT64_Z FNC_VALUES 1 A_UINT64 ROW_DIR DIRECT /end RECORD_LAYOUT
/begin RECORD_LAYOUT __A_INT64_Z FNC_VALUES 1 A_INT64 ROW_DIR DIRECT /end RECORD_LAYOUT
/begin RECORD_LAYOUT __A_UINT64_S FNC_VALUES 1 A_UINT64 COLUMN_DIR DIRECT /end RECORD_LAYOUT
/begin RECORD_LAYOUT __A_INT64_S FNC_VALUES 1 A_INT64 COLUMN_DIR DIRECT /end RECORD_LAYOUT
/begin RECORD_LAYOUT SSV__A_UINT64_S AXIS_PTS_X 1 A_UINT64 INDEX_INCR DIRECT /end RECORD_LAYOUT
/begin RECORD_LAYOUT SSV__A_INT64_S AXIS_PTS_X 1 A_INT64 INDEX_INCR DIRECT /end RECORD_LAYOUT
/end MODULE
/end PROJECT
